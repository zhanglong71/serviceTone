#define MAIN_GLOBALS
#include <includes.H>
#include <CodeMenu.h>
//******************************************************************************************/
void	T0_Ini() reentrant using 0		//定时器0初始化,5ms中断一次
{
	TR0	= 0;
	TF0	= 0;
	TH0	= 0xdc;
	TL0	= 0x31;
	TR0	= 1;
	ET0	= 1;
}
void	Ser_Ini()  reentrant using 0
{
	SCON = 0x50;		   			//串口工作在模式1,速率57600bps
	PCON = 0x80;
 	TMOD = 0x21;
	//TH1  = 0xff;	/** raw setting 57600bps **/
	TH1  = 0xfe;	/** 28800bps **/
	//TH1  = 0xfd;	/** 19200bps **/
	//TH1  = 0xfc;	/** 14400bps **/
	//TH1  = 0xfb;	/** 11520bps **/
	//TH1  = 0xfa;	/** 9600bps **/
	TL1  = 0xfa;
 	TR1  = 1;
 	//Tibuf=0;
 	//gcReceComm1OK=0;
 	//testPin=0;
 	ES=1;
}
//------------------------------------------------------------------------------------------
void  mem_ini()                   //内存初始化程序
{
	INT8U i,j,k,k16;
	INT16U i_16u,j_16u;
	INT8U cntRoomBuf[4];
	j_16u=0;
	i=0;
	j=0;
	fLcdPwr=LCD_ON;
	KeyLed=LED_ON;
	Cnt5ms=0;
	CntLcdOn=0;
	KeyPoint=0x00;
	KeyCir[0]=0x00;
	KeyCir[1]=0x00;
	KeyCir[2]=0x00;
	KeyCir[3]=0x00;
	KeyCir[4]=0x00;
	KeyWrPoint=0x00;
	KeyRdPoint=0x00;
	KeyRptBuf=0x00;
	CntOv1s=0;
	init_comp_flag=0;
	IndexSend=0;
	for(i=0;i<10;i++)
  {
  	idbuf[i]=48;
  }
	fProSelect=Byte_Read(ADDR_PROSEL);
	RoomLen=0;
	MyChn=0;
  MyAddres[0]=0xa6;
  MyAddres[1]=0x1f;
  RoomLen=0;
	fProSelect=Byte_Read(ADDR_PROSEL);
	for(k=0;k<6;k++)
	{
	 	k16=k;
	 	RoomId[k]=Byte_Read(k16);
	 	if(RoomId[k]!='#')RoomLen++;
	 	else break;
	 	if(RoomId[k]<48||RoomId[k]>57)RoomId[k]=48;
	}
	j=RoomLen;
	i_16u=0;
	for(i=0;i<4;i++)cntRoomBuf[i]=0;
	for(i=0;i<RoomLen;i++)
	{
		cntRoomBuf[RoomLen-1-i]=RoomId[i]-48;
	}
	i_16u=cntRoomBuf[3]*1000+cntRoomBuf[2]*100+cntRoomBuf[1]*10+cntRoomBuf[0];
	if(i_16u>9999)i_16u=1;
	//i_16u++;
	j_16u=i_16u;
	i_16u&=0x00ff;
	MyAddres[0]=(INT8U)i_16u;
	j_16u>>=8;
	j_16u&=0x00ff;
	MyAddres[1]=(INT8U)j_16u;
	MyChn=Byte_Read(ADDR_CHNSEL);
	if(MyChn>0x0f)MyChn=0;
  staNet=NET_START;
	CntWorkId=0;
	WorkLen=0;
	CustLen=0;
	CostLen=0;
	NewRoomLen=0;
	Xiaofeilen=0;
	Numlen=0;
	Intelen=0;
	Resilen=0;
	Cost_len=0;
	Locatlen=0;
	male_female=0xFF;
	Type_clock=0xFF;
	check_flag=0xFF;
	Query=0xFF;
	Stat=0xFF;
	//ZigB_NUM_flag=0;
	LCD_disp_img_flag=0;
	Notice_operat_flag=0;
	Notice_again_ENflag=0;
	Service_type=0;
//	for(i=0;i<CNT_WORKUSE;i++)
//	{
//		Cnt1min[i]=0;
//		TimeId[i]=0;                //技师上钟时间
//		for(j=0;j<7;j++)
//		{
//			WorkingId[i][j]=48;       //技师工号
//		}
//	}
	for(i=0;i<7;i++)
	{
		CustId[i]=48;
		WorkId[i]=48;
		NewRoomId[i]=48;
		Xiaofei[i]=48;
		Inte[i]=48;
		Resi[i]=48;
		Cost[i]=48;
		QueryID[0][i]=48;
		QueryID[1][i]=48;
		QueryID[2][i]=48;
		Locat[i]=48;
	}
	for(j=0;j<4;j++)
	{
		//ZigB_NUM_buf[j]=0xFF;
		Time[j]=48;
	}
	for(j=0;j<3;j++)
	{
		Num[j]=48;
	}
	player_Cut_stop=1;
	player_Cut=10;
	player_stop=0;
	player_wait_time=0;
	
	comRxConfirmRdy=0;
	comRxDataRdy=0;
	cntSemPend=0;
//*****************************************************************
}

void LcdDisDefMen()
{
	INT8U i,i_buf,j_buf;
	clrram();
	if(fProSelect==0x04)
	{
		chn_disp(Sel04,0);
	}
	else
	{
		chn_disp(Sel05,0);
	}
	wr_lcd(comm,0x30);
  wr_lcd(comm,0x82);
  wr_lcd(dat,'.');
	for(i=0;i<7;i++)
	{
		if(RoomId[i]!='#')
		{
			wr_lcd(dat,RoomId[i]);
		}
		else break;
	}
	i_buf=MyChn/10+48;
  j_buf=MyChn%10+48;
  wr_lcd(comm,0x30);
  wr_lcd(comm,0x86);
  wr_lcd(dat,'C');
  wr_lcd(dat,i_buf);
  wr_lcd(dat,j_buf);
}
void LcdDisIniIn()   //LCD待机显示
{
	clrram();
	LcdDisDefMen();
	//chn_disp(Menu04,1);
	switch(staNet)    //网络状态
  {
  	case NET_START:
  		chn_disp(NetStaMenu00,1);
  		break;
  	case NET_INIT:
  		chn_disp(NetStaMenu03,1);
  		break;
  	case NET_JOIN:
  		chn_disp(NetStaMenu01,1);
  		break;
  	case NET_LEAVE:
  		chn_disp(NetStaMenu02,1);
  		break;
  	default: break;
  }
	//chn_disp(NetStaMenu00,1);
}
void main()
{
 	INT8U i,j,k,bufi,i_buf,j_buf,k_buf,l_buf;
 	INT16U i_16u,j_16u,k16;
 	INT8U fFirstEnt,fNetOK,fTXNewroom;
 	INT8U keycode_buf;
 	INT8U TRDataBuf[80];
 	//INT8U TRDataLen;
 	char sbuf[4];
	j_16u=0;
	sbuf[0]=0;
 	keycode_buf=0xff;
 	fOvTime=0;
 	fNetOK=0;
 	fCancel=0;
 	fFirstEnt=0;
 	fTXNewroom=0;
 	idbuf[0]=0x33;
 	idbuf[1]=0x33;
 	idbuf[2]=0x33;
 	i=0;
 	bufi=0;
 	j=0;
 	k=0;
 	k16=0;
 	EA = 0;
 	P4SW=0xff;
 	P4M0=0x08;
 	P4M1=0x00;
 	P3M0=0x78;
 	P3M1=0x00;
 	PinRff=1;
 	Ser_Ini();
	T0_Ini();
	mem_ini();
	player_init();
	EA = 1;
	PinSet=1;
	PinSet_ZigBee=1;
 	init_lcd();
 	LcdDisDefMen();
	keycode_buf=0xff;
	switch(staNet)    //网络状态
  {
   	case NET_START:
   		chn_disp(NetStaMenu00,1);
   		break;
   	case NET_INIT:
   		chn_disp(NetStaMenu03,1);
   		break;
   	case NET_JOIN:
   		chn_disp(NetStaMenu01,1);
   		break;
   	case NET_LEAVE:
   		chn_disp(NetStaMenu02,1);
   		break;
   	default: break;
  }
 	while(1)
 	{
   	WDT_CONTR=0x3d;  //喂狗 1.13s;
   	keycode_buf=KeyRd();
   	while(keycode_buf==0xff)
   	{
   		switch(staNet)    //网络状态
      {
       	case NET_START:
       		chn_disp(NetStaMenu00,1);
       		break;
       	case NET_INIT:
       		chn_disp(NetStaMenu03,1);
       		break;
       	case NET_JOIN:
       		chn_disp(NetStaMenu01,1);
       		break;
       	case NET_LEAVE:
       		chn_disp(NetStaMenu02,1);
       		break;
       	default: break;
      }
			keycode_buf=KeyRd();
			WDT_CONTR=0x3d;  //喂狗 1.13s;
			if(!PinSet)
   		{
   			delay1(4000);
   			if(!PinSet)
   			{
   				keycode_buf=0xfe;
   			}
   		}
   		if(flag_rx_time)
	    {
	    	flag_rx_time=0;
	    	keycode_buf=0xfd;
	    }
   	}
    //-----------------------------------------------------------------------
   	fCancel=0;
   	CntLcdOn=0;
   	if(keycode_buf==0xfd)												//刷卡器催钟或者是刷卡器报警
   	{
			  for(i=6;i<(comRxLength-1);i++)TRDataBuf[i-6]=comRxDataBuf[i];
				if((TRDataBuf[0]=='d')&&(TRDataBuf[1]='#'))
				{
					WorkLen=0;
					for(k=0;k<7;k++)
				  {
				  	WorkId[k]=TRDataBuf[2+k];
				  	if(WorkId[k]!='#')WorkLen++;
				  	else break;
				  }
				  for(j=0;j<DISP_BUF_MAX;j++)
					{
						disp_buf[j]=0;
					}
					for(j=0;j<20;j++)
				  {
				  	disp_buf[j]=Mesg00[j];
				  }
				  disp_buf[4]=':';
				  disp_buf[5]=' ';
				  for(j=0;j<WorkLen;j++)
				  {
				  	disp_buf[6+j]=WorkId[j];
				  }
				  LCD_disp_starting=0;
				  fLcdPwr=LCD_ON;
					CntLcdOn=0;
				  clrram();
				  chn_left_disp(disp_buf,0,20,LCD_disp_starting);
				  chn_disp(Mesg01,1);
				  LCD_disp_starting++;
				  LCD_disp_starting++;
				  LcdLeftCnt=LCD_LEFT_CNT;
					//第一次催钟
					player_stop=0;
				  while(player_busy()==1)
				  {
				  	if(LcdLeftCnt==0)
					  {
					  	chn_left_disp(disp_buf,0,20,LCD_disp_starting);
					  	LCD_disp_starting++;
					  	LCD_disp_starting++;
					  	if(LCD_disp_starting>=24)
					  		LCD_disp_starting=0;
					  	LcdLeftCnt=LCD_LEFT_CNT;
					  }
				  	WDT_CONTR=0x3d;  //喂狗 1.13s;
				  }
					player_Num(23);
					for(j=0;j<WorkLen;j++)
					{
						while(player_busy()==1)
						{
							if(LcdLeftCnt==0)
						  {
						  	chn_left_disp(disp_buf,0,20,LCD_disp_starting);
						  	LCD_disp_starting++;
						  	LCD_disp_starting++;
						  	if(LCD_disp_starting>=24)
						  		LCD_disp_starting=0;
						  	LcdLeftCnt=LCD_LEFT_CNT;
						  }
							WDT_CONTR=0x3d;  //喂狗 1.13s;
						}
						player_Num(WorkId[j]-48);
					}
					while(player_busy()==1)
					{
						if(LcdLeftCnt==0)
					  {
					  	chn_left_disp(disp_buf,0,20,LCD_disp_starting);
					  	LCD_disp_starting++;
					  	LCD_disp_starting++;
					  	if(LCD_disp_starting>=24)
					  		LCD_disp_starting=0;
					  	LcdLeftCnt=LCD_LEFT_CNT;
					  }
						WDT_CONTR=0x3d;  //喂狗 1.13s;
					}
					player_Num(43);
					delay1(4000);
					//第二次催钟
					player_stop=0;
				  while(player_busy()==1)
				  {
				  	if(LcdLeftCnt==0)
					  {
					  	chn_left_disp(disp_buf,0,20,LCD_disp_starting);
					  	LCD_disp_starting++;
					  	LCD_disp_starting++;
					  	if(LCD_disp_starting>=24)
					  		LCD_disp_starting=0;
					  	LcdLeftCnt=LCD_LEFT_CNT;
					  }
				  	WDT_CONTR=0x3d;  //喂狗 1.13s;
				  }
					player_Num(23);
					for(j=0;j<WorkLen;j++)
					{
						while(player_busy()==1)
						{
							if(LcdLeftCnt==0)
						  {
						  	chn_left_disp(disp_buf,0,20,LCD_disp_starting);
						  	LCD_disp_starting++;
						  	LCD_disp_starting++;
						  	if(LCD_disp_starting>=24)
						  		LCD_disp_starting=0;
						  	LcdLeftCnt=LCD_LEFT_CNT;
						  }
							WDT_CONTR=0x3d;  //喂狗 1.13s;
						}
						player_Num(WorkId[j]-48);
					}
					while(player_busy()==1)
					{
						if(LcdLeftCnt==0)
					  {
					  	chn_left_disp(disp_buf,0,20,LCD_disp_starting);
					  	LCD_disp_starting++;
					  	LCD_disp_starting++;
					  	if(LCD_disp_starting>=24)
					  		LCD_disp_starting=0;
					  	LcdLeftCnt=LCD_LEFT_CNT;
					  }
						WDT_CONTR=0x3d;  //喂狗 1.13s;
					}
					player_Num(43);
					
					k=0xff;
					LcdDisIniIn();
				}
				else
				{
					if((TRDataBuf[0]=='e')&&(TRDataBuf[1]='#')&&(TRDataBuf[2]='B')&&(TRDataBuf[3]='J')&&(TRDataBuf[4]='#'))
					{
						clrram();
				  	chn_disp(Menu79,0);
					  chn_disp(Menu80,1);
				  	player_stop=0;
					  while(player_busy()==1)WDT_CONTR=0x3d;  //喂狗 1.13s;
						player_Num(44);
						k=0xff;
						while(k==0xff)   //等待有按键
						{
							player_stop=0;
							while(player_busy()==1)WDT_CONTR=0x3d;  //喂狗 1.13s;
							player_Num(44);
							WDT_CONTR=0x3d;  //喂狗 1.13s;
							k=KeyRd();
							fLcdPwr=LCD_ON;
							CntLcdOn=0;
						}
						LcdDisIniIn();
					}
				}
   	}
    //-----------------------------------------------------------------------
    //****************************************************************************************//  
   	if(keycode_buf==0xfe)//设置房间号(最多支持四位),软件版本,无线频率，
   	{
				fLcdPwr=LCD_ON;
   		clrram();
   		chn_disp(Set000,0);
   		chn_disp(Null00,1);
				player_stop=0;
		  	while(player_busy()==1)WDT_CONTR=0x3d;  //喂狗 1.13s;
				player_Num(QAJ);
   		wr_lcd(comm,0x30);
   	  wr_lcd(comm,0x92);
   	  for(j=0;j<RoomLen;j++)
   	  {
   	  	wr_lcd(dat,RoomId[j]);
   	  }
   	  wr_lcd(comm,0x30);
   	  wr_lcd(comm,0x92);
   	  fFirstEnt=1;
   	  //wr_lcd(dat,i+0x30);
   	  i=0;
   		for(j=0;j<5;j++)
   		{
   			i=KeyRd();
   			while(i>0x0b)
   			{
   				i=KeyRd();
   				WDT_CONTR=0x3d;  //喂狗 1.13s;
   				if(j==4)
   				{
   					if((i!=0x0b)&&(i!=0x0a))
   						i=0xFF;
   				}
   			}
   			if(i==0x0a)       //*取消
   			{
   				fCancel=1;
   				break;
   			}
   			else if(i==0x0b&&j==0) //没输入数据直接按#也是取消
   			{
   				fCancel=1;
   				break;
   			}
   			else if(i==0x0b&&j>0)
   			{
   				clrram();
   				chn_disp(Set003,0);
   				chn_disp(Set004,1);
   				//选择软件版本
   			  player_Num(QXZ);
   		    CntOv1s=0;
   	      fOvTime=0;
   	      fCancel=0;
   	      i_buf=0;
   		    while((i_buf!=0x04)&&(i_buf!=0x05)&&(i_buf!=0x0a))
   	  	  {
   	  	  	WDT_CONTR=0x3d;  //喂狗 1.13s;
   	  	  	i_buf=KeyRd();
   	  	  }
   	  	  if((i_buf==0x04)||(i_buf==0x05))   //重新选择后把值赋给 fProSelect
   	  	  {
   	  	  	fProSelect=i_buf;
   	  	  }
   				fCancel=1;
   				clrram();
   				chn_disp(Set005,0);
   				chn_disp(Null00,1);
   				j_buf=MyChn/10+48;
   				k_buf=MyChn%10+48;
   				wr_lcd(comm,0x30);
   				wr_lcd(comm,0x86);
   				wr_lcd(dat,j_buf);
   				wr_lcd(dat,k_buf);
   				//chanel 选择
   				wr_lcd(comm,0x30);
   				wr_lcd(comm,0x93);
   				wr_lcd(dat,'-');
   				wr_lcd(dat,'-');
   				i_buf=0;
   				j_buf=0;
   				while((i_buf!=0x0a)&&(i_buf!=0x0b))
   				{
   					WDT_CONTR=0x3d;  //喂狗 1.13s;
   	  	  	i_buf=KeyRd();
   	  	  	if(i_buf<0x0a)
   	  	  	{
   	  	  		if(j_buf%2==0)
   	  	  		{
   	  	  			wr_lcd(comm,0x30);
   	  	  			wr_lcd(comm,0x93);
   	  	  			wr_lcd(dat,i_buf+48);
   	  	  			k_buf=i_buf;
   	  	  		}
   	  	  		else
   	  	  		{
   	  	  			wr_lcd(dat,i_buf+48);
   	  	  			l_buf=i_buf;
   	  	  		}
   	  	  		j_buf++;
   	  	  	}
   	  	  	//wr_lcd(dat,i_buf+48);
   				}
   				j_buf=k_buf*10+l_buf;
   				if((i_buf==0x0b)&&(j_buf<16))   //重新选择后把值赋给
   	  	  {
   	  	  	MyChn=j_buf;
   	  	  }
   	  	  else
   	  	  {
   	  	  	chn_disp(ErrM04,1);
   	  	  	delay1(2000);
   	  	  }
   				Sector_Erase(0);
   				RoomLen=0;
   				Byte_Program(ADDR_PROSEL,fProSelect);
   				Byte_Program(ADDR_CHNSEL,MyChn);
   				for(k=0;k<7;k++)
   				{
   					k16=k;
   					Byte_Program(k16,RoomId[k]);
   					if(RoomId[k]!='#')RoomLen++;
		          else break;
   				}
   				j=RoomLen;
	          i_16u=0;
	          for(i=0;i<j;i++)
	          {
	          	i_16u+=(RoomId[i]-48)*pow(10,j-i-1);
	          }
	          if(i_16u>9999)i_16u=9999;
	          MyAddres[0]=(INT8U)(i_16u&0x00ff);
	          i_16u>>=8;
	          MyAddres[1]=(INT8U)(i_16u&0x00ff);
   				break;
   			}
   			else
   			{
   				if(fFirstEnt==1)
   				{
   					for(k=0;k<4;k++)
   				  {
   				  	wr_lcd(dat,'-');
   				  }
   				  fFirstEnt=0;
   				  wr_lcd(comm,0x30);
   				  wr_lcd(comm,0x92);
   				}
   				RoomId[j]=i+48;
   				RoomId[j+1]='#';
   				wr_lcd(dat,RoomId[j]);
   				//if(j==5)
   				//{
   				//	j=4;
   					//wr_lcd(comm,0x99);
   				//}
   			}
   		}
   	}
   	if(fCancel==1)
   	{
				RoomLen=0;
				fProSelect=Byte_Read(ADDR_PROSEL);
	    	for(k=0;k<7;k++)
		    {
		     	k16=k;
		     	RoomId[k]=Byte_Read(k16);
		     	if(RoomId[k]!='#')RoomLen++;
		     	else break;
		     	if(RoomId[k]<48||RoomId[k]>57)RoomId[k]=48;
		    }
		    j=RoomLen;
	      i_16u=0;
	      for(i=0;i<j;i++)
	      {
	      	i_16u+=(RoomId[i]-48)*pow(10,j-i-1);
	      }
	      if(i_16u>9999)i_16u=9999;
	      MyAddres[0]=(INT8U)(i_16u&0x00ff);
	      i_16u>>=8;
	      MyAddres[1]=(INT8U)(i_16u&0x00ff);
				LcdDisDefMen();
				if(init_comp_flag==0)
				{
					chn_disp(Menu20,1);
				}
				else
				{
		    	chn_disp(Menu04,1);
				}
	    	
	    	continue;
   	}
    //-----------------------------------------------------------------------
   	fCancel=0;
   	CntLcdOn=0;
    //-----------------------------------------------------------------------
   	j=keycode_buf;
   	switch(j)
   	{
   	  case FUN1:              //功能1:技师刷卡起钟
   	  {
   		  clrram();
   		  KeyCLr();
   		  chn_disp(Menu05,0);
   		  chn_disp(Menu17,1);
				player_Num(12);
				player_Num(QSK);
   		  RFID_GetID();
   	    PinRfs=1;
   	    if((fOvTime==1)||(fCancel==1))break;
				player_Num(53);
   	    delay1(2000);
   	    TRDataBuf[0]='a';
   	    TRDataBuf[1]='#';
   	    IndexSend++;
   	    IndexSend%=10;
   	    TRDataBuf[2]=IndexSend+48;
   	    TRDataBuf[3]='#';
   	    for(i=0;i<10;i++)
   	    {
   	    	TRDataBuf[4+i]=idbuf[i];
   	    }
   	    TRDataBuf[14]='#';
   	    for(i=0;i<RoomLen;i++)
   	    {
   	    	TRDataBuf[15+i]=RoomId[i];
   	    }
   	    TRDataBuf[15+RoomLen]='#';
	      k=comTrCommand(TRDataBuf,15+RoomLen+1);  //发送指令
   	    if(k==COM_NO_ERR)  //成功接收数据
   	    {
   	    	for(i=6;i<(comRxLength-1);i++)TRDataBuf[i-6]=comRxDataBuf[i];
          TRDataBuf[comRxLength-7]=0;
   	    	if((TRDataBuf[0]=='a')&&(TRDataBuf[1]=='#')&&(TRDataBuf[2]==IndexSend+48)&&(TRDataBuf[3]=='#')&&(TRDataBuf[4]!='e'))
   	      {
   	      	WorkLen=0;
   	      	for(k=0;k<7;k++)
	            {
	            	WorkId[k]=48;
	            }
   	      	for(k=0;k<7;k++)
	            {
	            	WorkId[k]=TRDataBuf[4+k];
	            	if(WorkId[k]!='#')WorkLen++;
	            	else break;
	            }
	            CustLen=0;
	            for(k=0;k<7;k++)
	            {
	            	CustId[k]=TRDataBuf[5+WorkLen+k];
	            	if(CustId[k]!='#')CustLen++;
	            	else break;
	            }
					  	  clrram();
					  	  chn_disp(CorM00,0);
   		        chn_disp(CorM12,1);
   		        wr_lcd(comm,0x30);
   	          wr_lcd(comm,0x82);
   	          wr_lcd(dat,':');
   	          for(j=0;j<WorkLen;j++)
   	          {
   	          	wr_lcd(dat,WorkId[j]);
   	          }
					  		player_Num(12);
					  		player_Num(10);
   	          delay1(40000);
   	          delay1(40000);
   	      }
   	      else if((TRDataBuf[0]=='a')&&(TRDataBuf[1]=='#')&&(TRDataBuf[2]==IndexSend+48)&&(TRDataBuf[3]=='#')&&(TRDataBuf[4]=='e')&&(TRDataBuf[5]=='#'))
   	      {
   	      	chn_disp(ErrM03,1);
					  	player_Num(12);
					  	player_Num(11);
   	      	delay1(40000);
   	      }
   	      else
   	      {
   	      	chn_disp(ErrM12,1);
					  	player_Num(45);
   	      	delay1(40000);
   	      }
   	    }
   	    else
        {
         	staComRx=COM_RX_NONE;
         	player_Num(45);
         	if(k==COM_ERR_SER)  //服务器无响应
         	{
   	        chn_disp(ErrM11,1);
   	      	delay1(40000);
         	}
         	else if(k==COM_ERR_COR)   //协调器无响应
         	{
   	        chn_disp(ErrM10,1);
   	      	delay1(40000);
         	}
         	else;
        }
      }
      break;
      case FUN2:              //功能2:技师刷卡落钟
    	{
    	  clrram();
    	  KeyCLr();
    	  chn_disp(Menu06,0);
    	  chn_disp(Menu17,1);
				player_Num(13);
				player_Num(QSK);
    	  RFID_GetID();
    	  PinRfs=1;
    	  if((fOvTime==1)||(fCancel==1))break;
				player_Num(53);
    	  delay1(2000);
    	  TRDataBuf[0]='b';
    	  TRDataBuf[1]='#';
    	  IndexSend++;
    	  IndexSend%=10;
    	  TRDataBuf[2]=IndexSend+48;
    	  TRDataBuf[3]='#';
    	  for(i=0;i<10;i++)
    	  {
    	  	TRDataBuf[4+i]=idbuf[i];
    	  }
    	  TRDataBuf[14]='#';
    	  for(i=0;i<RoomLen;i++)
    	  {
    	  	TRDataBuf[15+i]=RoomId[i];
    	  }
    	  TRDataBuf[15+RoomLen]='#';
    	  //WIFISendData(TRDataBuf,15+RoomLen+1);
    	  k=comTrCommand(TRDataBuf,15+RoomLen+1);  //发送指令
   		  if(k==COM_NO_ERR)  //成功接收数据
   	    {
   	    	for(i=6;i<(comRxLength-1);i++)TRDataBuf[i-6]=comRxDataBuf[i];
          TRDataBuf[comRxLength-7]=0;
    	    if((TRDataBuf[0]=='b')&&(TRDataBuf[1]=='#')&&(TRDataBuf[2]==IndexSend+48)&&(TRDataBuf[3]=='#')&&(TRDataBuf[4]!='e'))
    	    {
    	    	WorkLen=0;
    	    	for(k=0;k<7;k++)
	          {
	          	WorkId[k]=48;
	          }
    	    	for(k=0;k<7;k++)
	          {
	          	WorkId[k]=TRDataBuf[4+k];
	          	if(WorkId[k]!='#')WorkLen++;
	          	else break;
	          }
	          CustLen=0;
	          for(k=0;k<7;k++)
	          {
	          	CustId[k]=TRDataBuf[5+WorkLen+k];
	          	if(CustId[k]!='#')CustLen++;
	          	else break;
	          }
	          //if((TRDataBuf[5+WorkLen+CustLen]=='#')&&(WorkLen+CustLen+6==TRDataLen))
	          {
	          	chn_disp(CorM00,0);
    	        chn_disp(CorM13,1);
    	        wr_lcd(comm,0x30);
    	        wr_lcd(comm,0x82);
    	        wr_lcd(dat,':');
    	        for(j=0;j<WorkLen;j++)
    	        {
    	        	wr_lcd(dat,WorkId[j]);
    	        }
			  			player_Num(13);
			  			player_Num(10);
    	        delay1(40000);
    	        delay1(40000);
	          }
    	    }
    	    else if((TRDataBuf[0]=='b')&&(TRDataBuf[1]=='#')&&(TRDataBuf[2]==IndexSend+48)&&(TRDataBuf[3]=='#')&&(TRDataBuf[4]=='e')&&(TRDataBuf[5]=='#'))
    	    {
    	    	chn_disp(ErrM03,1);
			  		player_Num(13);
			  		player_Num(11);
    	    	delay1(40000);
    	    }
    	    else
    	    {
    	    	chn_disp(ErrM12,1);
			  		player_Num(45);

    	    	delay1(40000);
    	    }
    	  }
    	  else
        {
         	staComRx=COM_RX_NONE;
         	player_Num(45);
         	if(k==COM_ERR_SER)  //服务器无响应
         	{
   	        chn_disp(ErrM11,1);
   	      	delay1(40000);
         	}
         	else if(k==COM_ERR_COR)   //协调器无响应
         	{
   	        chn_disp(ErrM10,1);
   	      	delay1(40000);
         	}
         	else;
        }
    	}
    	break;
    	case FUN3:              //功能3:房间加钟
    	{
    	  clrram();
    	  KeyCLr();
    	  chn_disp(Menu10,0);
    	  chn_disp(Menu17,1);
				player_Num(14);
				player_Num(QSK);
				RFID_GetID();
        PinRfs=1;
        if((fOvTime==1)||(fCancel==1))break;
				player_Num(53);
        delay1(2000);
        TRDataBuf[0]='c';
        TRDataBuf[1]='#';
        IndexSend++;
        IndexSend%=10;
        TRDataBuf[2]=IndexSend+48;
        TRDataBuf[3]='#';
        for(i=0;i<10;i++)
        {
        	TRDataBuf[4+i]=idbuf[i];
        }
        TRDataBuf[14]='#';
        //-----------------------------------------
				fOvTime=0;
				fCancel=0;
				if(fProSelect==0x04)
				{
					clrram();
    	    chn_disp(Menu10,0);
    	    chn_disp(Menu18,1);
				  player_Num(QSK);
          for(i=0;i<3;i++)
          {
          	delay1(10000);
          	RFID_GetID();
            if((fOvTime==1)||(fCancel==1))break;
            k=0;
            for(j=0;j<10;j++)
            {
            	if(idbuf[j]!=TRDataBuf[4+j])
            	{
            		k++;
            	}
            }
            PinRfs=1;
            if(k>0)
            {
            	fOvTime=0;
				  		player_Num(53);
            	break;
            }
            fOvTime=1;
				  	player_Num(53);
				  	player_Num(53);
				  	player_Num(53);
				  	player_Num(53);
          }
          PinRfs=1;
        }
        if((fOvTime==1)||(fCancel==1))break;
        for(i=0;i<10;i++)
        {
        	TRDataBuf[15+i]=idbuf[i];
        }
    		//------------------------------------------
    	  clrram();
    	  chn_disp(Menu07,0);
    	  chn_disp(Menu16,1);
    	  img_disp(BmpNum,0,0x84);
    	  AddTime[0]=48;
    	  AddTime[1]=48;
    	  wr_lcd(comm,0x30);
      	wr_lcd(comm,0x92);
      	wr_lcd(dat,':');
      	wr_lcd(dat,'0');
      	wr_lcd(dat,'.');
      	wr_lcd(dat,'0');
				player_Num(QAJ);
    	  CntOv1s=0;
        fOvTime=0;
        fCancel=0;
        i=0;
        fFirstEnt=1;
      	for(j=0;j<3;j++)
      	{
      		fOvTime=0;
      		i=KeyRd();
      		while(i>0x0b)
      		{
      			WDT_CONTR=0x3d;  //喂狗 1.13s;
      			i=KeyRd();
      			if(j==2)
	  				{
	  					if((i!=0x0b)&&(i!=0x0a))
	  						i=0xFF;
	  				}
    	  	  if(CntOv1s<=KEY_OVERTIME)
    		    {
    		    	Lcd_overtime(KEY_OVERTIME-CntOv1s,0);
    		    }
    		    else
    		    {
    		    	fOvTime=1;
							player_Num(54);

    		    	break;
    		    }
      		}
      		CntOv1s=0;
      		if(i==0x0a||fOvTime==1)       //*取消
      		{
      			fCancel=1;
      			break;
      		}
      		else if(i==0x0b&&j==0) //没输入数据直接按#也是取消
      		{
      			fCancel=1;
      			break;
      		}
      		else if(i==0x0b&&j>0)
      		{
      			fCancel=0;
      			break;
      		}
      		else
      		{
      			AddTime[j]=i+48;
      			wr_lcd(comm,0x30);
      			wr_lcd(comm,0x92);
      			wr_lcd(dat,':');
      			wr_lcd(dat,AddTime[0]);
      			wr_lcd(dat,'.');
      			wr_lcd(dat,AddTime[1]);
      			//if(j==1)
      			//{
      			//	j=0;
      			//}
      		}
      	}
        if(fCancel==1)
        {
        	LcdDisIniIn();
        	break;
        }
        TRDataBuf[25]='#';
        TRDataBuf[26]=AddTime[0];
        TRDataBuf[27]='.';
        TRDataBuf[28]=AddTime[1];
        TRDataBuf[29]='#';
        for(i=0;i<RoomLen;i++)
        {
        	TRDataBuf[30+i]=RoomId[i];
        }
        TRDataBuf[30+RoomLen]='#';
   	    //WIFISendData(TRDataBuf,30+RoomLen+1);
   	    k=comTrCommand(TRDataBuf,30+RoomLen+1);  //发送指令
   	    if(k==COM_NO_ERR)  //成功接收数据
   	    {
   	    	for(i=6;i<(comRxLength-1);i++)TRDataBuf[i-6]=comRxDataBuf[i];
          TRDataBuf[comRxLength-7]=0;
   	    	if((TRDataBuf[0]=='c')&&(TRDataBuf[1]=='#')&&(TRDataBuf[2]==IndexSend+48)&&(TRDataBuf[3]=='#')&&(TRDataBuf[4]!='e')&&(TRDataBuf[4]!='x'))
          {
          	WorkLen=0;
          	for(k=0;k<7;k++)
	          {
	          	WorkId[k]=48;
	          }
          	for(k=0;k<7;k++)
	          {
	          	WorkId[k]=TRDataBuf[4+k];
	          	if(WorkId[k]!='#')WorkLen++;
	          	else break;
	          }
	          CustLen=0;
	          for(k=0;k<7;k++)
	          {
	          	CustId[k]=TRDataBuf[5+WorkLen+k];
	          	if(CustId[k]!='#')CustLen++;
	          	else break;
	          }
	          //if((TRDataBuf[5+WorkLen+CustLen]=='#')&&(WorkLen+CustLen+6==TRDataLen))
	          {
	          	for(j=0;j<DISP_BUF_MAX;j++)
				  		{
				  			disp_buf[j]=0;
				  		}
				  		for(j=0;j<24;j++)
				      {
				      	if(fProSelect==0x04)
				      	{
				      		disp_buf[j]=CorM054[j];
				      	}
				      	else 
				      	{
				      		disp_buf[j]=CorM055[j];
				      	}
				      }
	          	
	          	disp_buf[4]=':';
	          	disp_buf[5]=' ';
              for(j=0;j<WorkLen;j++)
              {
              	disp_buf[6+j]=WorkId[j];
              }
              disp_buf[16]=':';
	          	disp_buf[17]=' ';
              for(j=0;j<CustLen;j++)
              {
              	disp_buf[18+j]=CustId[j];
              }
				  		LCD_disp_starting=0;
				  		LcddispCnt=0;
              clrram();
              chn_left_disp(disp_buf,0,24,LCD_disp_starting);
	          	chn_disp(CorM04,1);
	          	LCD_disp_starting++;
	          	LCD_disp_starting++;
	          	LcddispCnt++;
	          	LcdLeftCnt=LCD_LEFT_CNT;
				  		player_stop=0;
              while(player_busy()==1)
              {
              	if(LcdLeftCnt==0)
				  		  {
				  		  	chn_left_disp(disp_buf,0,24,LCD_disp_starting);
				  		  	LCD_disp_starting++;
				  		  	LCD_disp_starting++;
				  		  	LcddispCnt++;
				  		  	if(LCD_disp_starting>=28)
				  		  		LCD_disp_starting=0;
				  		  	LcdLeftCnt=LCD_LEFT_CNT;
				  		  }
              	WDT_CONTR=0x3d;  //喂狗 1.13s;
              }
				  		player_Num(14);
				  		while(player_busy()==1)
				  		{
				  			if(LcdLeftCnt==0)
				  		  {
				  		  	chn_left_disp(disp_buf,0,24,LCD_disp_starting);
				  		  	LCD_disp_starting++;
				  		  	LCD_disp_starting++;
				  		  	LcddispCnt++;
				  		  	if(LCD_disp_starting>=28)
				  		  		LCD_disp_starting=0;
				  		  	LcdLeftCnt=LCD_LEFT_CNT;
				  		  }
				  			WDT_CONTR=0x3d;  //喂狗 1.13s;
				  		}
				  		player_Num(10);
              k=0xff;
			      	while((k==0xff)&&(LcddispCnt<21))   //等待有按键
			      	{
			      		WDT_CONTR=0x3d;  //喂狗 1.13s;
			      		if(LcdLeftCnt==0)
				  			{
				  				chn_left_disp(disp_buf,0,24,LCD_disp_starting);
				  				LCD_disp_starting++;
				  				LCD_disp_starting++;
				  				LcddispCnt++;
				  				if(LCD_disp_starting>=28)
				  					LCD_disp_starting=0;
				  				LcdLeftCnt=LCD_LEFT_CNT;
				  			}
			      		k=KeyRd();
			      		fLcdPwr=LCD_ON;
			      		CntLcdOn=0;
			      	}
			      	delay1(10000);
	          }
          }
          else if((TRDataBuf[0]=='c')&&(TRDataBuf[1]=='#')&&(TRDataBuf[2]==IndexSend+48)&&(TRDataBuf[3]=='#')&&(TRDataBuf[4]=='x')&&(TRDataBuf[5]=='#'))
          {
          	//此时，技师被预约
          	for(j=0;j<DISP_BUF_MAX;j++)
				  	{
				  		disp_buf[j]=0;
				  	}
				  	for(j=0;j<26;j++)
				    {
				    	disp_buf[j]=Menu25[j];
				    }
				  	LCD_disp_starting=0;
          	clrram();
	  		    chn_disp(Menu00,0);
	  		    chn_left_disp(disp_buf,1,26,LCD_disp_starting);
	  		    LCD_disp_starting++;
	          LCD_disp_starting++;
	          LcdLeftCnt=LCD_LEFT_CNT;
				  	player_stop=0;
	  		    while(player_busy()==1)
	  		    {
	  		    	if(LcdLeftCnt==0)
				  		{
				  			chn_left_disp(disp_buf,1,26,LCD_disp_starting);
				  			LCD_disp_starting++;
				  			LCD_disp_starting++;
				  			if(LCD_disp_starting>=30)
				  				LCD_disp_starting=0;
				  			LcdLeftCnt=LCD_LEFT_CNT;
				  		}
	  		    	WDT_CONTR=0x3d;  //喂狗 1.13s;
	  		    }
				  	player_Num(15);
				  	while(player_busy()==1)
				  	{
				  		if(LcdLeftCnt==0)
				  		{
				  			chn_left_disp(disp_buf,1,26,LCD_disp_starting);
				  			LCD_disp_starting++;
				  			LCD_disp_starting++;
				  			if(LCD_disp_starting>=30)
				  				LCD_disp_starting=0;
				  			LcdLeftCnt=LCD_LEFT_CNT;
				  		}
				  		WDT_CONTR=0x3d;  //喂狗 1.13s;
				  	}
				  	player_Num(QQR);
	  		    CntOv1s=0;
            fOvTime=0;
	  		    i=KeyRd();
	  		  	while((i!=0x0b)&&(i!=0x0a))
	  		  	{
	  		  		i=KeyRd();
	  		  		WDT_CONTR=0x3d;  //喂狗 1.13s;
	  		  		if(CntOv1s<=ID_OVERTIME)                   
	  		  	  {
	  		  	  	if(LcdLeftCnt==0)
				  			{
				  				chn_left_disp(disp_buf,1,26,LCD_disp_starting);
				  				LCD_disp_starting++;
				  				LCD_disp_starting++;
				  				if(LCD_disp_starting>=30)
				  					LCD_disp_starting=0;
				  				LcdLeftCnt=LCD_LEFT_CNT;
				  			}                                          
	  		  	  	Lcd_overtime(ID_OVERTIME-CntOv1s,0);       
	  		  	  }                                          
	  		  	  else                                       
	  		  	  {                                          
		  	  		  fOvTime=1;
				  			player_Num(54);
		  	  		  break;              										                       
	  		  	  }   
	  		  	}
	  		  	if(fOvTime==1)break;
	  		  	if(i==0x0b)			//确认键被按下
	  		  	{
	  		  		TRDataBuf[0]='c';
		  	      TRDataBuf[1]='#';
		  	      TRDataBuf[2]=IndexSend+48;
		  	      TRDataBuf[3]='#';
		  	      TRDataBuf[4]='c';
		  	      TRDataBuf[5]='#';
		  	      //WIFISendData(TRDataBuf,6);
		 		      k=0;
		 		      fOvTime=0;
		 		      fCancel=0;
				  		clrram();
          		chn_disp(Null00,0);
          		k=comTrCommand(TRDataBuf,6);  //发送指令
		 		      if(k==COM_NO_ERR)  //成功接收数据
		 		      {
		 		      	for(i=6;i<(comRxLength-1);i++)TRDataBuf[i-6]=comRxDataBuf[i];
		 		      	TRDataBuf[comRxLength-7]=0;
		 		      	if((TRDataBuf[0]=='c')&&(TRDataBuf[1]=='#')&&(TRDataBuf[2]==IndexSend+48)&&(TRDataBuf[3]=='#')&&(TRDataBuf[4]!='e'))
		  	        {
		  	        	WorkLen=0;
		  	        	for(k=0;k<7;k++)
		              {
		              	WorkId[k]=48;
		              }
		  	        	for(k=0;k<7;k++)
		              {
		              	WorkId[k]=TRDataBuf[4+k];
		              	if(WorkId[k]!='#')WorkLen++;
		              	else break;
		              }
		              CustLen=0;
		              for(k=0;k<7;k++)
		              {
		              	CustId[k]=TRDataBuf[5+WorkLen+k];
		              	if(CustId[k]!='#')CustLen++;
		              	else break;
		              }
		              //if((TRDataBuf[5+WorkLen+CustLen]=='#')&&(WorkLen+CustLen+6==TRDataLen))
		              {
		              	for(j=0;j<DISP_BUF_MAX;j++)
				  		  		{
				  		  			disp_buf[j]=0;
				  		  		}
				  		  		for(j=0;j<24;j++)
				  		      {
				  		      	if(fProSelect==0x04)
				        	    {
				        	    	disp_buf[j]=CorM054[j];
				        	    }
				        	    else 
				        	    {
				        	    	disp_buf[j]=CorM055[j];
				        	    }
				  		      }
		              	disp_buf[4]=':';
		              	disp_buf[5]=' ';
		  	            for(j=0;j<WorkLen;j++)
		  	            {
		  	            	disp_buf[6+j]=WorkId[j];
		  	            }
		  	            disp_buf[16]=':';
		              	disp_buf[17]=' ';
		  	            for(j=0;j<CustLen;j++)
		  	            {
		  	            	disp_buf[18+j]=CustId[j];
		  	            }
				  		  		LCD_disp_starting=0;
				  		  		LcddispCnt=0;
				  		  		clrram();
		  	            chn_left_disp(disp_buf,0,24,LCD_disp_starting);
		              	chn_disp(CorM04,1);
		              	LCD_disp_starting++;
		              	LCD_disp_starting++;
		              	LcddispCnt++;
		              	LcdLeftCnt=LCD_LEFT_CNT;
				  		  		player_stop=0;
		  	            while(player_busy()==1)
		  	            {
		  	            	if(LcdLeftCnt==0)
				  		  		  {
				  		  		  	chn_left_disp(disp_buf,0,24,LCD_disp_starting);
				  		  		  	LCD_disp_starting++;
				  		  		  	LCD_disp_starting++;
				  		  		  	LcddispCnt++;
				  		  		  	if(LCD_disp_starting>=28)
				  		  		  		LCD_disp_starting=0;
				  		  		  	LcdLeftCnt=LCD_LEFT_CNT;
				  		  		  }
		  	            	WDT_CONTR=0x3d;  //喂狗 1.13s;
		  	            }
				  		  		player_Num(14);
				  		  		while(player_busy()==1)
				  		  		{
				  		  			if(LcdLeftCnt==0)
				  		  		  {
				  		  		  	chn_left_disp(disp_buf,0,24,LCD_disp_starting);
				  		  		  	LCD_disp_starting++;
				  		  		  	LCD_disp_starting++;
				  		  		  	LcddispCnt++;
				  		  		  	if(LCD_disp_starting>=28)
				  		  		  		LCD_disp_starting=0;
				  		  		  	LcdLeftCnt=LCD_LEFT_CNT;
				  		  		  }
				  		  			WDT_CONTR=0x3d;  //喂狗 1.13s;
				  		  		}
				  		  		player_Num(10);
		  	            k=0xff;
				  	      	while((k==0xff)&&(LcddispCnt<21))   //等待有按键
				  	      	{
				  	      		WDT_CONTR=0x3d;  //喂狗 1.13s;
				  	      		if(LcdLeftCnt==0)
				  		  			{
				  		  				chn_left_disp(disp_buf,0,24,LCD_disp_starting);
				  		  				LCD_disp_starting++;
				  		  				LCD_disp_starting++;
				  		  				LcddispCnt++;
				  		  				if(LCD_disp_starting>=28)
				  		  					LCD_disp_starting=0;
				  		  				LcdLeftCnt=LCD_LEFT_CNT;
				  		  			}
				  	      		k=KeyRd();
				  	      		fLcdPwr=LCD_ON;
				  	      		CntLcdOn=0;
				  	      	}
				  	      	delay1(10000);
		              }
		  	        }
		  	        else if((TRDataBuf[0]=='c')&&(TRDataBuf[1]=='#')&&(TRDataBuf[2]==IndexSend+48)&&(TRDataBuf[3]=='#')&&(TRDataBuf[4]=='e')&&(TRDataBuf[5]=='#'))
		  	        {
		  	        	chn_disp(ErrM03,1);
				  		  	player_Num(14);
				  		  	player_Num(11);
		  	        	delay1(40000);
		  	        }
		  	        else
		  	        {
		  	        	chn_disp(ErrM12,1);
				  		  	player_Num(45);
		  	        	delay1(40000);
		  	        }
		  	      }
		  	      else
              {
               	staComRx=COM_RX_NONE;
               	player_Num(45);
               	if(k==COM_ERR_SER)  //服务器无响应
               	{
   	              chn_disp(ErrM11,1);
   	            	delay1(40000);
               	}
               	else if(k==COM_ERR_COR)   //协调器无响应
               	{
   	              chn_disp(ErrM10,1);
   	            	delay1(40000);
               	}
               	else;
              }
	  		  	}                                      
          }
          else if((TRDataBuf[0]=='c')&&(TRDataBuf[1]=='#')&&(TRDataBuf[2]==IndexSend+48)&&(TRDataBuf[3]=='#')&&(TRDataBuf[4]=='e')&&(TRDataBuf[5]=='#'))
          {
          	chn_disp(ErrM03,1);
				  	player_Num(14);
				  	player_Num(11);
          	delay1(40000);
          }
          else
          {
          	chn_disp(ErrM12,1);
				  	player_Num(45);
          	delay1(40000);
          }
        }
        else
        {
         	staComRx=COM_RX_NONE;
         	player_Num(45);
         	if(k==COM_ERR_SER)  //服务器无响应
         	{
   	        chn_disp(ErrM11,1);
   	      	delay1(40000);
         	}
         	else if(k==COM_ERR_COR)   //协调器无响应
         	{
   	        chn_disp(ErrM10,1);
   	      	delay1(40000);
         	}
         	else;
        }
        
      }
      break;
      case FUN4:              //功能4:房间下单
    	{
    	  clrram();
    	  KeyCLr();
    	  chn_disp(Menu11,0);
    	  chn_disp(Menu17,1);
				player_Num(16);
				player_Num(QSK);
    	  RFID_GetID();
        PinRfs=1;
        if((fOvTime==1)||(fCancel==1))break;
				player_Num(53);
        delay1(2000);
        TRDataBuf[0]='3';
        TRDataBuf[1]='#';
        IndexSend++;
        IndexSend%=10;
        TRDataBuf[2]=IndexSend+48;
        TRDataBuf[3]='#';
        for(i=0;i<10;i++)
        {
        	TRDataBuf[4+i]=idbuf[i];
        }
        TRDataBuf[14]='#';
        //-----------------------------------------
        fOvTime=0;
				fCancel=0;
				if(fProSelect==0x04)
				{
          clrram();
    	    chn_disp(Menu11,0);
    	    chn_disp(Menu18,1);
			  	player_Num(QSK);
          for(i=0;i<3;i++)
          {
          	delay1(10000);
          	RFID_GetID();
            if((fOvTime==1)||(fCancel==1))break;
            k=0;
            for(j=0;j<10;j++)
            {
            	if(idbuf[j]!=TRDataBuf[4+j])
            	{
            		k++;
            	}
            }
            PinRfs=1;
            if(k>0)
            {
            	fOvTime=0;
			  			player_Num(53);
            	break;
            }
            fOvTime=1;
			  		player_Num(53);
			  		player_Num(53);
			  		player_Num(53);
			  		player_Num(53);
          }
          PinRfs=1;
        }
        if((fOvTime==1)||(fCancel==1))break;
        for(i=0;i<10;i++)
        {
        	TRDataBuf[15+i]=idbuf[i];
        }
        TRDataBuf[25]='#';
        //------------------------------------------
    	  clrram();
    	  chn_disp(Menu08,0);
    	  chn_disp(Null00,1);
    	  wr_lcd(comm,0x30);
      	wr_lcd(comm,0x92);
      	for(k=0;k<6;k++)
      	{
      		wr_lcd(dat,'-');
      	}
				player_Num(QAJ);
    	  CntOv1s=0;
        fOvTime=0;
        fCancel=0;
        i=0;
        fFirstEnt=1;
      	for(j=0;j<7;j++)
      	{
      		fOvTime=0;
      		i=KeyRd();
      		while(i>0x0b)
      		{
      			WDT_CONTR=0x3d;  //喂狗 1.13s;
      			i=KeyRd();
      			if(j==6)
	  				{
	  					if((i!=0x0b)&&(i!=0x0a))
	  						i=0xFF;
	  				}
    	  	  if(CntOv1s<=KEY_OVERTIME)
    		    {
    		    	Lcd_overtime(KEY_OVERTIME-CntOv1s,0);
    		    }
    		    else
    		    {
    		    	fOvTime=1;
							player_Num(54);

    		    	break;
    		    }
      		}
      		CntOv1s=0;
          //fOvTime=0;
      		if(i==0x0a||fOvTime==1)       //*取消
      		{
      			fCancel=1;
      			break;
      		}
      		else if(i==0x0b&&j==0) //没输入数据直接按#也是取消
      		{
      			fCancel=1;
      			break;
      		}
      		else if(i==0x0b&&j>0)
      		{
      			fCancel=0;
      			CostLen=0;
      			for(k=0;k<7;k++)
      			{
      				if(CostId[k]!='#')CostLen++;
		          else break;
      			}
      			break;
      		}
      		else
      		{
      			if(fFirstEnt==1)
      			{
      				wr_lcd(comm,0x30);
      			  wr_lcd(comm,0x92);
      				for(k=0;k<6;k++)
      			  {
      			  	wr_lcd(dat,'-');
      			  }
      			  fFirstEnt=0;
      			  wr_lcd(comm,0x30);
      			  wr_lcd(comm,0x92);
      			}
      			CostId[j]=i+48;
      			CostId[j+1]='#';
      			wr_lcd(comm,0x30);
      			wr_lcd(comm,0x92);
      			for(k=0;k<=j;k++)
      			{
      				wr_lcd(dat,CostId[k]);
      			}
      			//if(j==5)
      			//{
      			//	j=4;
      			//}
      		}
      	}
        if(fCancel==1)
        {
        	LcdDisIniIn();
        	break;
        }
    	  //------------------------------------------输入消费数量
    	  clrram();
    	  chn_disp(Menu09,0);
    	  chn_disp(Null00,1);
		  	img_disp(BmpNum,0,0x84);
    	  wr_lcd(comm,0x30);
      	wr_lcd(comm,0x93);
      	wr_lcd(dat,'0');
      	wr_lcd(dat,'.');
      	wr_lcd(dat,'0');
				player_Num(QAJ);
    	  CntOv1s=0;
        fOvTime=0;
        fCancel=0;
        CostNum[0]=48;
        CostNum[1]=48;
        i=0;
        fFirstEnt=1;
      	for(j=0;j<3;j++)
      	{
      		fOvTime=0;
      		i=KeyRd();
      		while(i>0x0b)
      		{
      			WDT_CONTR=0x3d;  //喂狗 1.13s;
      			i=KeyRd();
      			if(j==2)
	  				{
	  					if((i!=0x0b)&&(i!=0x0a))
	  						i=0xFF;
	  				}
    	  	  if(CntOv1s<=KEY_OVERTIME)
    		    {
    		    	Lcd_overtime(KEY_OVERTIME-CntOv1s,0);
    		    }
    		    else
    		    {
    		    	fOvTime=1;
							player_Num(54);

    		    	break;
    		    }
      		}
      		CntOv1s=0;
          //fOvTime=0;
      		if(i==0x0a||fOvTime==1)       //*取消
      		{
      			fCancel=1;
      			break;
      		}
      		else if(i==0x0b&&j==0) //没输入数据直接按#也是取消
      		{
      			fCancel=1;
      			break;
      		}
      		else if(i==0x0b&&j>0)
      		{
      			fCancel=0;
      			break;
      		}
      		else
      		{
      			CostNum[j]=i+48;
      			wr_lcd(comm,0x30);
      			wr_lcd(comm,0x93);
      			wr_lcd(dat,CostNum[0]);
      			wr_lcd(dat,'.');
      			wr_lcd(dat,CostNum[1]);
      			//if(j==1)
      			//{
      			//	j=0;
      			//}
      		}
      	}
        if(fCancel==1)
        {
        	LcdDisIniIn();
        	break;
        }
        for(i=0;i<CostLen;i++)
        {
        	TRDataBuf[26+i]=CostId[i];
        }
        TRDataBuf[26+CostLen]='#';
        TRDataBuf[27+CostLen]=CostNum[0];
        TRDataBuf[28+CostLen]='.';
        TRDataBuf[29+CostLen]=CostNum[1];
        TRDataBuf[30+CostLen]='#';
        for(i=0;i<RoomLen;i++)
        {
        	TRDataBuf[31+CostLen+i]=RoomId[i];
        }
        TRDataBuf[31+RoomLen+CostLen]='#';
	      //WIFISendData(TRDataBuf,32+RoomLen+CostLen);
   	    k=0;
   	    fOvTime=0;
   	    fCancel=0;
   	    clrram();
    	  chn_disp(Menu11,0);
    	  k=comTrCommand(TRDataBuf,32+RoomLen+CostLen);  //发送指令
   	    if(k==COM_NO_ERR)  //成功接收数据
   	    {
   	    	for(i=6;i<(comRxLength-1);i++)TRDataBuf[i-6]=comRxDataBuf[i];
          TRDataBuf[comRxLength-7]=0;
          if((TRDataBuf[0]=='3')&&(TRDataBuf[1]=='#')&&(TRDataBuf[2]==IndexSend+48)&&(TRDataBuf[3]=='#')&&(TRDataBuf[4]!='e'))
          {
          	WorkLen=0;
          	for(k=0;k<7;k++)
	          {
	          	WorkId[k]=48;
	          }
          	for(k=0;k<7;k++)
	          {
	          	WorkId[k]=TRDataBuf[4+k];
	          	if(WorkId[k]!='#')WorkLen++;
	          	else break;
	          }
	          CustLen=0;
	          for(k=0;k<7;k++)
	          {
	          	CustId[k]=TRDataBuf[5+WorkLen+k];
	          	if(CustId[k]!='#')CustLen++;
	          	else break;
	          }
	          //if((TRDataBuf[5+WorkLen+CustLen]=='#')&&(WorkLen+CustLen+6==TRDataLen))
	          {
	          	for(j=0;j<DISP_BUF_MAX;j++)
				  		{
				  			disp_buf[j]=0;
				  		}
				  		for(j=0;j<24;j++)
				      {
				      	if(fProSelect==0x04)
				      	{
				      		disp_buf[j]=CorM054[j];
				      	}
				      	else 
				      	{
				      		disp_buf[j]=CorM055[j];
				      	}
				      }
	          	
	          	disp_buf[4]=':';
	          	disp_buf[5]=' ';
              for(j=0;j<WorkLen;j++)
              {
              	disp_buf[6+j]=WorkId[j];
              }
              disp_buf[16]=':';
	          	disp_buf[17]=' ';
              for(j=0;j<CustLen;j++)
              {
              	disp_buf[18+j]=CustId[j];
              }
				  		LCD_disp_starting=0;
				  		LcddispCnt=0;
              clrram();
              chn_left_disp(disp_buf,0,24,LCD_disp_starting);
	          	chn_disp(CorM10,1);
	          	LCD_disp_starting++;
	          	LCD_disp_starting++;
	          	LcddispCnt++;
	          	LcdLeftCnt=LCD_LEFT_CNT;
				  		player_stop=0;
				  		while(player_busy()==1)
              {
              	if(LcdLeftCnt==0)
				  		  {
				  		  	chn_left_disp(disp_buf,0,24,LCD_disp_starting);
				  		  	LCD_disp_starting++;
				  		  	LCD_disp_starting++;
				  		  	LcddispCnt++;
				  		  	if(LCD_disp_starting>=28)
				  		  		LCD_disp_starting=0;
				  		  	LcdLeftCnt=LCD_LEFT_CNT;
				  		  }
              	WDT_CONTR=0x3d;  //喂狗 1.13s;
              }
				  		player_Num(16);
				  		while(player_busy()==1)
				  		{
				  			if(LcdLeftCnt==0)
				  		  {
				  		  	chn_left_disp(disp_buf,0,24,LCD_disp_starting);
				  		  	LCD_disp_starting++;
				  		  	LCD_disp_starting++;
				  		  	LcddispCnt++;
				  		  	if(LCD_disp_starting>=28)
				  		  		LCD_disp_starting=0;
				  		  	LcdLeftCnt=LCD_LEFT_CNT;
				  		  }
				  			WDT_CONTR=0x3d;  //喂狗 1.13s;
				  		}
				  		player_Num(10);
				  		k=0xff;
			      	while((k==0xff)&&(LcddispCnt<21))   //等待有按键
			      	{
			      		WDT_CONTR=0x3d;  //喂狗 1.13s;
			      		if(LcdLeftCnt==0)
				  			{
				  				chn_left_disp(disp_buf,0,24,LCD_disp_starting);
				  				LCD_disp_starting++;
				  				LCD_disp_starting++;
				  				LcddispCnt++;
				  				if(LCD_disp_starting>=28)
				  					LCD_disp_starting=0;
				  				LcdLeftCnt=LCD_LEFT_CNT;
				  			}
			      		k=KeyRd();
			      		fLcdPwr=LCD_ON;
			      		CntLcdOn=0;
			      	}
			      	delay1(10000);
	          }
          }
          else if((TRDataBuf[0]=='3')&&(TRDataBuf[1]=='#')&&(TRDataBuf[2]==IndexSend+48)&&(TRDataBuf[3]=='#')&&(TRDataBuf[4]=='e')&&(TRDataBuf[5]=='#'))
          {
          	chn_disp(ErrM03,1);
				  	player_Num(16);
				  	player_Num(11);
          	delay1(40000);
          }
          else
          {
          	chn_disp(ErrM12,1);
				  	player_Num(45);
          	delay1(40000);
          }
        }
        else
        {
         	staComRx=COM_RX_NONE;
         	player_Num(45);
         	if(k==COM_ERR_SER)  //服务器无响应
         	{
   	        chn_disp(ErrM11,1);
   	      	delay1(40000);
         	}
         	else if(k==COM_ERR_COR)   //协调器无响应
         	{
   	        chn_disp(ErrM10,1);
   	      	delay1(40000);
         	}
         	else;
        }
      }
      break;
      case FUN5:              //功能5:开房
    	{
    	  clrram();
    	  KeyCLr();
    	  chn_disp(Menu26,0);
    	  chn_disp(Menu36,1);
				player_Num(18);
				player_Num(QSK);
    	  RFID_GetID();
        PinRfs=1;
        if((fOvTime==1)||(fCancel==1))break;
				player_Num(53);
        delay1(2000);
        TRDataBuf[0]='4';
        TRDataBuf[1]='#';
        IndexSend++;
        IndexSend%=10;
        TRDataBuf[2]=IndexSend+48;
        TRDataBuf[3]='#';
        for(i=0;i<10;i++)
        {
        	TRDataBuf[4+i]=idbuf[i];
        }
        TRDataBuf[14]='#';
        //-----------------------------------------
        fOvTime=0;
				fCancel=0;
				if(fProSelect==0x04)
				{
					chn_disp(Menu26,0);
    	    chn_disp(Menu18,1);
				  player_Num(QSK);
          for(i=0;i<3;i++)
          {
          	delay1(10000);
          	RFID_GetID();
            if((fOvTime==1)||(fCancel==1))break;
            k=0;
            for(j=0;j<10;j++)
            {
            	if(idbuf[j]!=TRDataBuf[4+j])
            	{
            		k++;
            	}
            }
            PinRfs=1;
            if(k>0)
            {
            	fOvTime=0;
				  		player_Num(53);
            	break;
            }
            fOvTime=1;
				  	player_Num(53);
				  	player_Num(53);
				  	player_Num(53);
				  	player_Num(53);
          }
          PinRfs=1;
        }
        if((fOvTime==1)||(fCancel==1))break;
        for(i=0;i<10;i++)
        {
        	TRDataBuf[15+i]=idbuf[i];
        }
        TRDataBuf[25]='#';
        for(i=0;i<RoomLen;i++)
        {
        	TRDataBuf[26+i]=RoomId[i];
        }
        TRDataBuf[26+RoomLen]='#';
   	    //WIFISendData(TRDataBuf,27+RoomLen);
   	    k=0;
   	    fOvTime=0;
   	    fCancel=0;
   	    k=comTrCommand(TRDataBuf,27+RoomLen);  //发送指令
   	    if(k==COM_NO_ERR)  //成功接收数据
   	    {
   	    	for(i=6;i<(comRxLength-1);i++)TRDataBuf[i-6]=comRxDataBuf[i];
          TRDataBuf[comRxLength-7]=0;
          if((TRDataBuf[0]=='4')&&(TRDataBuf[1]=='#')&&(TRDataBuf[2]==IndexSend+48)&&(TRDataBuf[3]=='#')&&(TRDataBuf[4]!='e'))
          {
          	WorkLen=0;
          	for(k=0;k<7;k++)
	          {
	          	WorkId[k]=48;
	          }
          	for(k=0;k<7;k++)
	          {
	          	WorkId[k]=TRDataBuf[4+k];
	          	if(WorkId[k]!='#')WorkLen++;
	          	else break;
	          }
	          CustLen=0;
	          for(k=0;k<7;k++)
	          {
	          	CustId[k]=TRDataBuf[5+WorkLen+k];
	          	if(CustId[k]!='#')CustLen++;
	          	else break;
	          }
	          //if((TRDataBuf[5+WorkLen+CustLen]=='#')&&(WorkLen+CustLen+6==TRDataLen))
	          {
	          	for(j=0;j<DISP_BUF_MAX;j++)
				  		{
				  			disp_buf[j]=0;
				  		}
				  		for(j=0;j<24;j++)
				      {
				      	if(fProSelect==0x04)
				      	{
				      		disp_buf[j]=CorM084[j];
				      	}
				      	else 
				      	{
				      		disp_buf[j]=CorM085[j];
				      	}
				      }
	          	disp_buf[4]=':';
	          	disp_buf[5]=' ';
              for(j=0;j<WorkLen;j++)
              {
              	disp_buf[6+j]=WorkId[j];
              }
              disp_buf[16]=':';
	          	disp_buf[17]=' ';
              for(j=0;j<CustLen;j++)
              {
              	disp_buf[18+j]=CustId[j];
              }
				  		LCD_disp_starting=0;
				  		LcddispCnt=0;
              clrram();
              chn_left_disp(disp_buf,0,24,LCD_disp_starting);
	          	chn_disp(CorM09,1);
	          	LCD_disp_starting++;
	          	LCD_disp_starting++;
	          	LcddispCnt++;
	          	LcdLeftCnt=LCD_LEFT_CNT;
	          	player_stop=0;
              while(player_busy()==1)
              {
              	if(LcdLeftCnt==0)
				  		  {
				  		  	chn_left_disp(disp_buf,0,24,LCD_disp_starting);
				  		  	LCD_disp_starting++;
				  		  	LCD_disp_starting++;
				  		  	LcddispCnt++;
				  		  	if(LCD_disp_starting>=28)
				  		  		LCD_disp_starting=0;
				  		  	LcdLeftCnt=LCD_LEFT_CNT;
				  		  }
              	WDT_CONTR=0x3d;  //喂狗 1.13s;
              }
				  		player_Num(18);
				  		while(player_busy()==1)
				  		{
				  			if(LcdLeftCnt==0)
				  		  {
				  		  	chn_left_disp(disp_buf,0,24,LCD_disp_starting);
				  		  	LCD_disp_starting++;
				  		  	LCD_disp_starting++;
				  		  	LcddispCnt++;
				  		  	if(LCD_disp_starting>=28)
				  		  		LCD_disp_starting=0;
				  		  	LcdLeftCnt=LCD_LEFT_CNT;
				  		  }
				  			WDT_CONTR=0x3d;  //喂狗 1.13s;
				  		}
				  		player_Num(10);
              k=0xff;
			      	while((k==0xff)&&(LcddispCnt<21))   //等待有按键
			      	{
			      		WDT_CONTR=0x3d;  //喂狗 1.13s;
			      		if(LcdLeftCnt==0)
				  			{
				  				chn_left_disp(disp_buf,0,24,LCD_disp_starting);
				  				LCD_disp_starting++;
				  				LCD_disp_starting++;
				  				LcddispCnt++;
				  				if(LCD_disp_starting>=28)
				  					LCD_disp_starting=0;
				  				LcdLeftCnt=LCD_LEFT_CNT;
				  			}
			      		k=KeyRd();
			      		fLcdPwr=LCD_ON;
			      		CntLcdOn=0;
			      	}
			      	delay1(10000);
	          }
          }
          else if((TRDataBuf[0]=='4')&&(TRDataBuf[1]=='#')&&(TRDataBuf[2]==IndexSend+48)&&(TRDataBuf[3]=='#')&&(TRDataBuf[4]=='e')&&(TRDataBuf[5]=='#'))
          {
          	chn_disp(ErrM03,1);
				  	player_Num(18);
				  	player_Num(11);
          	delay1(40000);
          }
          else
          {
          	chn_disp(ErrM12,1);
				  	player_Num(45);
          	delay1(40000);
          }
        }
        else
        {
         	staComRx=COM_RX_NONE;
         	player_Num(45);
         	if(k==COM_ERR_SER)  //服务器无响应
         	{
   	        chn_disp(ErrM11,1);
   	      	delay1(40000);
         	}
         	else if(k==COM_ERR_COR)   //协调器无响应
         	{
   	        chn_disp(ErrM10,1);
   	      	delay1(40000);
         	}
         	else;
        }
      }
      break;
      case FUN6:              //功能6:清房
    	{
    	  clrram();
    	  KeyCLr();
    	  chn_disp(Menu14,0);
    	  chn_disp(Menu58,1);
				player_Num(19);
				player_Num(QSK);
    	  RFID_GetID();
        PinRfs=1;
        if((fOvTime==1)||(fCancel==1))break;
				player_Num(53);
        delay1(2000);
        TRDataBuf[0]='6';
        TRDataBuf[1]='#';
        IndexSend++;
        IndexSend%=10;
        TRDataBuf[2]=IndexSend+48;
        TRDataBuf[3]='#';
        for(i=0;i<10;i++)
        {
        	TRDataBuf[4+i]=idbuf[i];
        }
        TRDataBuf[14]='#';
        for(i=0;i<RoomLen;i++)
        {
        	TRDataBuf[15+i]=RoomId[i];
        }
        TRDataBuf[15+RoomLen]='#';
   	    //WIFISendData(TRDataBuf,15+RoomLen+1);
   	    k=0;
   	    fOvTime=0;
   	    fCancel=0;
   	    k=comTrCommand(TRDataBuf,15+RoomLen+1);  //发送指令
   	    if(k==COM_NO_ERR)  //成功接收数据
   	    {
   	    	for(i=6;i<(comRxLength-1);i++)TRDataBuf[i-6]=comRxDataBuf[i];
          TRDataBuf[comRxLength-7]=0;
          if((TRDataBuf[0]=='6')&&(TRDataBuf[1]=='#')&&(TRDataBuf[2]==IndexSend+48)&&(TRDataBuf[3]=='#')&&(TRDataBuf[4]!='e'))
          {
          	WorkLen=0;
          	for(k=0;k<7;k++)
	          {
	          	WorkId[k]=TRDataBuf[4+k];
	          	if(WorkId[k]!='#')WorkLen++;
	          	else break;
	          }
	          //if((TRDataBuf[4+WorkLen]=='#')&&(WorkLen+5==TRDataLen))
	          {
	          	chn_disp(CorM00,0);
    	        chn_disp(CorM03,1);
    	        wr_lcd(comm,0x30);
              wr_lcd(comm,0x82);
              wr_lcd(dat,':');
              for(j=0;j<WorkLen;j++)
              {
              	wr_lcd(dat,WorkId[j]);
              }
				  		player_Num(19);
				  		player_Num(10);
              delay1(40000);
              delay1(40000);
	          }
          }
          else if((TRDataBuf[0]=='6')&&(TRDataBuf[1]=='#')&&(TRDataBuf[2]==IndexSend+48)&&(TRDataBuf[3]=='#')&&(TRDataBuf[4]=='e')&&(TRDataBuf[5]=='#'))
          {
          	chn_disp(ErrM03,1);
				  	player_Num(19);
				  	player_Num(11);
          	delay1(40000);
          }
          else
          {
          	chn_disp(ErrM12,1);
				  	player_Num(45);
          	delay1(40000);
          }
        }
        else
        {
         	staComRx=COM_RX_NONE;
         	player_Num(45);
         	if(k==COM_ERR_SER)  //服务器无响应
         	{
   	        chn_disp(ErrM11,1);
   	      	delay1(40000);
         	}
         	else if(k==COM_ERR_COR)   //协调器无响应
         	{
   	        chn_disp(ErrM10,1);
   	      	delay1(40000);
         	}
         	else;
        }
      }
      break;
      case FUN7:              //功能7:换房
    	{
    		clrram();
    		KeyCLr();
    	  chn_disp(Menu15,0);
    	  chn_disp(Menu17,1);
				player_Num(20);
				player_Num(QSK);
    	  RFID_GetID();
        PinRfs=1;
        if((fOvTime==1)||(fCancel==1))break;
				player_Num(53);
        delay1(2000);
        TRDataBuf[0]='5';
        TRDataBuf[1]='#';
        IndexSend++;
        IndexSend%=10;
        TRDataBuf[2]=IndexSend+48;
        TRDataBuf[3]='#';
        for(i=0;i<10;i++)
        {
        	TRDataBuf[4+i]=idbuf[i];
        }
        TRDataBuf[14]='#';
        //-----------------------------------------
        fOvTime=0;
				fCancel=0;
				if(fProSelect==0x04)
				{
					chn_disp(Menu15,0);
    	    chn_disp(Menu18,1);
				  player_Num(QSK);
          for(i=0;i<3;i++)
          {
          	delay1(10000);
          	RFID_GetID();
            if((fOvTime==1)||(fCancel==1))break;
            k=0;
            for(j=0;j<10;j++)
            {
            	if(idbuf[j]!=TRDataBuf[4+j])
            	{
            		k++;
            	}
            }
            PinRfs=1;
            if(k>0)
            {
            	fOvTime=0;
				  		player_Num(53);
            	break;
            }
            fOvTime=1;
				  	player_Num(53);
				  	player_Num(53);
				  	player_Num(53);
				  	player_Num(53);
          }
          PinRfs=1;
        }
        if((fOvTime==1)||(fCancel==1))break;
        for(i=0;i<10;i++)
        {
        	TRDataBuf[15+i]=idbuf[i];
        }
        TRDataBuf[25]='#';
    		//------------------------------------------
    	  clrram();
    	  chn_disp(Menu15,0);
    	  chn_disp(Menu19,1);
    	  wr_lcd(comm,0x30);
      	wr_lcd(comm,0x94);
      	wr_lcd(dat,':');
      	for(k=0;k<6;k++)
      	{
      		wr_lcd(dat,'-');
      	}
				player_Num(QAJ);
    	  CntOv1s=0;
        fOvTime=0;
        fCancel=0;
        i=0;
        fFirstEnt=1;
      	for(j=0;j<7;j++)
      	{
      		fOvTime=0;
      		i=KeyRd();
      		while(i>0x0b)
      		{
      			WDT_CONTR=0x3d;  //喂狗 1.13s;
      			i=KeyRd();
      			if(j==6)
	  				{
	  					if((i!=0x0b)&&(i!=0x0a))
	  						i=0xFF;
	  				}
    	  	  if(CntOv1s<=KEY_OVERTIME)
    		    {
    		    	Lcd_overtime(KEY_OVERTIME-CntOv1s,0);
    		    }
    		    else
    		    {
    		    	fOvTime=1;
							player_Num(54);
							player_Num(55);
    		    	break;
    		    }
      		}
      		CntOv1s=0;
          //fOvTime=0;
      		if(i==0x0a||fOvTime==1)       //*取消
      		{
      			fCancel=1;
      			break;
      		}
      		else if(i==0x0b&&j==0) //没输入数据直接按#也是取消
      		{
      			fCancel=1;
      			break;
      		}
      		else if(i==0x0b&&j>0)
      		{
      			fCancel=0;
      			NewRoomLen=0;
      			for(k=0;k<7;k++)
      			{
      				if(NewRoomId[k]!='#')NewRoomLen++;
		          else break;
      			}
      			break;
      		}
      		else
      		{
      			if(fFirstEnt==1)
      			{
      				wr_lcd(comm,0x30);
      			  wr_lcd(comm,0x94);
      			  wr_lcd(dat,':');
      				for(k=0;k<6;k++)
      			  {
      			  	wr_lcd(dat,'-');
      			  }
      			  fFirstEnt=0;
      			  wr_lcd(comm,0x30);
      			  wr_lcd(comm,0x94);
      			  wr_lcd(dat,':');
      			}
      			NewRoomId[j]=i+48;
      			NewRoomId[j+1]='#';
      			wr_lcd(comm,0x30);
      			wr_lcd(comm,0x94);
      			wr_lcd(dat,':');
      			for(k=0;k<=j;k++)
      			{
      				wr_lcd(dat,NewRoomId[k]);
      			}
      			//if(j==5)
      			//{
      			//	j=4;
      			//}
      		}
      	}
        if(fCancel==1)
        {
        	LcdDisIniIn();
        	break;
        }
    	  //------------------------------------------
        for(i=0;i<RoomLen;i++)
        {
        	TRDataBuf[26+i]=RoomId[i];
        }
        TRDataBuf[26+RoomLen]='#';
        for(i=0;i<NewRoomLen;i++)
        {
        	TRDataBuf[27+RoomLen+i]=NewRoomId[i];
        }
        TRDataBuf[27+RoomLen+NewRoomLen]='#';
   	    //WIFISendData(TRDataBuf,28+RoomLen+NewRoomLen);
   	    k=0;
   	    fOvTime=0;
   	    fCancel=0;
   	    k=comTrCommand(TRDataBuf,28+RoomLen+NewRoomLen);  //发送指令
   	    if(k==COM_NO_ERR)  //成功接收数据
   	    {
   	    	for(i=6;i<(comRxLength-1);i++)TRDataBuf[i-6]=comRxDataBuf[i];
          TRDataBuf[comRxLength-7]=0;
          if((TRDataBuf[0]=='5')&&(TRDataBuf[1]=='#')&&(TRDataBuf[2]==IndexSend+48)&&(TRDataBuf[3]=='#')&&(TRDataBuf[4]!='e'))
          {
          	WorkLen=0;
          	for(k=0;k<7;k++)
	          {
	          	WorkId[k]=TRDataBuf[4+k];
	          	if(WorkId[k]!='#')WorkLen++;
	          	else break;
	          }
	          CustLen=0;
	          for(k=0;k<7;k++)
	          {
	          	CustId[k]=TRDataBuf[5+WorkLen+k];
	          	if(CustId[k]!='#')CustLen++;
	          	else break;
	          }
	          //if((TRDataBuf[5+WorkLen+CustLen]=='#')&&(WorkLen+CustLen+6==TRDataLen))
	          {
	          	for(j=0;j<DISP_BUF_MAX;j++)
				  		{
				  			disp_buf[j]=0;
				  		}
				  		for(j=0;j<24;j++)
				      {
				      	if(fProSelect==0x04)
				      	{
				      		disp_buf[j]=CorM054[j];
				      	}
				      	else 
				      	{
				      		disp_buf[j]=CorM055[j];
				      	}
				      }
	          	disp_buf[4]=':';
	          	disp_buf[5]=' ';
              for(j=0;j<WorkLen;j++)
              {
              	disp_buf[6+j]=WorkId[j];
              }
              disp_buf[16]=':';
	          	disp_buf[17]=' ';
              for(j=0;j<CustLen;j++)
              {
              	disp_buf[18+j]=CustId[j];
              }
				  		LCD_disp_starting=0;
				  		LcddispCnt=0;
              clrram();
              chn_left_disp(disp_buf,0,24,LCD_disp_starting);
	          	chn_disp(CorM06,1);
	          	LCD_disp_starting++;
	          	LCD_disp_starting++;
	          	LcddispCnt++;
	          	LcdLeftCnt=LCD_LEFT_CNT;
	          	player_stop=0;
              while(player_busy()==1)
              {
              	if(LcdLeftCnt==0)
				  		  {
				  		  	chn_left_disp(disp_buf,0,24,LCD_disp_starting);
				  		  	LCD_disp_starting++;
				  		  	LCD_disp_starting++;
				  		  	LcddispCnt++;
				  		  	if(LCD_disp_starting>=28)
				  		  		LCD_disp_starting=0;
				  		  	LcdLeftCnt=LCD_LEFT_CNT;
				  		  }
              	WDT_CONTR=0x3d;  //喂狗 1.13s;
              }
				  		player_Num(20);
				  		while(player_busy()==1)
				  		{
				  			if(LcdLeftCnt==0)
				  		  {
				  		  	chn_left_disp(disp_buf,0,24,LCD_disp_starting);
				  		  	LCD_disp_starting++;
				  		  	LCD_disp_starting++;
				  		  	LcddispCnt++;
				  		  	if(LCD_disp_starting>=28)
				  		  		LCD_disp_starting=0;
				  		  	LcdLeftCnt=LCD_LEFT_CNT;
				  		  }
				  			WDT_CONTR=0x3d;  //喂狗 1.13s;
				  		}
				  		player_Num(10);
              k=0xff;
			      	while((k==0xff)&&(LcddispCnt<21))   //等待有按键
			      	{
			      		WDT_CONTR=0x3d;  //喂狗 1.13s;
			      		if(LcdLeftCnt==0)
				  			{
				  				chn_left_disp(disp_buf,0,24,LCD_disp_starting);
				  				LCD_disp_starting++;
				  				LCD_disp_starting++;
				  				LcddispCnt++;
				  				if(LCD_disp_starting>=28)
				  					LCD_disp_starting=0;
				  				LcdLeftCnt=LCD_LEFT_CNT;
				  			}
			      		k=KeyRd();
			      		fLcdPwr=LCD_ON;
			      		CntLcdOn=0;
			      	}
			      	delay1(10000);
	          }
          }
          else if((TRDataBuf[0]=='5')&&(TRDataBuf[1]=='#')&&(TRDataBuf[2]==IndexSend+48)&&(TRDataBuf[3]=='#')&&(TRDataBuf[4]=='e')&&(TRDataBuf[5]=='#'))
          {
          	chn_disp(ErrM03,1);
				  	player_Num(20);
				  	player_Num(11);
          	delay1(40000);
          }
          else
          {
          	chn_disp(ErrM12,1);
				  	player_Num(45);
          	delay1(40000);
          }
        }
        else
        {
         	staComRx=COM_RX_NONE;
         	player_Num(45);
         	if(k==COM_ERR_SER)  //服务器无响应
         	{
   	        chn_disp(ErrM11,1);
   	      	delay1(40000);
         	}
         	else if(k==COM_ERR_COR)   //协调器无响应
         	{
   	        chn_disp(ErrM10,1);
   	      	delay1(40000);
         	}
         	else;
        }
      }
      break;
      case FUN8:              //功能8:输小费
			{
				clrram();
				KeyCLr();
    	  chn_disp(Menu29,0);
    	  chn_disp(Menu17,1);
				player_Num(17);
				player_Num(QSK);
    	  RFID_GetID();
        PinRfs=1;
        if((fOvTime==1)||(fCancel==1))break;
				player_Num(53);
        delay1(2000);
        TRDataBuf[0]='0';
        TRDataBuf[1]='#';
        IndexSend++;
        IndexSend%=10;
        TRDataBuf[2]=IndexSend+48;
        TRDataBuf[3]='#';
        for(i=0;i<10;i++)
        {
        	TRDataBuf[4+i]=idbuf[i];
        }
        TRDataBuf[14]='#';
        //-----------------------------------------
        fOvTime=0;
				fCancel=0;
				if(fProSelect==0x04)
				{
					clrram();
          chn_disp(Menu29,0);
    	    chn_disp(Menu18,1);
				  player_Num(QSK);
          for(i=0;i<3;i++)
          {
          	delay1(10000);
          	RFID_GetID();
            if((fOvTime==1)||(fCancel==1))break;
            k=0;
            for(j=0;j<10;j++)
            {
            	if(idbuf[j]!=TRDataBuf[4+j])
            	{
            		k++;
            	}
            }
            PinRfs=1;
            if(k>0)
            {
            	fOvTime=0;
				  		player_Num(53);
            	break;
            }
            fOvTime=1;
				  	player_Num(53);
				  	player_Num(53);
				  	player_Num(53);
				  	player_Num(53);
          }
          PinRfs=1;
        }
        if((fOvTime==1)||(fCancel==1))break;
        for(i=0;i<10;i++)
        {
        	TRDataBuf[15+i]=idbuf[i];
        }
        TRDataBuf[25]='#';
				//-----------------------------------------
				clrram();
				chn_disp(Menu27,0);
    	  chn_disp(Null00,1);
      	wr_lcd(comm,0x30);
      	wr_lcd(comm,0x92);
      	for(k=0;k<6;k++)
      	{
      		wr_lcd(dat,'-');
      	}
				player_Num(QAJ);
    	  CntOv1s=0;
        fOvTime=0;
        fCancel=0;
        i=0;
        fFirstEnt=1;
      	for(j=0;j<7;j++)
      	{
      		fOvTime=0;
      		i=KeyRd();
      		while(i>0x0b)
      		{
      			WDT_CONTR=0x3d;  //喂狗 1.13s;
      			i=KeyRd();
      			if(j==6)
	  				{
	  					if((i!=0x0b)&&(i!=0x0a))
	  						i=0xFF;
	  				}
    	  	  if(CntOv1s<=KEY_OVERTIME)
    		    {
    		    	Lcd_overtime(KEY_OVERTIME-CntOv1s,0);
    		    }
    		    else
    		    {
    		    	fOvTime=1;
							player_Num(54);
							player_Num(55);
    		    	break;
    		    }
      		}
      		CntOv1s=0;
          //fOvTime=0;
      		if(i==0x0a||fOvTime==1)       //*取消
      		{
      			fCancel=1;
      			break;
      		}
      		else if(i==0x0b&&j==0) //没输入数据直接按#也是取消
      		{
      			fCancel=1;
      			break;
      		}
      		else if(i==0x0b&&j>0)
      		{
      			fCancel=0;
      			Xiaofeilen=0;
      			for(k=0;k<7;k++)
      			{
      				if(Xiaofei[k]!='#')Xiaofeilen++;
		          else break;
      			}
      			break;
      		}
      		else
      		{
      			if(fFirstEnt==1)
      			{
      			  wr_lcd(comm,0x30);
      			  wr_lcd(comm,0x92);
      				for(k=0;k<6;k++)
      			  {
      			  	wr_lcd(dat,'-');
      			  }
      			  fFirstEnt=0;
      			  //wr_lcd(comm,0x30);
      			  //wr_lcd(comm,0x97);
      			  //wr_lcd(dat,':');
      			}
      			Xiaofei[j]=i+48;
      			Xiaofei[j+1]='#';
      			wr_lcd(comm,0x30);
      			wr_lcd(comm,0x92);
      			for(k=0;k<=j;k++)
      			{
      				wr_lcd(dat,Xiaofei[k]);
      			}
      			//if(j==5)
      			//{
      			//	j=4;
      			//}
      		}
      	}
        if(fCancel==1)
        {
        	LcdDisIniIn();
        	break;
        }
        //-----------------------------------------
        for(i=0;i<Xiaofeilen;i++)
        {
        	TRDataBuf[26+i]=Xiaofei[i];
        }
        TRDataBuf[26+Xiaofeilen]='#';
        for(i=0;i<RoomLen;i++)
        {
        	TRDataBuf[27+Xiaofeilen+i]=RoomId[i];
        }
        TRDataBuf[27+Xiaofeilen+RoomLen]='#';
   	    //WIFISendData(TRDataBuf,28+Xiaofeilen+RoomLen);
   	    k=0;
   	    fOvTime=0;
   	    fCancel=0;
   	    clrram();
        chn_disp(Menu29,0);
   	    k=comTrCommand(TRDataBuf,28+Xiaofeilen+RoomLen);  //发送指令
   	    if(k==COM_NO_ERR)  //成功接收数据
   	    {
   	    	for(i=6;i<(comRxLength-1);i++)TRDataBuf[i-6]=comRxDataBuf[i];
          TRDataBuf[comRxLength-7]=0;
          if((TRDataBuf[0]=='0')&&(TRDataBuf[1]=='#')&&(TRDataBuf[2]==IndexSend+48)&&(TRDataBuf[3]=='#')&&(TRDataBuf[4]!='e'))
          {
          	WorkLen=0;
          	for(k=0;k<7;k++)
	          {
	          	WorkId[k]=TRDataBuf[4+k];
	          	if(WorkId[k]!='#')WorkLen++;
	          	else break;
	          }
	          CustLen=0;
	          for(k=0;k<7;k++)
	          {
	          	CustId[k]=TRDataBuf[5+WorkLen+k];
	          	if(CustId[k]!='#')CustLen++;
	          	else break;
	          }
	          //if((TRDataBuf[5+WorkLen+CustLen]=='#')&&(WorkLen+CustLen+6==TRDataLen))
	          {
	          	for(j=0;j<DISP_BUF_MAX;j++)
				  		{
				  			disp_buf[j]=0;
				  		}
				  		for(j=0;j<24;j++)
				      {
				      	if(fProSelect==0x04)
				      	{
				      		disp_buf[j]=CorM054[j];
				      	}
				      	else 
				      	{
				      		disp_buf[j]=CorM055[j];
				      	}
				      }
	          	disp_buf[4]=':';
	          	disp_buf[5]=' ';
              for(j=0;j<WorkLen;j++)
              {
              	disp_buf[6+j]=WorkId[j];
              }
              disp_buf[16]=':';
	          	disp_buf[17]=' ';
              for(j=0;j<CustLen;j++)
              {
              	disp_buf[18+j]=CustId[j];
              }
				  		LCD_disp_starting=0;
				  		LcddispCnt=0;
              clrram();
              chn_left_disp(disp_buf,0,24,LCD_disp_starting);
	          	chn_disp(Menu28,1);
	          	LCD_disp_starting++;
	          	LCD_disp_starting++;
	          	LcddispCnt++;
	          	LcdLeftCnt=LCD_LEFT_CNT;
	          	player_stop=0;
              while(player_busy()==1)
              {
              	if(LcdLeftCnt==0)
				  		  {
				  		  	chn_left_disp(disp_buf,0,24,LCD_disp_starting);
				  		  	LCD_disp_starting++;
				  		  	LCD_disp_starting++;
				  		  	LcddispCnt++;
				  		  	if(LCD_disp_starting>=28)
				  		  		LCD_disp_starting=0;
				  		  	LcdLeftCnt=LCD_LEFT_CNT;
				  		  }
              	WDT_CONTR=0x3d;  //喂狗 1.13s;
              }
				  		player_Num(17);
				  		while(player_busy()==1)
				  		{
				  			if(LcdLeftCnt==0)
				  		  {
				  		  	chn_left_disp(disp_buf,0,24,LCD_disp_starting);
				  		  	LCD_disp_starting++;
				  		  	LCD_disp_starting++;
				  		  	LcddispCnt++;
				  		  	if(LCD_disp_starting>=28)
				  		  		LCD_disp_starting=0;
				  		  	LcdLeftCnt=LCD_LEFT_CNT;
				  		  }
				  			WDT_CONTR=0x3d;  //喂狗 1.13s;
				  		}
				  		player_Num(10);
              k=0xff;
			      	while((k==0xff)&&(LcddispCnt<21))   //等待有按键
			      	{
			      		WDT_CONTR=0x3d;  //喂狗 1.13s;
			      		if(LcdLeftCnt==0)
				  			{
				  				chn_left_disp(disp_buf,0,24,LCD_disp_starting);
				  				LCD_disp_starting++;
				  				LCD_disp_starting++;
				  				LcddispCnt++;
				  				if(LCD_disp_starting>=28)
				  					LCD_disp_starting=0;
				  				LcdLeftCnt=LCD_LEFT_CNT;
				  			}
			      		k=KeyRd();
			      		fLcdPwr=LCD_ON;
			      		CntLcdOn=0;
			      	}
			      	delay1(10000);
	          }
          }
          else if((TRDataBuf[0]=='0')&&(TRDataBuf[1]=='#')&&(TRDataBuf[2]==IndexSend+48)&&(TRDataBuf[3]=='#')&&(TRDataBuf[4]=='e')&&(TRDataBuf[5]=='#'))
          {
          	chn_disp(ErrM03,1);
				  	player_Num(17);
				  	player_Num(11);
          	delay1(40000);
          }
          else
          {
          	chn_disp(ErrM12,1);
				  	player_Num(45);
          	delay1(40000);
          }
        }
        else
        {
         	staComRx=COM_RX_NONE;
         	player_Num(45);
         	if(k==COM_ERR_SER)  //服务器无响应
         	{
   	        chn_disp(ErrM11,1);
   	      	delay1(40000);
         	}
         	else if(k==COM_ERR_COR)   //协调器无响应
         	{
   	        chn_disp(ErrM10,1);
   	      	delay1(40000);
         	}
         	else;
        }
      }
			break;
			case FUN9:			//功能9:反弹
			{
				clrram();
				KeyCLr();
    	  chn_disp(Menu30,0);
    	  chn_disp(Menu17,1);
				player_Num(21);
				player_Num(QSK);
    	  RFID_GetID();
        PinRfs=1;
        if((fOvTime==1)||(fCancel==1))break;
				player_Num(53);
        delay1(2000);
        TRDataBuf[0]='7';
        TRDataBuf[1]='#';
        IndexSend++;
        IndexSend%=10;
        TRDataBuf[2]=IndexSend+48;
        TRDataBuf[3]='#';
        for(i=0;i<10;i++)
        {
        	TRDataBuf[4+i]=idbuf[i];
        }
        TRDataBuf[14]='#';
        /////////////////////////////////////////////////////////////////////
				fOvTime=0;
				fCancel=0;
				if(fProSelect==0x04)
				{
					clrram();
          chn_disp(Menu30,0);
    	    chn_disp(Menu18,1);
				  player_Num(QSK);
          for(i=0;i<3;i++)
          {
          	delay1(10000);
          	RFID_GetID();
            if((fOvTime==1)||(fCancel==1))break;
            k=0;
            for(j=0;j<10;j++)
            {
            	if(idbuf[j]!=TRDataBuf[4+j])
            	{
            		k++;
            	}
            }
            PinRfs=1;
            if(k>0)
            {
            	fOvTime=0;
				  		player_Num(53);
            	break;
            }
            fOvTime=1;
				  	player_Num(53);
				  	player_Num(53);
				  	player_Num(53);
				  	player_Num(53);
          }
          PinRfs=1;
        }
        if((fOvTime==1)||(fCancel==1))break;
        for(i=0;i<10;i++)
        {
        	TRDataBuf[15+i]=idbuf[i];
        }
        TRDataBuf[25]='#';
        for(i=0;i<RoomLen;i++)
        {
        	TRDataBuf[26+i]=RoomId[i];
        }
        TRDataBuf[26+RoomLen]='#';
   	    //WIFISendData(TRDataBuf,27+RoomLen);
   	    k=0;
   	    fOvTime=0;
   	    fCancel=0;
   	    k=comTrCommand(TRDataBuf,27+RoomLen);  //发送指令
   	    if(k==COM_NO_ERR)  //成功接收数据
   	    {
   	    	for(i=6;i<(comRxLength-1);i++)TRDataBuf[i-6]=comRxDataBuf[i];
          TRDataBuf[comRxLength-7]=0;
          if((TRDataBuf[0]=='7')&&(TRDataBuf[1]=='#')&&(TRDataBuf[2]==IndexSend+48)&&(TRDataBuf[3]=='#')&&(TRDataBuf[4]!='e'))
          {
          	WorkLen=0;
          	for(k=0;k<7;k++)
	          {
	          	WorkId[k]=TRDataBuf[4+k];
	          	if(WorkId[k]!='#')WorkLen++;
	          	else break;
	          }
	          CustLen=0;
	          for(k=0;k<7;k++)
	          {
	          	CustId[k]=TRDataBuf[5+WorkLen+k];
	          	if(CustId[k]!='#')CustLen++;
	          	else break;
	          }
	          //if((TRDataBuf[5+WorkLen+CustLen]=='#')&&(WorkLen+CustLen+6==TRDataLen))
	          {
	          	for(j=0;j<DISP_BUF_MAX;j++)
				  		{
				  			disp_buf[j]=0;
				  		}
				  		for(j=0;j<24;j++)
				      {
				      	if(fProSelect==0x04)
				      	{
				      		disp_buf[j]=CorM054[j];
				      	}
				      	else 
				      	{
				      		disp_buf[j]=CorM055[j];
				      	}
				      }
	          	disp_buf[4]=':';
	          	disp_buf[5]=' ';
              for(j=0;j<WorkLen;j++)
              {
              	disp_buf[6+j]=WorkId[j];
              }
              disp_buf[16]=':';
	          	disp_buf[17]=' ';
              for(j=0;j<CustLen;j++)
              {
              	disp_buf[18+j]=CustId[j];
              }
				  		LCD_disp_starting=0;
				  		LcddispCnt=0;
              clrram();
              chn_left_disp(disp_buf,0,24,LCD_disp_starting);
	          	chn_disp(Menu31,1);
	          	LCD_disp_starting++;
	          	LCD_disp_starting++;
	          	LcddispCnt++;
	          	LcdLeftCnt=LCD_LEFT_CNT;
	          	player_stop=0;
              while(player_busy()==1)
              {
              	if(LcdLeftCnt==0)
				  		  {
				  		  	chn_left_disp(disp_buf,0,24,LCD_disp_starting);
				  		  	LCD_disp_starting++;
				  		  	LCD_disp_starting++;
				  		  	LcddispCnt++;
				  		  	if(LCD_disp_starting>=28)
				  		  		LCD_disp_starting=0;
				  		  	LcdLeftCnt=LCD_LEFT_CNT;
				  		  }
              	WDT_CONTR=0x3d;  //喂狗 1.13s;
              }
				  		player_Num(21);
				  		while(player_busy()==1)
				  		{
				  			if(LcdLeftCnt==0)
				  		  {
				  		  	chn_left_disp(disp_buf,0,24,LCD_disp_starting);
				  		  	LCD_disp_starting++;
				  		  	LCD_disp_starting++;
				  		  	LcddispCnt++;
				  		  	if(LCD_disp_starting>=28)
				  		  		LCD_disp_starting=0;
				  		  	LcdLeftCnt=LCD_LEFT_CNT;
				  		  }
				  			WDT_CONTR=0x3d;  //喂狗 1.13s;
				  		}
				  		player_Num(10);
              k=0xff;
			      	while((k==0xff)&&(LcddispCnt<21))   //等待有按键
			      	{
			      		WDT_CONTR=0x3d;  //喂狗 1.13s;
			      		if(LcdLeftCnt==0)
				  			{
				  				chn_left_disp(disp_buf,0,24,LCD_disp_starting);
				  				LCD_disp_starting++;
				  				LCD_disp_starting++;
				  				LcddispCnt++;
				  				if(LCD_disp_starting>=28)
				  					LCD_disp_starting=0;
				  				LcdLeftCnt=LCD_LEFT_CNT;
				  			}
			      		k=KeyRd();
			      		fLcdPwr=LCD_ON;
			      		CntLcdOn=0;
			      	}
			      	delay1(10000);
	          }
          }
          else if((TRDataBuf[0]=='7')&&(TRDataBuf[1]=='#')&&(TRDataBuf[2]==IndexSend+48)&&(TRDataBuf[3]=='#')&&(TRDataBuf[4]=='e')&&(TRDataBuf[5]=='#'))
          {
          	chn_disp(ErrM03,1);
				  	player_Num(21);
				  	player_Num(11);
          	delay1(40000);
          }
          else
          {
          	chn_disp(ErrM12,1);
				  	player_Num(45);
          	delay1(40000);
          }
        }
        else
        {
         	staComRx=COM_RX_NONE;
         	player_Num(45);
         	if(k==COM_ERR_SER)  //服务器无响应
         	{
   	        chn_disp(ErrM11,1);
   	      	delay1(40000);
         	}
         	else if(k==COM_ERR_COR)   //协调器无响应
         	{
   	        chn_disp(ErrM10,1);
   	      	delay1(40000);
         	}
         	else;
        }
      }
			break;
			case FUN10:				//功能10:查询
			{
			  clrram();
    	  chn_disp(Menu33,0);
    	  chn_disp(Menu36,1);
				player_Num(33);
				player_Num(QSK);
    	  RFID_GetID();
        PinRfs=1;
        if((fOvTime==1)||(fCancel==1))break;
				player_Num(53);
        delay1(2000);
        TRDataBuf[0]='8';
        TRDataBuf[1]='#';
        IndexSend++;
        IndexSend%=10;
        TRDataBuf[2]=IndexSend+48;
        TRDataBuf[3]='#';
        for(i=0;i<10;i++)
        {
        	TRDataBuf[4+i]=idbuf[i];
        }
        TRDataBuf[14]='#';
        ////////////////////////////////////////////////////////////////////////////
        for(j=0;j<DISP_BUF_MAX;j++)
				{
					disp_buf[j]=0;
				}
				for(j=0;j<24;j++)
				{
					disp_buf[j]=Menu35[j];
				}
        LCD_disp_starting=0;
        clrram();
    	  chn_disp(Menu34,0);
    	  chn_left_disp(disp_buf,1,24,LCD_disp_starting);
    	  LCD_disp_starting++;
				LCD_disp_starting++;
				LcdLeftCnt=LCD_LEFT_CNT;
    	  player_stop=0;
		  	while(player_busy()==1)
		  	{
		  		if(LcdLeftCnt==0)
					{
						chn_left_disp(disp_buf,1,24,LCD_disp_starting);
						LCD_disp_starting++;
						LCD_disp_starting++;
						if(LCD_disp_starting>=28)
							LCD_disp_starting=0;
						LcdLeftCnt=LCD_LEFT_CNT;
					}
		  		WDT_CONTR=0x3d;  //喂狗 1.13s;
		  	}
				player_Num(QXZ);
    	  CntOv1s=0;
        fOvTime=0;
        fCancel=0;
        i=0;
      	while((i!=0x04)&&(i!=0x05)&&(i!=0x0a))
      	{
      		WDT_CONTR=0x3d;  //喂狗 1.13s;
      		i=KeyRd();
    	    if(CntOv1s<=KEY_OVERTIME)
    		  {
    		  	if(LcdLeftCnt==0)
						{
							chn_left_disp(disp_buf,1,24,LCD_disp_starting);
							LCD_disp_starting++;
							LCD_disp_starting++;
							if(LCD_disp_starting>=28)
								LCD_disp_starting=0;
							LcdLeftCnt=LCD_LEFT_CNT;
						}
    		   	Lcd_overtime(KEY_OVERTIME-CntOv1s,0);
    		  }
    		  else
    		  {
    		   	fOvTime=1;
						player_Num(54);
						player_Num(55);
    		   	break;
    		  }
      	}
      	if(i==0x0a||fOvTime==1)       //*取消
      	{
      		fCancel=1;
      	}
      	else
      	{
      		Query=i;
      	}
        if(fCancel==1)
        {
        	LcdDisIniIn();
        	break;
        }
        if(Query==0x04)
        {
        	clrram();
        	chn_disp(Menu62,0);
        	chn_disp(Null00,1);
					player_Num(QAJ);
        }
        else if(Query==0x05)
        {
        	clrram();
        	chn_disp(Menu41,0);
        	chn_disp(Null00,1);
					player_Num(QAJ);
        }
        else 
        {
        	LcdDisIniIn();
        	break;
        }
        wr_lcd(comm,0x30);
      	wr_lcd(comm,0x92);
      	for(k=0;k<6;k++)
      	{
      		wr_lcd(dat,'-');
      	}
    	  i=0;
    	  CntOv1s=0;
        fOvTime=0;
        fCancel=0;
        i=0;
        fFirstEnt=1;
      	for(j=0;j<7;j++)
      	{
      		fOvTime=0;
      		i=KeyRd();
      		while(i>0x0b)
      		{
      			WDT_CONTR=0x3d;  //喂狗 1.13s;
      			i=KeyRd();
      			if(j==6)
	  				{
	  					if((i!=0x0b)&&(i!=0x0a))
	  						i=0xFF;
	  				}
    	  	  if(CntOv1s<=KEY_OVERTIME)
    		    {
    		    	Lcd_overtime(KEY_OVERTIME-CntOv1s,0);
    		    }
    		    else
    		    {
    		    	fOvTime=1;
							player_Num(54);
							player_Num(55);
    		    	break;
    		    }
      		}
      		CntOv1s=0;
          //fOvTime=0;
      		if(i==0x0a||fOvTime==1)       //*取消
      		{
      			fCancel=1;
      			break;
      		}
      		else if(i==0x0b&&j==0) //没输入数据直接按#也是取消
      		{
      			fCancel=1;
      			break;
      		}
      		else if(i==0x0b&&j>0)
      		{
      			fCancel=0;
      			WorkLen=0;
      			for(k=0;k<7;k++)
      			{
      				if(WorkId[k]!='#')WorkLen++;
		          else break;
      			}
      			break;
      		}
      		else
      		{
      			if(fFirstEnt==1)
      			{
      			  wr_lcd(comm,0x30);
      			  wr_lcd(comm,0x92);
      				for(k=0;k<6;k++)
      			  {
      			  	wr_lcd(dat,'-');
      			  }
      			  fFirstEnt=0;
      			}
      			WorkId[j]=i+48;
      			WorkId[j+1]='#';
      			wr_lcd(comm,0x30);
      			wr_lcd(comm,0x92);
      			for(k=0;k<=j;k++)
      			{
      				wr_lcd(dat,WorkId[k]);
      			}
      			//if(j==5)
      			//{
      			//	j=4;
      			//}
      		}
      	}
        if(fCancel==1)
        {
        	LcdDisIniIn();
        	break;
        }
        TRDataBuf[15]=Query+48;
        TRDataBuf[16]='#';
        for(i=0;i<WorkLen;i++)
        {
        	TRDataBuf[17+i]=WorkId[i];
        }
        TRDataBuf[17+WorkLen]='#';
        for(i=0;i<RoomLen;i++)
        {
        	TRDataBuf[18+WorkLen+i]=RoomId[i];
        }
        TRDataBuf[18+WorkLen+RoomLen]='#';
   	    //WIFISendData(TRDataBuf,19+WorkLen+RoomLen);
   	    clrram();
        chn_disp(Menu33,0);
   	    k=0;
   	    fOvTime=0;
   	    fCancel=0;
   	    k=comTrCommand(TRDataBuf,19+WorkLen+RoomLen);  //发送指令
   	    if(k==COM_NO_ERR)  //成功接收数据
   	    {
   	    	for(i=6;i<(comRxLength-1);i++)TRDataBuf[i-6]=comRxDataBuf[i];
          TRDataBuf[comRxLength-7]=0;
   	    
          if((TRDataBuf[0]=='8')&&(TRDataBuf[1]=='#')&&(TRDataBuf[2]==IndexSend+48)&&(TRDataBuf[3]=='#')&&(TRDataBuf[4]!='e'))
          {
          	if(Query==0x04)
          	{
          		//队列查询
          		WorkLen=0;
	  	      	for(k=0;k<7;k++)
		          {
		          	WorkId[k]=TRDataBuf[4+k];
		          	if(WorkId[k]!='#')WorkLen++;
		          	else break;
		          }
		          QueryIDlen[0]=0;
		          for(k=0;k<7;k++)
		          {
		          	QueryID[0][k]=TRDataBuf[5+WorkLen+k];
		          	if(QueryID[0][k]!='#')QueryIDlen[0]++;
		          	else break;
		          }
		          QueryIDlen[1]=0;
		          for(k=0;k<7;k++)
		          {
		          	QueryID[1][k]=TRDataBuf[6+WorkLen+QueryIDlen[0]+k];
		          	if(QueryID[1][k]!='#')QueryIDlen[1]++;
		          	else break;
		          }
		          QueryIDlen[2]=0;
		          for(k=0;k<7;k++)
		          {
		          	QueryID[2][k]=TRDataBuf[7+WorkLen+QueryIDlen[0]+QueryIDlen[1]+k];
		          	if(QueryID[2][k]!='#')QueryIDlen[2]++;
		          	else break;
		          }
		          //if((TRDataBuf[7+WorkLen+QueryIDlen[0]+QueryIDlen[1]+QueryIDlen[2]]=='#')&&(8+WorkLen+QueryIDlen[0]+QueryIDlen[1]+QueryIDlen[2]==TRDataLen))
		          {
		          	for(j=0;j<DISP_BUF_MAX;j++)
				  	    {
				  	    	disp_buf[j]=0;
				  	    }
		          	for(j=0;j<QueryIDlen[0];j++)
	  	          {
	  	          	disp_buf[j]=QueryID[0][j];
	  	          }
		          	disp_buf[QueryIDlen[0]]=' ';
		          	for(j=0;j<QueryIDlen[1];j++)
	  	          {
	  	          	disp_buf[j+QueryIDlen[0]+1]=QueryID[1][j];
	  	          }
	  	          disp_buf[QueryIDlen[1]+QueryIDlen[0]+1]=' ';
	  	          for(j=0;j<QueryIDlen[2];j++)
	  	          {
	  	          	disp_buf[j+QueryIDlen[1]+QueryIDlen[0]+2]=QueryID[2][j];
	  	          }
	  	          disp_buf[QueryIDlen[2]+QueryIDlen[1]+QueryIDlen[0]+2]=' ';
		          	LCD_disp_starting=0;
	  		        clrram();
	  		        chn_disp(Menu63,0);
	  		        chn_left_disp(disp_buf,1,QueryIDlen[2]+QueryIDlen[1]+QueryIDlen[0]+3,LCD_disp_starting);
				    		img_disp(BmpNum2,0,0x80);
				    		LCD_disp_starting++;
	          		LCD_disp_starting++;
				  			player_stop=0;
	  	          while(player_busy()==1)
	  	          {
	  	          	if(LcdLeftCnt==0)
				  			  {
				  			  	chn_left_disp(disp_buf,1,QueryIDlen[2]+QueryIDlen[1]+QueryIDlen[0]+3,LCD_disp_starting);
				  			  	LCD_disp_starting++;
				  			  	LCD_disp_starting++;
				  			  	if(LCD_disp_starting>=QueryIDlen[2]+QueryIDlen[1]+QueryIDlen[0]+7)
				  			  		LCD_disp_starting=0;
				  			  	LcdLeftCnt=LCD_LEFT_CNT;
				  			  }
	  	          	WDT_CONTR=0x3d;  //喂狗 1.13s;
	  	          }
				  			player_Num(22);
				  			for(j=0;j<QueryIDlen[0];j++)
				  			{
				  				while(player_busy()==1)
				  				{
				  					if(LcdLeftCnt==0)
				  				  {
				  				  	chn_left_disp(disp_buf,1,QueryIDlen[2]+QueryIDlen[1]+QueryIDlen[0]+3,LCD_disp_starting);
				  				  	LCD_disp_starting++;
				  				  	LCD_disp_starting++;
				  				  	if(LCD_disp_starting>=QueryIDlen[2]+QueryIDlen[1]+QueryIDlen[0]+7)
				  				  		LCD_disp_starting=0;
				  				  	LcdLeftCnt=LCD_LEFT_CNT;
				  				  }
				  					WDT_CONTR=0x3d;  //喂狗 1.13s;
				  				}
				  				player_Num(QueryID[0][j]-48);
				  			}
				  			for(j=0;j<QueryIDlen[1];j++)
				  			{
				  				while(player_busy()==1)
				  				{
				  					if(LcdLeftCnt==0)
				  				  {
				  				  	chn_left_disp(disp_buf,1,QueryIDlen[2]+QueryIDlen[1]+QueryIDlen[0]+3,LCD_disp_starting);
				  				  	LCD_disp_starting++;
				  				  	LCD_disp_starting++;
				  				  	if(LCD_disp_starting>=QueryIDlen[2]+QueryIDlen[1]+QueryIDlen[0]+7)
				  				  		LCD_disp_starting=0;
				  				  	LcdLeftCnt=LCD_LEFT_CNT;
				  				  }
				  					WDT_CONTR=0x3d;  //喂狗 1.13s;
				  				}
				  				player_Num(QueryID[1][j]-48);
				  			}
				  			for(j=0;j<QueryIDlen[2];j++)
				  			{
				  				while(player_busy()==1)
				  				{
				  					if(LcdLeftCnt==0)
				  				  {
				  				  	chn_left_disp(disp_buf,1,QueryIDlen[2]+QueryIDlen[1]+QueryIDlen[0]+3,LCD_disp_starting);
				  				  	LCD_disp_starting++;
				  				  	LCD_disp_starting++;
				  				  	if(LCD_disp_starting>=QueryIDlen[2]+QueryIDlen[1]+QueryIDlen[0]+7)
				  				  		LCD_disp_starting=0;
				  				  	LcdLeftCnt=LCD_LEFT_CNT;
				  				  }
				  					WDT_CONTR=0x3d;  //喂狗 1.13s;
				  				}
				  				player_Num(QueryID[2][j]-48);
				  			}
				  			k=0xff;
				  			while(k==0xff)   //等待有按键
				  			{
				  				WDT_CONTR=0x3d;  //喂狗 1.13s;
				  				if(LcdLeftCnt==0)
				  				{
				  					chn_left_disp(disp_buf,1,QueryIDlen[2]+QueryIDlen[1]+QueryIDlen[0]+3,LCD_disp_starting);
				  					LCD_disp_starting++;
				  					LCD_disp_starting++;
				  					if(LCD_disp_starting>=QueryIDlen[2]+QueryIDlen[1]+QueryIDlen[0]+7)
				  						LCD_disp_starting=0;
				  					LcdLeftCnt=LCD_LEFT_CNT;
				  				}
				  				k=KeyRd();
				  				fLcdPwr=LCD_ON;
				  				CntLcdOn=0;
				  			}
		          }
          	}
          	if(Query==0x05)
          	{
          		//技师工号查询
          		WorkLen=0;
	  	      	for(k=0;k<7;k++)
		          {
		          	WorkId[k]=TRDataBuf[4+k];
		          	if(WorkId[k]!='#')WorkLen++;
		          	else break;
		          }
		          QueryIDlen[0]=0;
		          for(k=0;k<7;k++)
		          {
		          	QueryID[0][k]=TRDataBuf[5+WorkLen+k];
		          	if(QueryID[0][k]!='#')QueryIDlen[0]++;
		          	else break;
		          }
		          Stat=TRDataBuf[6+WorkLen+QueryIDlen[0]];
		          if(TRDataBuf[7+WorkLen+QueryIDlen[0]]=='#')
		          {
		          	switch(Stat)
		          	{
		          		case STAT1:		//未上班
		          			//if(8+WorkLen+QueryIDlen[0]==TRDataLen)
		          			{
		            			clrram();
			      		      chn_disp(CorM01,0);
			      		      chn_disp(Menu64,1);
			      	        wr_lcd(comm,0x30);
			      	        wr_lcd(comm,0x82);
			      	        wr_lcd(dat,':');
			      	        wr_lcd(comm,0x30);
			      	        wr_lcd(comm,0x83);
			      	        for(j=0;j<QueryIDlen[0];j++)
			      	        {
			      	        	wr_lcd(dat,QueryID[0][j]);
			      	        }
				  						player_Num(23);
				  						for(j=0;j<QueryIDlen[0];j++)
				  						{
				  							player_Num(QueryID[0][j]-48);
				  						}
				  						player_Num(24);
			      	        delay1(40000);
	  	          			delay1(40000);
	  	          		}
			          			break;
		          		case STAT2:		//空闲
		          			//if(8+WorkLen+QueryIDlen[0]==TRDataLen)
		          			{
		            		  clrram();
			      		      chn_disp(CorM01,0);
			      		      chn_disp(Menu65,1);
			      	        wr_lcd(comm,0x30);
			      	        wr_lcd(comm,0x82);
			      	        wr_lcd(dat,':');
			      	        wr_lcd(comm,0x30);
			      	        wr_lcd(comm,0x83);
			      	        for(j=0;j<QueryIDlen[0];j++)
			      	        {
			      	        	wr_lcd(dat,QueryID[0][j]);
			      	        }
				  						player_Num(23);
				  						for(j=0;j<QueryIDlen[0];j++)
				  						{
				  							player_Num(QueryID[0][j]-48);
				  						}
				  						player_Num(25);
			      	        delay1(40000);
	  	          			delay1(40000);
              			}
		          			break;
		          		case STAT3:		//空闲,HH:mm被预约
		          			Time[0]=TRDataBuf[8+WorkLen+QueryIDlen[0]];
		          			Time[1]=TRDataBuf[9+WorkLen+QueryIDlen[0]];
		          			Time[2]=TRDataBuf[11+WorkLen+QueryIDlen[0]];
		          			Time[3]=TRDataBuf[12+WorkLen+QueryIDlen[0]];
		          			//if((TRDataBuf[13+WorkLen+QueryIDlen[0]]=='#')&&(14+WorkLen+QueryIDlen[0]==TRDataLen))
		          			{
		          				for(j=0;j<DISP_BUF_MAX;j++)
				  	          {
				  	          	disp_buf[j]=0;
				  	          }
		          				for(j=0;j<16;j++)
		          				{
		          					disp_buf[j]=Menu66[j];
		          				}
		          				disp_buf[4]=Time[0];
		          				disp_buf[5]=Time[1];
		          				disp_buf[6]=':';
		          				disp_buf[7]=' ';
		          				disp_buf[8]=Time[2];
		          				disp_buf[9]=Time[3];
				  						LCD_disp_starting=0;
				  						LcddispCnt=0;
		            			clrram();
			      		      chn_disp(CorM01,0);
			      	        wr_lcd(comm,0x30);
			      	        wr_lcd(comm,0x82);
			      	        wr_lcd(dat,':');
			      	        wr_lcd(comm,0x30);
			      	        wr_lcd(comm,0x83);
			      	        for(j=0;j<QueryIDlen[0];j++)
			      	        {
			      	        	wr_lcd(dat,QueryID[0][j]);
			      	        }
			      	        chn_left_disp(disp_buf,1,16,LCD_disp_starting);
				            	LCD_disp_starting++;
				            	LCD_disp_starting++;
				            	LcddispCnt++;
				            	LcdLeftCnt=LCD_LEFT_CNT;
				  						player_stop=0;
			      	        while(player_busy()==1)
			      	        {
			      	        	if(LcdLeftCnt==0)
				  						  {
				  						  	chn_left_disp(disp_buf,1,16,LCD_disp_starting);
				  						  	LCD_disp_starting++;
				  						  	LCD_disp_starting++;
				  						  	LcddispCnt++;
				  						  	if(LCD_disp_starting>=20)
				  						  		LCD_disp_starting=0;
				  						  	LcdLeftCnt=LCD_LEFT_CNT;
				  						  }
			      	        	WDT_CONTR=0x3d;  //喂狗 1.13s;
			      	        }
				  						player_Num(23);
				  						for(j=0;j<QueryIDlen[0];j++)
				  						{
				  							while(player_busy()==1)
				  							{
				  								if(LcdLeftCnt==0)
				  							  {
				  							  	chn_left_disp(disp_buf,1,16,LCD_disp_starting);
				  							  	LCD_disp_starting++;
				  							  	LCD_disp_starting++;
				  							  	LcddispCnt++;
				  							  	if(LCD_disp_starting>=20)
				  							  		LCD_disp_starting=0;
				  							  	LcdLeftCnt=LCD_LEFT_CNT;
				  							  }
				  								WDT_CONTR=0x3d;  //喂狗 1.13s;
				  							}
				  							player_Num(QueryID[0][j]-48);
				  						}
				  						while(player_busy()==1)
				  						{
				  							if(LcdLeftCnt==0)
				  						  {
				  						  	chn_left_disp(disp_buf,1,16,LCD_disp_starting);
				  						  	LCD_disp_starting++;
				  						  	LCD_disp_starting++;
				  						  	LcddispCnt++;
				  						  	if(LCD_disp_starting>=20)
				  						  		LCD_disp_starting=0;
				  						  	LcdLeftCnt=LCD_LEFT_CNT;
				  						  }
				  							WDT_CONTR=0x3d;  //喂狗 1.13s;
				  						}
				  						player_Num(25);
				  						player_Time(&Time[0],disp_buf,1,16,0xFF);
				  						while(player_busy()==1)
				  						{
				  							if(LcdLeftCnt==0)
				  						  {
				  						  	chn_left_disp(disp_buf,1,16,LCD_disp_starting);
				  						  	LCD_disp_starting++;
				  						  	LCD_disp_starting++;
				  						  	LcddispCnt++;
				  						  	if(LCD_disp_starting>=20)
				  						  		LCD_disp_starting=0;
				  						  	LcdLeftCnt=LCD_LEFT_CNT;
				  						  }
				  							WDT_CONTR=0x3d;  //喂狗 1.13s;
				  						}
				  						player_Num(26);
			      	        k=0xff;
				  			    	while((k==0xff)&&(LcddispCnt<13))   //等待有按键
				  			    	{
				  			    		WDT_CONTR=0x3d;  //喂狗 1.13s;
				  			    		if(LcdLeftCnt==0)
				  							{
				  								chn_left_disp(disp_buf,1,16,LCD_disp_starting);
				  								LCD_disp_starting++;
				  								LCD_disp_starting++;
				  								LcddispCnt++;
				  								if(LCD_disp_starting>=20)
				  									LCD_disp_starting=0;
				  								LcdLeftCnt=LCD_LEFT_CNT;
				  							}
				  			    		k=KeyRd();
				  			    		fLcdPwr=LCD_ON;
				  			    		CntLcdOn=0;
				  			    	}
				  			    	delay1(10000);
	  	          		}
		          			break;
		          		case STAT4:		//上钟,落钟时间HH:mm,位置XXX
		          			Time[0]=TRDataBuf[8+WorkLen+QueryIDlen[0]];
		          			Time[1]=TRDataBuf[9+WorkLen+QueryIDlen[0]];
		          			Time[2]=TRDataBuf[11+WorkLen+QueryIDlen[0]];
		          			Time[3]=TRDataBuf[12+WorkLen+QueryIDlen[0]];
		          			//if(TRDataBuf[13+WorkLen+QueryIDlen[0]]=='#')
		          			{
		          				Locatlen=0;
				  	          for(k=0;k<7;k++)
				  	          {
				  	          	Locat[k]=TRDataBuf[14+WorkLen+QueryIDlen[0]+k];
				  	          	if(Locat[k]!='#')Locatlen++;
				  	          	else break;
				  	          }
				  	          //if((TRDataBuf[14+WorkLen+QueryIDlen[0]+Locatlen]=='#')&&(15+WorkLen+QueryIDlen[0]+Locatlen==TRDataLen))
				  	          {
				  	          	for(j=0;j<DISP_BUF_MAX;j++)
				  	          	{
				  	          		disp_buf[j]=0;
				  	          	}
				  	          	for(j=0;j<34;j++)
		            				{
		            					disp_buf[j]=Menu68[j];
		            				}
		            				disp_buf[18]=Time[0];
		            				disp_buf[19]=Time[1];
		            				disp_buf[20]=':';
		            				disp_buf[21]=' ';
		            				disp_buf[22]=Time[2];
		            				disp_buf[23]=Time[3];
		            				for(j=0;j<Locatlen;j++)
		            				{
		            					disp_buf[28+j]=Locat[j];
		            				}
				  							LCD_disp_starting=0;
				  							LcddispCnt=0;
				  	          	clrram();
				      		      chn_disp(CorM01,0);
				      	        wr_lcd(comm,0x30);
				      	        wr_lcd(comm,0x82);
				      	        wr_lcd(dat,':');
				      	        wr_lcd(comm,0x30);
				      	        wr_lcd(comm,0x83);
				      	        for(j=0;j<QueryIDlen[0];j++)
				      	        {
				      	        	wr_lcd(dat,QueryID[0][j]);
				      	        }
				      	        chn_left_disp1(disp_buf,1,34,LCD_disp_starting,0);
				  	          	LCD_disp_starting++;
				  	          	LCD_disp_starting++;
				  	          	LcddispCnt++;
				  	          	LcdLeftCnt=LCD_LEFT_CNT;
				  							player_stop=0;
				      	        while(player_busy()==1)
				      	        {
				      	        	if(LcdLeftCnt==0)
				  							  {
				  							  	chn_left_disp1(disp_buf,1,34,LCD_disp_starting,0);
				  							  	LCD_disp_starting++;
				  							  	LCD_disp_starting++;
				  							  	LcddispCnt++;
				  							  	if(LCD_disp_starting>=38)
				  							  		LCD_disp_starting=0;
				  							  	LcdLeftCnt=LCD_LEFT_CNT;
				  							  }
				      	        	WDT_CONTR=0x3d;  //喂狗 1.13s;
				      	        }
				  							player_Num(23);
				  							for(j=0;j<QueryIDlen[0];j++)
				  							{
				  								while(player_busy()==1)
				  								{
				  									if(LcdLeftCnt==0)
				  								  {
				  								  	chn_left_disp1(disp_buf,1,34,LCD_disp_starting,0);
				  								  	LCD_disp_starting++;
				  								  	LCD_disp_starting++;
				  								  	LcddispCnt++;
				  								  	if(LCD_disp_starting>=38)
				  								  		LCD_disp_starting=0;
				  								  	LcdLeftCnt=LCD_LEFT_CNT;
				  								  }
				  									WDT_CONTR=0x3d;  //喂狗 1.13s;
				  								}
				  								player_Num(QueryID[0][j]-48);
				  							}
				  							while(player_busy()==1)
				  							{
				  								if(LcdLeftCnt==0)
				  								{
				  									chn_left_disp1(disp_buf,1,34,LCD_disp_starting,0);
				  									LCD_disp_starting++;
				  									LCD_disp_starting++;
				  									LcddispCnt++;
				  									if(LCD_disp_starting>=38)
				  										LCD_disp_starting=0;
				  									LcdLeftCnt=LCD_LEFT_CNT;
				  								}
				  								WDT_CONTR=0x3d;  //喂狗 1.13s;
				  							}
				  							player_Num(27);
				  							while(player_busy()==1)
				  							{
				  								if(LcdLeftCnt==0)
				  								{
				  									chn_left_disp1(disp_buf,1,34,LCD_disp_starting,0);
				  									LCD_disp_starting++;
				  									LCD_disp_starting++;
				  									LcddispCnt++;
				  									if(LCD_disp_starting>=38)
				  										LCD_disp_starting=0;
				  									LcdLeftCnt=LCD_LEFT_CNT;
				  								}
				  								WDT_CONTR=0x3d;  //喂狗 1.13s;
				  							}
				  							player_Num(28);
				  							player_Time(&Time[0],disp_buf,1,34,0);
				  							while(player_busy()==1)
				  							{
				  								if(LcdLeftCnt==0)
				  								{
				  									chn_left_disp1(disp_buf,1,34,LCD_disp_starting,0);
				  									LCD_disp_starting++;
				  									LCD_disp_starting++;
				  									LcddispCnt++;
				  									if(LCD_disp_starting>=38)
				  										LCD_disp_starting=0;
				  									LcdLeftCnt=LCD_LEFT_CNT;
				  								}
				  								WDT_CONTR=0x3d;  //喂狗 1.13s;
				  							}
				  							player_Num(29);
				  							for(j=0;j<Locatlen;j++)
				  							{
				  								while(player_busy()==1)
				  								{
				  									if(LcdLeftCnt==0)
				  									{
				  										chn_left_disp1(disp_buf,1,34,LCD_disp_starting,0);
				  										LCD_disp_starting++;
				  										LCD_disp_starting++;
				  										LcddispCnt++;
				  										if(LCD_disp_starting>=38)
				  											LCD_disp_starting=0;
				  										LcdLeftCnt=LCD_LEFT_CNT;
				  									}
				  									WDT_CONTR=0x3d;  //喂狗 1.13s;
				  								}
				  								player_Num(Locat[j]-48);
				  							}
				  							k=0xff;
				  				    	while((k==0xff)&&(LcddispCnt<31))   //等待有按键
				  				    	{
				  				    		WDT_CONTR=0x3d;  //喂狗 1.13s;
				  				    		if(LcdLeftCnt==0)
				  								{
				  									chn_left_disp1(disp_buf,1,34,LCD_disp_starting,0);
				  									LCD_disp_starting++;
				  									LCD_disp_starting++;
				  									LcddispCnt++;
				  									if(LCD_disp_starting>=38)
				  										LCD_disp_starting=0;
				  									LcdLeftCnt=LCD_LEFT_CNT;
				  								}
				  				    		k=KeyRd();
				  				    		fLcdPwr=LCD_ON;
				  				    		CntLcdOn=0;
				  				    	}
				  				    	delay1(10000);
				  	          }
		          			}
		          			break;
		          		case STAT5:		//上钟
		          			//if(8+WorkLen+QueryIDlen[0]==TRDataLen)
		          			{
		            		  clrram();
			      		      chn_disp(CorM01,0);
			      		      chn_disp(Menu67,1);
				  						img_disp(BmpNum1,1,0x92);
			      		      wr_lcd(comm,0x30);
			      	        wr_lcd(comm,0x82);
			      	        wr_lcd(dat,':');
			      	        wr_lcd(comm,0x30);
			      	        wr_lcd(comm,0x83);
			      	        for(j=0;j<QueryIDlen[0];j++)
			      	        {
			      	        	wr_lcd(dat,QueryID[0][j]);
			      	        }
				  						player_Num(23);
				  						for(j=0;j<QueryIDlen[0];j++)
				  						{
				  							player_Num(QueryID[0][j]-48);
				  						}
				  						player_Num(27);
			      	        delay1(40000);
	  	          			delay1(40000);
              			}
		          			break;
		          		case STAT6:		//临时报走
		          			//if(8+WorkLen+QueryIDlen[0]==TRDataLen)
		          			{
		            		  clrram();
			      		      chn_disp(CorM01,0);
			      		      chn_disp(Menu69,1);
			      		      wr_lcd(comm,0x30);
			      	        wr_lcd(comm,0x82);
			      	        wr_lcd(dat,':');
			      	        wr_lcd(comm,0x30);
			      	        wr_lcd(comm,0x83);
			      	        for(j=0;j<QueryIDlen[0];j++)
			      	        {
			      	        	wr_lcd(dat,QueryID[0][j]);
			      	        }
				  						player_Num(23);
				  						for(j=0;j<QueryIDlen[0];j++)
				  						{
				  							player_Num(QueryID[0][j]-48);
				  						}
				  						player_Num(30);
			      	        delay1(40000);
	  	          			delay1(40000);
              			}
		          			break;
		          		case STAT7:		//被锁定
		          			//if(8+WorkLen+QueryIDlen[0]==TRDataLen)
		          			{
		            		  clrram();
			      		      chn_disp(CorM01,0);
			      		      chn_disp(Menu70,1);
			      		      wr_lcd(comm,0x30);
			      	        wr_lcd(comm,0x82);
			      	        wr_lcd(dat,':');
			      	        wr_lcd(comm,0x30);
			      	        wr_lcd(comm,0x83);
			      	        for(j=0;j<QueryIDlen[0];j++)
			      	        {
			      	        	wr_lcd(dat,QueryID[0][j]);
			      	        }
				  						player_Num(23);
				  						for(j=0;j<QueryIDlen[0];j++)
				  						{
				  							player_Num(QueryID[0][j]-48);
				  						}
				  						player_Num(31);
			      	        delay1(40000);
	  	          			delay1(40000);
              			}
		          			break;
		          		case STAT8:		//被停牌
		          			//if(8+WorkLen+QueryIDlen[0]==TRDataLen)
		          			{
		            		  clrram();
			      		      chn_disp(CorM01,0);
			      		      chn_disp(Menu71,1);
			      		      wr_lcd(comm,0x30);
			      	        wr_lcd(comm,0x82);
			      	        wr_lcd(dat,':');
			      	        wr_lcd(comm,0x30);
			      	        wr_lcd(comm,0x83);
			      	        for(j=0;j<QueryIDlen[0];j++)
			      	        {
			      	        	wr_lcd(dat,QueryID[0][j]);
			      	        }
				  						player_Num(23);
				  						for(j=0;j<QueryIDlen[0];j++)
				  						{
				  							player_Num(QueryID[0][j]-48);
				  						}
				  						player_Num(32);
			      	        delay1(40000);
	  	          			delay1(40000);
              			}
		          			break;
		          		case STAT9:		//上钟,落钟时间HH:mm
		          			Time[0]=TRDataBuf[8+WorkLen+QueryIDlen[0]];
		          			Time[1]=TRDataBuf[9+WorkLen+QueryIDlen[0]];
		          			Time[2]=TRDataBuf[11+WorkLen+QueryIDlen[0]];
		          			Time[3]=TRDataBuf[12+WorkLen+QueryIDlen[0]];
		          			//if((TRDataBuf[13+WorkLen+QueryIDlen[0]]=='#')&&(14+WorkLen+QueryIDlen[0]==TRDataLen))
		          			{
		          				for(j=0;j<DISP_BUF_MAX;j++)
				  	          {
				  	          	disp_buf[j]=0;
				  	          }
				  	          for(j=0;j<24;j++)
		            			{
		            				disp_buf[j]=Menu72[j];
		            			}
		            			disp_buf[18]=Time[0];
		            			disp_buf[19]=Time[1];
		            			disp_buf[20]=':';
		            			disp_buf[21]=' ';
		            			disp_buf[22]=Time[2];
		            			disp_buf[23]=Time[3];
				  						LCD_disp_starting=0;
				  						LcddispCnt=0;
				  	          clrram();
				      		    chn_disp(CorM01,0);
				      	      wr_lcd(comm,0x30);
				      	      wr_lcd(comm,0x82);
				      	      wr_lcd(dat,':');
				      	      wr_lcd(comm,0x30);
				      	      wr_lcd(comm,0x83);
				      	      for(j=0;j<QueryIDlen[0];j++)
				      	      {
				      	      	wr_lcd(dat,QueryID[0][j]);
				      	      }
				      	      chn_left_disp1(disp_buf,1,24,LCD_disp_starting,0);
				  	          LCD_disp_starting++;
				  	          LCD_disp_starting++;
				  	          LcddispCnt++;
				  	          LcdLeftCnt=LCD_LEFT_CNT;
				  						player_stop=0;
			      	        while(player_busy()==1)
			      	        {
			      	        	if(LcdLeftCnt==0)
				  							{
				  								chn_left_disp1(disp_buf,1,24,LCD_disp_starting,0);
				  								LCD_disp_starting++;
				  								LCD_disp_starting++;
				  								LcddispCnt++;
				  								if(LCD_disp_starting>=28)
				  									LCD_disp_starting=0;
				  								LcdLeftCnt=LCD_LEFT_CNT;
				  							}
			      	        	WDT_CONTR=0x3d;  //喂狗 1.13s;
			      	        }
				  						player_Num(23);
				  						for(j=0;j<QueryIDlen[0];j++)
				  						{
				  							while(player_busy()==1)
				  							{
				  								if(LcdLeftCnt==0)
				  								{
				  									chn_left_disp1(disp_buf,1,24,LCD_disp_starting,0);
				  									LCD_disp_starting++;
				  									LCD_disp_starting++;
				  									LcddispCnt++;
				  									if(LCD_disp_starting>=28)
				  										LCD_disp_starting=0;
				  									LcdLeftCnt=LCD_LEFT_CNT;
				  								}
				  								WDT_CONTR=0x3d;  //喂狗 1.13s;
				  							}
				  							player_Num(QueryID[0][j]-48);
				  						}
				  						while(player_busy()==1)
				  						{
				  							if(LcdLeftCnt==0)
				  							{
				  								chn_left_disp1(disp_buf,1,24,LCD_disp_starting,0);
				  								LCD_disp_starting++;
				  								LCD_disp_starting++;
				  								LcddispCnt++;
				  								if(LCD_disp_starting>=28)
				  									LCD_disp_starting=0;
				  								LcdLeftCnt=LCD_LEFT_CNT;
				  							}
				  							WDT_CONTR=0x3d;  //喂狗 1.13s;
				  						}
				  						player_Num(27);
				  						while(player_busy()==1)
				  						{
				  							if(LcdLeftCnt==0)
				  							{
				  								chn_left_disp1(disp_buf,1,24,LCD_disp_starting,0);
				  								LCD_disp_starting++;
				  								LCD_disp_starting++;
				  								LcddispCnt++;
				  								if(LCD_disp_starting>=28)
				  									LCD_disp_starting=0;
				  								LcdLeftCnt=LCD_LEFT_CNT;
				  							}
				  							WDT_CONTR=0x3d;  //喂狗 1.13s;
				  						}
				  						player_Num(28);
				  						player_Time(&Time[0],disp_buf,1,24,0);
			      	        k=0xff;
				  				    while((k==0xff)&&(LcddispCnt<21))   //等待有按键
				  				    {
				  				    	WDT_CONTR=0x3d;  //喂狗 1.13s;
				  				    	if(LcdLeftCnt==0)
				  							{
				  								chn_left_disp1(disp_buf,1,24,LCD_disp_starting,0);
				  								LCD_disp_starting++;
				  								LCD_disp_starting++;
				  								LcddispCnt++;
				  								if(LCD_disp_starting>=28)
				  									LCD_disp_starting=0;
				  								LcdLeftCnt=LCD_LEFT_CNT;
				  							}
				  				    	k=KeyRd();
				  				    	fLcdPwr=LCD_ON;
				  				    	CntLcdOn=0;
				  				    }
				  				    delay1(10000);
	  	          		}
		          			break;
		          		case STAT0:		//上钟 位置XXX
		          			Locatlen=0;
				  	        for(k=0;k<7;k++)
				  	        {
				  	        	Locat[k]=TRDataBuf[8+WorkLen+QueryIDlen[0]+k];
				  	        	if(Locat[k]!='#')Locatlen++;
				  	         	else break;
				  	        }
				  	        //if((TRDataBuf[8+WorkLen+QueryIDlen[0]+Locatlen]=='#')&&(9+WorkLen+QueryIDlen[0]+Locatlen==TRDataLen))
				  	        {
				  	        	for(j=0;j<DISP_BUF_MAX;j++)
				  	          {
				  	          	disp_buf[j]=0;
				  	          }
				  	          for(j=0;j<20;j++)
		            			{
		            				disp_buf[j]=Menu73[j];
		            			}
		            			for(j=0;j<Locatlen;j++)
		            			{
		            				disp_buf[14+j]=Locat[j];
		            			}
				  						LCD_disp_starting=0;
				  						LcddispCnt=0;
				  	          clrram();
				      		    chn_disp(CorM01,0);
				      	      wr_lcd(comm,0x30);
				      	      wr_lcd(comm,0x82);
				      	      wr_lcd(dat,':');
				      	      wr_lcd(comm,0x30);
				      	      wr_lcd(comm,0x83);
				      	      for(j=0;j<QueryIDlen[0];j++)
				      	      {
				      	      	wr_lcd(dat,QueryID[0][j]);
				      	      }
				      	      chn_left_disp1(disp_buf,1,20,LCD_disp_starting,0);
				  	          LCD_disp_starting++;
				  	          LCD_disp_starting++;
				  	          LcddispCnt++;
				  	          LcdLeftCnt=LCD_LEFT_CNT;
				  						player_stop=0;
			      	        while(player_busy()==1)
			      	        {
			      	        	if(LcdLeftCnt==0)
				  							{
				  								chn_left_disp1(disp_buf,1,20,LCD_disp_starting,0);
				  								LCD_disp_starting++;
				  								LCD_disp_starting++;
				  								LcddispCnt++;
				  								if(LCD_disp_starting>=24)
				  									LCD_disp_starting=0;
				  								LcdLeftCnt=LCD_LEFT_CNT;
				  							}
			      	        	WDT_CONTR=0x3d;  //喂狗 1.13s;
			      	        }
				  						player_Num(23);
				  						for(j=0;j<QueryIDlen[0];j++)
				  						{
				  							while(player_busy()==1)
				  							{
				  								if(LcdLeftCnt==0)
				  								{
				  									chn_left_disp1(disp_buf,1,20,LCD_disp_starting,0);
				  									LCD_disp_starting++;
				  									LCD_disp_starting++;
				  									LcddispCnt++;
				  									if(LCD_disp_starting>=24)
				  										LCD_disp_starting=0;
				  									LcdLeftCnt=LCD_LEFT_CNT;
				  								}
				  								WDT_CONTR=0x3d;  //喂狗 1.13s;
				  							}
				  							player_Num(QueryID[0][j]-48);
				  						}
				  						while(player_busy()==1)
				  						{
				  							if(LcdLeftCnt==0)
				  							{
				  								chn_left_disp1(disp_buf,1,20,LCD_disp_starting,0);
				  								LCD_disp_starting++;
				  								LCD_disp_starting++;
				  								LcddispCnt++;
				  								if(LCD_disp_starting>=24)
				  									LCD_disp_starting=0;
				  								LcdLeftCnt=LCD_LEFT_CNT;
				  							}
				  							WDT_CONTR=0x3d;  //喂狗 1.13s;
				  						}
				  						player_Num(27);
				  						while(player_busy()==1)
				  						{
				  							if(LcdLeftCnt==0)
				  							{
				  								chn_left_disp1(disp_buf,1,20,LCD_disp_starting,0);
				  								LCD_disp_starting++;
				  								LCD_disp_starting++;
				  								LcddispCnt++;
				  								if(LCD_disp_starting>=24)
				  									LCD_disp_starting=0;
				  								LcdLeftCnt=LCD_LEFT_CNT;
				  							}
				  							WDT_CONTR=0x3d;  //喂狗 1.13s;
				  						}
				  						player_Num(29);
				  						for(j=0;j<Locatlen;j++)
				  						{
				  							while(player_busy()==1)
				  							{
				  								if(LcdLeftCnt==0)
				  								{
				  									chn_left_disp1(disp_buf,1,20,LCD_disp_starting,0);
				  									LCD_disp_starting++;
				  									LCD_disp_starting++;
				  									LcddispCnt++;
				  									if(LCD_disp_starting>=24)
				  										LCD_disp_starting=0;
				  									LcdLeftCnt=LCD_LEFT_CNT;
				  								}
				  								WDT_CONTR=0x3d;  //喂狗 1.13s;
				  							}
				  							player_Num(Locat[j]-48);
				  						}
			      	        k=0xff;
				  				    while((k==0xff)&&(LcddispCnt<17))   //等待有按键
				  				    {
				  				    	WDT_CONTR=0x3d;  //喂狗 1.13s;
				  				    	if(LcdLeftCnt==0)
				  							{
				  								chn_left_disp1(disp_buf,1,20,LCD_disp_starting,0);
				  								LCD_disp_starting++;
				  								LCD_disp_starting++;
				  								LcddispCnt++;
				  								if(LCD_disp_starting>=24)
				  									LCD_disp_starting=0;
				  								LcdLeftCnt=LCD_LEFT_CNT;
				  							}
				  				    	k=KeyRd();
				  				    	fLcdPwr=LCD_ON;
				  				    	CntLcdOn=0;
				  				    }
				  				    delay1(10000);
				  	        }
		          			break;
		          		default:
		          			break;
		          	}
		          }
		          else
		          {
		          	chn_disp(ErrM12,1);
				  			player_Num(45);
				  			
	  	      		delay1(40000);
		          }
          	}
          }
          else if((TRDataBuf[0]=='8')&&(TRDataBuf[1]=='#')&&(TRDataBuf[2]==IndexSend+48)&&(TRDataBuf[3]=='#')&&(TRDataBuf[4]=='e')&&(TRDataBuf[5]=='#'))
          {
          	chn_disp(ErrM03,1);
				  	player_Num(33);
				  	player_Num(11);
          	delay1(40000);
          }
          else
          {
          	chn_disp(ErrM12,1);
				  	player_Num(45);
				  	
          	delay1(40000);
          }
        }
        else
        {
         	staComRx=COM_RX_NONE;
         	player_Num(45);
         	if(k==COM_ERR_SER)  //服务器无响应
         	{
   	        chn_disp(ErrM11,1);
   	      	delay1(40000);
         	}
         	else if(k==COM_ERR_COR)   //协调器无响应
         	{
   	        chn_disp(ErrM10,1);
   	      	delay1(40000);
         	}
         	else;
        }
        KeyCLr();
      }
      break;
      case FUN11:				//功能11:通知
			{
    	  KeyCLr();
				clrram();
				player_Num(34);
				delay1(2000);
	  		chn_disp(Menu75,0);
	  		chn_disp(Menu36,1);
				player_Num(QSK);
	  		RFID_GetID();
	  	  PinRfs=1;
	  	  if((fOvTime==1)||(fCancel==1))break;
				player_Num(53);
	  	  delay1(2000);
	  	  TRDataBuf[0]='1';
	  	  TRDataBuf[1]='#';
	  	  IndexSend++;
	  	  IndexSend%=10;
	  	  TRDataBuf[2]=IndexSend+48;
	  	  TRDataBuf[3]='#';
	  	  for(i=0;i<10;i++)
	  	  {
	  	  	TRDataBuf[4+i]=idbuf[i];
	  	  }
	  	  TRDataBuf[14]='#';
				///////////////////////////////////////////////////////////////
				clrram();
	  		chn_disp(Menu08,0);
	  		chn_disp(Null00,1);
	  		wr_lcd(comm,0x30);
	  	  wr_lcd(comm,0x92);
	  	  for(k=0;k<6;k++)
	  	  {
	  	  	wr_lcd(dat,'-');
	  	  }
				player_Num(QAJ);
	  		CntOv1s=0;
	  	  fOvTime=0;
	  	  fCancel=0;
	  	  i=0;
	  	  fFirstEnt=1;
	  	  for(j=0;j<7;j++)
	  	  {
	  	  	fOvTime=0;
	  	  	i=KeyRd();
	  	  	while(i>0x0b)
	  	  	{
	  	  		WDT_CONTR=0x3d;  //喂狗 1.13s;
	  	  		i=KeyRd();
	  	  		if(j==6)
		  			{
		  				if((i!=0x0b)&&(i!=0x0a))
		  					i=0xFF;
		  			}
	  			  if(CntOv1s<=KEY_OVERTIME)
	  		    {
	  		    	Lcd_overtime(KEY_OVERTIME-CntOv1s,0);
	  		    }
	  		    else
	  		    {
	  		    	fOvTime=1;
							player_Num(54);
							player_Num(55);
	  		    	break;
	  		    }
	  	  	}
	  	  	CntOv1s=0;
	  	    //fOvTime=0;
	  	  	if(i==0x0a||fOvTime==1)       //*取消
	  	  	{
	  	  		fCancel=1;
	  	  		break;
	  	  	}
	  	  	else if(i==0x0b&&j==0) //没输入数据直接按#也是取消
	  	  	{
	  	  		fCancel=1;
	  	  		break;
	  	  	}
	  	  	else if(i==0x0b&&j>0)
	  	  	{
	  	  		fCancel=0;
	  	  		CostLen=0;
	  	  		for(k=0;k<7;k++)
	  	  		{
	  	  			if(CostId[k]!='#')CostLen++;
		          else break;
	  	  		}
	  	  		break;
	  	  	}
	  	  	else
	  	  	{
	  	  		if(fFirstEnt==1)
	  	  		{
	  	  			wr_lcd(comm,0x30);
	  	  		  wr_lcd(comm,0x92);
	  	  			for(k=0;k<6;k++)
	  	  		  {
	  	  		  	wr_lcd(dat,'-');
	  	  		  }
	  	  		  fFirstEnt=0;
	  	  		  wr_lcd(comm,0x30);
	  	  		  wr_lcd(comm,0x92);
	  	  		}
	  	  		CostId[j]=i+48;
	  	  		CostId[j+1]='#';
	  	  		wr_lcd(comm,0x30);
	  	  		wr_lcd(comm,0x92);
	  	  		for(k=0;k<=j;k++)
	  	  		{
	  	  			wr_lcd(dat,CostId[k]);
	  	  		}
	  	  		//if(j==5)
	  	  		//{
	  	  		//	j=4;
	  	  		//}
	  	  	}
	  	  }
	  	  if(fCancel==1)
	  	  {
	  	  	LcdDisIniIn();
	  	  	break;
	  	  }
	  	  ///////////////////////////////////////////////////////////////
	  	  for(j=0;j<DISP_BUF_MAX;j++)
				{
					disp_buf[j]=0;
				}
				for(j=0;j<22;j++)
			  {
			  	disp_buf[j]=Menu38[j];
			  }
			  LCD_disp_starting=0;
	  	  clrram();
	  		chn_disp(Menu75,0);
	  		chn_left_disp(disp_buf,1,22,LCD_disp_starting);
	  		LCD_disp_starting++;
		    LCD_disp_starting++;
		    LcdLeftCnt=LCD_LEFT_CNT;
	  		player_stop=0;
    		while(player_busy()==1)
    		{
    			if(LcdLeftCnt==0)
					{
						chn_left_disp(disp_buf,1,22,LCD_disp_starting);
						LCD_disp_starting++;
						LCD_disp_starting++;
						if(LCD_disp_starting>=26)
							LCD_disp_starting=0;
						LcdLeftCnt=LCD_LEFT_CNT;
					}
    			WDT_CONTR=0x3d;  //喂狗 1.13s;
    		}
				player_Num(QXZ);
	  		CntOv1s=0;
	  	  fOvTime=0;
	  	  fCancel=0;
	  	  i=0;
	  		while((i!=0x04)&&(i!=0x05)&&(i!=0x0a))
	  	  {
	  	  	WDT_CONTR=0x3d;  //喂狗 1.13s;
	  	  	i=KeyRd();
	  		  if(CntOv1s<=KEY_OVERTIME)
	  		  {
	  		  	if(LcdLeftCnt==0)
						{
							chn_left_disp(disp_buf,1,22,LCD_disp_starting);
							LCD_disp_starting++;
							LCD_disp_starting++;
							if(LCD_disp_starting>=26)
								LCD_disp_starting=0;
							LcdLeftCnt=LCD_LEFT_CNT;
						}
	  		   	Lcd_overtime(KEY_OVERTIME-CntOv1s,0);
	  		  }
	  		  else
	  		  {
	  		   	fOvTime=1;
						player_Num(54);
						player_Num(55);
	  		   	break;
	  		  }
	  	  }
	  	  if(i==0x0a||fOvTime==1)       //*取消
	  	  {
	  	  	fCancel=1;
	  	  	break;
	  	  }
	  	  else if((i==0x04)||(i==0x05))
	  	  {
	  	  	male_female=i;
	  	  }
	  	  else
	  	  {
	  	  	fCancel=1;
	  	  	break;
	  	  }
	  	  if(fCancel==1)
	  	  {
	  	  	LcdDisIniIn();
	  	  	break;
	  	  }
	  	  ///////////////////////////////////////////////////////////////
	  		clrram();
	  		chn_disp(Menu75,0);
	  		chn_disp(Menu39,1);
			  img_disp(BmpNum,1,0x93);
	  		wr_lcd(comm,0x30);
	  	  wr_lcd(comm,0x95);
	  	  wr_lcd(dat,':');
	  	  wr_lcd(comm,0x30);
	  	  wr_lcd(comm,0x96);
	  	  for(k=0;k<2;k++)
	  	  {
	  	  	wr_lcd(dat,'-');
	  	  }
				player_Num(QAJ);
	  		CntOv1s=0;
	  	  fOvTime=0;
	  	  fCancel=0;
	  	  i=0;
	  	  fFirstEnt=1;
	  	  for(j=0;j<3;j++)
	  	  {
	  	  	fOvTime=0;
	  	  	i=KeyRd();
	  	  	while(i>0x0b)
	  	  	{
	  	  		WDT_CONTR=0x3d;  //喂狗 1.13s;
	  	  		i=KeyRd();
	  	  		if(j==2)
		  			{
		  				if((i!=0x0b)&&(i!=0x0a))
		  					i=0xFF;
		  			}
	  			  if(CntOv1s<=KEY_OVERTIME)
	  		    {
	  		    	Lcd_overtime(KEY_OVERTIME-CntOv1s,0);
	  		    }
	  		    else
	  		    {
	  		    	fOvTime=1;
							player_Num(54);
							player_Num(55);
	  		    	break;
	  		    }
	  	  	}
	  	  	CntOv1s=0;
	  	    //fOvTime=0;
	  	  	if(i==0x0a||fOvTime==1)       //*取消
	  	  	{
	  	  		fCancel=1;
	  	  		break;
	  	  	}
	  	  	else if(i==0x0b&&j==0) //没输入数据直接按#也是取消
	  	  	{
	  	  		fCancel=1;
	  	  		break;
	  	  	}
	  	  	else if(i==0x0b&&j>0)
	  	  	{
	  	  		fCancel=0;
	  	  		Numlen=0;
	  	  		for(k=0;k<7;k++)
	  	  		{
	  	  			if(Num[k]!='#')Numlen++;
		          else break;
	  	  		}
	  	  		break;
	  	  	}
	  	  	else
	  	  	{
	  	  		if(fFirstEnt==1)
	  	  		{
	  	  			wr_lcd(comm,0x30);
	  	  		  wr_lcd(comm,0x95);
	  	  		  wr_lcd(dat,':');
	  	  		  wr_lcd(comm,0x30);
	  	  		  wr_lcd(comm,0x96);
	  	  			for(k=0;k<2;k++)
	  	  		  {
	  	  		  	wr_lcd(dat,'-');
	  	  		  }
	  	  		  fFirstEnt=0;
	  	  		}
	  	  		Num[j]=i+48;
	  	  		Num[j+1]='#';
	  	  		wr_lcd(comm,0x30);
	  	  		wr_lcd(comm,0x96);
	  	  		for(k=0;k<=j;k++)
	  	  		{
	  	  			wr_lcd(dat,Num[k]);
	  	  		}
	  	  		//if(j==1)
	  	  		//{
	  	  		//	j=0;
	  	  		//}
	  	  	}
	  	  }
	  	  if(fCancel==1)
	  	  {
	  	  	LcdDisIniIn();
	  	  	break;
	  	  }
	  	  ///////////////////////////////////////////////////////////////
	  	  for(i=0;i<CostLen;i++)
	  	  {
	  	  	TRDataBuf[15+i]=CostId[i];
	  	  }
	  	  TRDataBuf[15+CostLen]='#';
	  	  TRDataBuf[16+CostLen]=male_female+48;
	  	  TRDataBuf[17+CostLen]='#';
	  	  for(i=0;i<Numlen;i++)
	  	  {
	  	  	TRDataBuf[18+CostLen+i]=Num[i];
	  	  }
	  	  TRDataBuf[18+CostLen+Numlen]='#';
	  	  for(i=0;i<RoomLen;i++)
	  	  {
	  	  	TRDataBuf[19+CostLen+Numlen+i]=RoomId[i];
	  	  }
	  	  TRDataBuf[19+CostLen+Numlen+RoomLen]='#';
	  	  //for(i=0;i<100;i++)
	  	  //	TRDataBuf_buf[i]=0x00;
	  	  //for(i=0;i<100;i++)
	  	  //	TRDataBuf_buf[i]=TRDataBuf[i];
	  	  //TXDataLen_buf=20+CostLen+Numlen+RoomLen;
		    clrram();
	  		chn_disp(Menu75,0);
	  		chn_disp(Null00,1);
 		    if(fCancel==1)
        {
        	LcdDisIniIn();
        	break;
        }
		    ///////////////////////////////////////////////////////////////
		    ///////////////////////////////////////////////////////////////
   	    //WIFISendData(TRDataBuf,TXDataLen_buf);
   	    k=0;
   	    fOvTime=0;
   	    fCancel=0;
   	    k=comTrCommand(TRDataBuf,20+CostLen+Numlen+RoomLen);  //发送指令
   	    if(k==COM_NO_ERR)  //成功接收数据
   	    {
   	    	for(i=6;i<(comRxLength-1);i++)TRDataBuf[i-6]=comRxDataBuf[i];
          TRDataBuf[comRxLength-7]=0;
          if((TRDataBuf[0]=='1')&&(TRDataBuf[1]=='#')&&(TRDataBuf[2]==IndexSend+48)&&(TRDataBuf[3]=='#')&&(TRDataBuf[4]!='e'))
          {
          	WorkLen=0;
          	for(k=0;k<7;k++)
	          {
	          	WorkId[k]=TRDataBuf[4+k];
	          	if(WorkId[k]!='#')WorkLen++;
	          	else break;
	          }
	          //if((TRDataBuf[4+WorkLen]=='#')&&(WorkLen+5==TRDataLen))
	          {
	          	clrram();
	  		      chn_disp(CorM02,0);
	  		      chn_disp(Menu40,1);
	  		      wr_lcd(comm,0x30);
	  	        wr_lcd(comm,0x82);
	  	        wr_lcd(dat,':');
	  	        wr_lcd(comm,0x30);
	  	        wr_lcd(comm,0x83);
	  	        for(j=0;j<WorkLen;j++)
	  	        {
	  	        	wr_lcd(dat,WorkId[j]);
	  	        }
				  		player_Num(34);
				  		player_Num(10);
				  		Notice_operat_flag=1;
	  	        delay1(40000);
	  	        delay1(40000);
	          }
          }
          else if((TRDataBuf[0]=='1')&&(TRDataBuf[1]=='#')&&(TRDataBuf[2]==IndexSend+48)&&(TRDataBuf[3]=='#')&&(TRDataBuf[4]=='e')&&(TRDataBuf[5]=='#'))
          {
          	chn_disp(ErrM03,1);
				  	player_Num(34);
				  	player_Num(11);
          	delay1(40000);
          }
          else
          {
          	chn_disp(ErrM12,1);
				  	player_Num(45);
				  	
          	delay1(40000);
          }
        }
        else
        {
         	staComRx=COM_RX_NONE;
         	player_Num(45);
         	if(k==COM_ERR_SER)  //服务器无响应
         	{
   	        chn_disp(ErrM11,1);
   	      	delay1(40000);
         	}
         	else if(k==COM_ERR_COR)   //协调器无响应
         	{
   	        chn_disp(ErrM10,1);
   	      	delay1(40000);
         	}
         	else;
        }
      }
			break;
			case FUN12:				//功能12:派工
			{
				clrram();
				KeyCLr();
    	  chn_disp(Menu76,0);
    	  chn_disp(Menu36,1);
				player_Num(35);
				player_Num(QSK);
    	  RFID_GetID();
        PinRfs=1;
        if((fOvTime==1)||(fCancel==1))break;
				player_Num(53);
        delay1(2000);
        TRDataBuf[0]='2';
        TRDataBuf[1]='#';
        IndexSend++;
        IndexSend%=10;
        TRDataBuf[2]=IndexSend+48;
        TRDataBuf[3]='#';
        for(i=0;i<10;i++)
        {
        	TRDataBuf[4+i]=idbuf[i];
        }
        TRDataBuf[14]='#';
        ///////////////////////////////////////////////////////////////
        fOvTime=0;
				fCancel=0;
				if(fProSelect==0x04)
				{
					clrram();
    	    chn_disp(Menu76,0);
    	    chn_disp(Menu18,1);
				  player_Num(QSK);
    	    for(i=0;i<3;i++)
          {
          	delay1(10000);
          	RFID_GetID();
            if((fOvTime==1)||(fCancel==1))break;
            k=0;
            for(j=0;j<10;j++)
            {
            	if(idbuf[j]!=TRDataBuf[4+j])
            	{
            		k++;
            	}
            }
            PinRfs=1;
            if(k>0)
            {
            	fOvTime=0;
				  		player_Num(53);
            	break;
            }
            fOvTime=1;
				  	player_Num(53);
				  	player_Num(53);
				  	player_Num(53);
				  	player_Num(53);
          }
          PinRfs=1;
        }
        if((fOvTime==1)||(fCancel==1))break;
        for(i=0;i<10;i++)
        {
        	TRDataBuf[15+i]=idbuf[i];
        }
        TRDataBuf[25]='#';
				///////////////////////////////////////////////////////////////
				clrram();
    	  chn_disp(Menu08,0);
    	  chn_disp(Null00,1);
    	  wr_lcd(comm,0x30);
      	wr_lcd(comm,0x92);
      	for(k=0;k<6;k++)
      	{
      		wr_lcd(dat,'-');
      	}
				player_Num(QAJ);
    	  CntOv1s=0;
        fOvTime=0;
        fCancel=0;
        i=0;
        fFirstEnt=1;
      	for(j=0;j<7;j++)
      	{
      		fOvTime=0;
      		i=KeyRd();
      		while(i>0x0b)
      		{
      			WDT_CONTR=0x3d;  //喂狗 1.13s;
      			i=KeyRd();
      			if(j==6)
	  				{
	  					if((i!=0x0b)&&(i!=0x0a))
	  						i=0xFF;
	  				}
    	  	  if(CntOv1s<=KEY_OVERTIME)
    		    {
    		    	Lcd_overtime(KEY_OVERTIME-CntOv1s,0);
    		    }
    		    else
    		    {
    		    	fOvTime=1;
							player_Num(54);
							player_Num(55);
    		    	break;
    		    }
      		}
      		CntOv1s=0;
          //fOvTime=0;
      		if(i==0x0a||fOvTime==1)       //*取消
      		{
      			fCancel=1;
      			break;
      		}
      		else if(i==0x0b&&j==0) //没输入数据直接按#也是取消
      		{
      			fCancel=1;
      			break;
      		}
      		else if(i==0x0b&&j>0)
      		{
      			fCancel=0;
      			CostLen=0;
      			for(k=0;k<7;k++)
      			{
      				if(CostId[k]!='#')CostLen++;
		          else break;
      			}
      			break;
      		}
      		else
      		{
      			if(fFirstEnt==1)
      			{
      				wr_lcd(comm,0x30);
      			  wr_lcd(comm,0x92);
      				for(k=0;k<6;k++)
      			  {
      			  	wr_lcd(dat,'-');
      			  }
      			  fFirstEnt=0;
      			}
      			CostId[j]=i+48;
      			CostId[j+1]='#';
      			wr_lcd(comm,0x30);
      			wr_lcd(comm,0x92);
      			for(k=0;k<=j;k++)
      			{
      				wr_lcd(dat,CostId[k]);
      			}
      			//if(j==5)
      			//{
      			//	j=4;
      			//}
      		}
      	}
        if(fCancel==1)
        {
        	LcdDisIniIn();
        	break;
        }
        ///////////////////////////////////////////////////////////////
        clrram();
        chn_disp(Menu41,0);
    	  chn_disp(Null00,1);
    	  wr_lcd(comm,0x30);
      	wr_lcd(comm,0x92);
      	for(k=0;k<6;k++)
      	{
      		wr_lcd(dat,'-');
      	}
				player_Num(QAJ);
    	  CntOv1s=0;
        fOvTime=0;
        fCancel=0;
        i=0;
        fFirstEnt=1;
      	for(j=0;j<7;j++)
      	{
      		fOvTime=0;
      		i=KeyRd();
      		while(i>0x0b)
      		{
      			WDT_CONTR=0x3d;  //喂狗 1.13s;
      			i=KeyRd();
      			if(j==6)
	  				{
	  					if((i!=0x0b)&&(i!=0x0a))
	  						i=0xFF;
	  				}
    	  	  if(CntOv1s<=KEY_OVERTIME)
    		    {
    		    	Lcd_overtime(KEY_OVERTIME-CntOv1s,0);
    		    }
    		    else
    		    {
    		    	fOvTime=1;
							player_Num(54);
							player_Num(55);
    		    	break;
    		    }
      		}
      		CntOv1s=0;
          //fOvTime=0;
      		if(i==0x0a||fOvTime==1)       //*取消
      		{
      			fCancel=1;
      			break;
      		}
      		else if(i==0x0b&&j==0) //没输入数据直接按#也是取消
      		{
      			fCancel=1;
      			break;
      		}
      		else if(i==0x0b&&j>0)
      		{
      			fCancel=0;
      			WorkLen=0;
      			for(k=0;k<7;k++)
      			{
      				if(WorkId[k]!='#')WorkLen++;
		          else break;
      			}
      			break;
      		}
      		else
      		{
      			if(fFirstEnt==1)
      			{
      				wr_lcd(comm,0x30);
      			  wr_lcd(comm,0x92);
      				for(k=0;k<6;k++)
      			  {
      			  	wr_lcd(dat,'-');
      			  }
      			  fFirstEnt=0;
      			}
      			WorkId[j]=i+48;
      			WorkId[j+1]='#';
      			wr_lcd(comm,0x30);
      			wr_lcd(comm,0x92);
      			for(k=0;k<=j;k++)
      			{
      				wr_lcd(dat,WorkId[k]);
      			}
      			//if(j==5)
      			//{
      			//	j=4;
      			//}
      		}
      	}
        if(fCancel==1)
        {
        	LcdDisIniIn();
        	break;
        }
        ///////////////////////////////////////////////////////////////
        for(j=0;j<DISP_BUF_MAX;j++)
				{
					disp_buf[j]=0;
				}
				for(j=0;j<32;j++)
				{
					disp_buf[j]=Menu44[j];
				}
        LCD_disp_starting=0;
        clrram();
    	  chn_disp(Menu43,0);
    	  chn_left_disp(disp_buf,1,32,LCD_disp_starting);
    	  LCD_disp_starting++;
	      LCD_disp_starting++;
	      LcdLeftCnt=LCD_LEFT_CNT;
    	  player_stop=0;
	  		while(player_busy()==1)
	  		{
	  			if(LcdLeftCnt==0)
					{
						chn_left_disp(disp_buf,1,32,LCD_disp_starting);
						LCD_disp_starting++;
						LCD_disp_starting++;
						if(LCD_disp_starting>=36)
							LCD_disp_starting=0;
						LcdLeftCnt=LCD_LEFT_CNT;
					}
	  			WDT_CONTR=0x3d;  //喂狗 1.13s;
				}
				player_Num(QXZ);
    	  CntOv1s=0;
        fOvTime=0;
        fCancel=0;
        i=0;
    	  while(((i<0x04)||(i>0x08))&&(i!=0x0a))
      	{
      		WDT_CONTR=0x3d;  //喂狗 1.13s;
      		i=KeyRd();
    	    if(CntOv1s<=KEY_OVERTIME)
    		  {
    		  	if(LcdLeftCnt==0)
						{
							chn_left_disp(disp_buf,1,32,LCD_disp_starting);
							LCD_disp_starting++;
							LCD_disp_starting++;
							if(LCD_disp_starting>=36)
								LCD_disp_starting=0;
							LcdLeftCnt=LCD_LEFT_CNT;
						}
    		   	Lcd_overtime(KEY_OVERTIME-CntOv1s,0);
    		  }
    		  else
    		  {
    		   	fOvTime=1;
						player_Num(54);
						player_Num(55);
    		   	break;
    		  }
      	}
      	if(i==0x0a||fOvTime==1)       //*取消
      	{
      		fCancel=1;
      		break;
      	}
      	else if((i>=0x04)&&(i<=0x08))
      	{
      		Type_clock=i;
      	}
      	else
      	{
      		fCancel=1;
      		break;
      	}
      	if(fCancel==1)
        {
        	LcdDisIniIn();
        	break;
        }
        ///////////////////////////////////////////////////////////////
        switch(Type_clock)
        {
        	case 0x04:				//轮钟
        	  clrram();
		  		  chn_disp(Menu45,0);
		  		  chn_disp(Menu50,1);
						player_Num(QQR);
		  		  CntOv1s=0;
		  	    fOvTime=0;
		  	    fCancel=0;
		  	    i=0;
		  		  while((i!=0x0b)&&(i!=0x0a))
		  	  	{
		  	  		WDT_CONTR=0x3d;  //喂狗 1.13s;
		  	  		i=KeyRd();
		  		    if(CntOv1s<=KEY_OVERTIME)
		  			  {
		  			   	Lcd_overtime(KEY_OVERTIME-CntOv1s,0);
		  			  }
		  			  else
		  			  {
		  			   	fOvTime=1;
								player_Num(54);
								player_Num(55);
		  			   	break;
		  			  }
		  	  	}
		  	  	if(i==0x0a||fOvTime==1)       //*取消
		  	  	{
		  	  		fCancel=1;
		  	  		break;
		  	  	}
        		break;
        	case 0x05:					//跳牌
        		clrram();
		  		  chn_disp(Menu46,0);
		  		  chn_disp(Menu50,1);
						player_Num(QQR);
		  		  CntOv1s=0;
		  	    fOvTime=0;
		  	    fCancel=0;
		  	    i=0;
		  		  while((i!=0x0b)&&(i!=0x0a))
		  	  	{
		  	  		WDT_CONTR=0x3d;  //喂狗 1.13s;
		  	  		i=KeyRd();
		  		    if(CntOv1s<=KEY_OVERTIME)
		  			  {
		  			   	Lcd_overtime(KEY_OVERTIME-CntOv1s,0);
		  			  }
		  			  else
		  			  {
		  			   	fOvTime=1;
								player_Num(54);
								player_Num(55);
		  			   	break;
		  			  }
		  	  	}
		  	  	if(i==0x0a||fOvTime==1)       //*取消
		  	  	{
		  	  		fCancel=1;
		  	  		break;
		  	  	}
        		break;
        	case 0x06:					//点钟
        		clrram();
		  		  chn_disp(Menu47,0);
		  		  chn_disp(Menu50,1);
						player_Num(QQR);
		  		  CntOv1s=0;
		  	    fOvTime=0;
		  	    fCancel=0;
		  	    i=0;
		  		  while((i!=0x0b)&&(i!=0x0a))
		  	  	{
		  	  		WDT_CONTR=0x3d;  //喂狗 1.13s;
		  	  		i=KeyRd();
		  		    if(CntOv1s<=KEY_OVERTIME)
		  			  {
		  			   	Lcd_overtime(KEY_OVERTIME-CntOv1s,0);
		  			  }
		  			  else
		  			  {
		  			   	fOvTime=1;
								player_Num(54);
								player_Num(55);
		  			   	break;
		  			  }
		  	  	}
		  	  	if(i==0x0a||fOvTime==1)       //*取消
		  	  	{
		  	  		fCancel=1;
		  	  		break;
		  	  	}
        		break;
        	case 0x07:					//留牌
        		clrram();
		  		  chn_disp(Menu48,0);
		  		  chn_disp(Menu50,1);
						player_Num(QQR);
		  		  CntOv1s=0;
		  	    fOvTime=0;
		  	    fCancel=0;
		  	    i=0;
		  		  while((i!=0x0b)&&(i!=0x0a))
		  	  	{
		  	  		WDT_CONTR=0x3d;  //喂狗 1.13s;
		  	  		i=KeyRd();
		  		    if(CntOv1s<=KEY_OVERTIME)
		  			  {
		  			   	Lcd_overtime(KEY_OVERTIME-CntOv1s,0);
		  			  }
		  			  else
		  			  {
		  			   	fOvTime=1;
								player_Num(54);
								player_Num(55);
		  			   	break;
		  			  }
		  	  	}
		  	  	if(i==0x0a||fOvTime==1)       //*取消
		  	  	{
		  	  		fCancel=1;
		  	  		break;
		  	  	}
        		break;
        	case 0x08:					//Call钟
        		clrram();
		  		  chn_disp(Menu49,0);
		  		  chn_disp(Menu50,1);
						player_Num(QQR);
		  		  CntOv1s=0;
		  	    fOvTime=0;
		  	    fCancel=0;
		  	    i=0;
		  		  while((i!=0x0b)&&(i!=0x0a))
		  	  	{
		  	  		WDT_CONTR=0x3d;  //喂狗 1.13s;
		  	  		i=KeyRd();
		  		    if(CntOv1s<=KEY_OVERTIME)
		  			  {
		  			   	Lcd_overtime(KEY_OVERTIME-CntOv1s,0);
		  			  }
		  			  else
		  			  {
		  			   	fOvTime=1;
								player_Num(54);
								player_Num(55);
		  			   	break;
		  			  }
		  	  	}
		  	  	if(i==0x0a||fOvTime==1)       //*取消
		  	  	{
		  	  		fCancel=1;
		  	  		break;
		  	  	}
        		break;
        	default : 
        		fCancel=1;
    		  	break;
        }
        if(fCancel==1)
        {
        	LcdDisIniIn();
        	break;
        }
        ///////////////////////////////////////////////////////////////
        for(i=0;i<CostLen;i++)
        {
        	TRDataBuf[26+i]=CostId[i];
        }
        TRDataBuf[26+CostLen]='#';
        for(i=0;i<WorkLen;i++)
        {
        	TRDataBuf[27+CostLen+i]=WorkId[i];
        }
        TRDataBuf[27+CostLen+WorkLen]='#';
        TRDataBuf[28+CostLen+WorkLen]=Type_clock+48;
        TRDataBuf[29+CostLen+WorkLen]='#';
        for(i=0;i<RoomLen;i++)
        {
        	TRDataBuf[30+CostLen+WorkLen+i]=RoomId[i];
        }
        TRDataBuf[30+CostLen+WorkLen+RoomLen]='#';
        //WIFISendData(TRDataBuf,31+CostLen+WorkLen+RoomLen);
   	    k=0;
   	    fOvTime=0;
   	    fCancel=0;
   	    clrram();
    	  chn_disp(Menu76,0);
    	  chn_disp(Null00,1);
   	    k=comTrCommand(TRDataBuf,31+CostLen+WorkLen+RoomLen);  //发送指令
   	    if(k==COM_NO_ERR)  //成功接收数据
   	    {
   	    	for(i=6;i<(comRxLength-1);i++)TRDataBuf[i-6]=comRxDataBuf[i];
          TRDataBuf[comRxLength-7]=0;
          if((TRDataBuf[0]=='2')&&(TRDataBuf[1]=='#')&&(TRDataBuf[2]==IndexSend+48)&&(TRDataBuf[3]=='#')&&(TRDataBuf[4]!='e'))
          {
          	WorkLen=0;
          	for(k=0;k<7;k++)
	          {
	          	WorkId[k]=TRDataBuf[4+k];
	          	if(WorkId[k]!='#')WorkLen++;
	          	else break;
	          }
	          CustLen=0;
	          for(k=0;k<7;k++)
	          {
	          	CustId[k]=TRDataBuf[5+WorkLen+k];
	          	if(CustId[k]!='#')CustLen++;
	          	else break;
	          }
	          //if((TRDataBuf[5+WorkLen+CustLen]=='#')&&(WorkLen+CustLen+6==TRDataLen))
	          {
	          	for(j=0;j<DISP_BUF_MAX;j++)
				  		{
				  			disp_buf[j]=0;
				  		}
				  		for(j=0;j<24;j++)
				      {
				      	if(fProSelect==0x04)
				      	{
				      		disp_buf[j]=CorM084[j];
				      	}
				      	else 
				      	{
				      		disp_buf[j]=CorM085[j];
				      	}
				      }
	          	disp_buf[4]=':';
	          	disp_buf[5]=' ';
              for(j=0;j<WorkLen;j++)
              {
              	disp_buf[6+j]=WorkId[j];
              }
              disp_buf[16]=':';
	          	disp_buf[17]=' ';
              for(j=0;j<CustLen;j++)
              {
              	disp_buf[18+j]=CustId[j];
              }
				  		LCD_disp_starting=0;
				  		LcddispCnt=0;
              clrram();
              chn_left_disp(disp_buf,0,24,LCD_disp_starting);
	          	chn_disp(Menu51,1);
	          	LCD_disp_starting++;
	          	LCD_disp_starting++;
	          	LcddispCnt++;
	          	LcdLeftCnt=LCD_LEFT_CNT;
				  		player_stop=0;
              while(player_busy()==1)
              {
              	if(LcdLeftCnt==0)
				  		  {
				  		  	chn_left_disp(disp_buf,0,24,LCD_disp_starting);
				  		  	LCD_disp_starting++;
				  		  	LCD_disp_starting++;
				  		  	LcddispCnt++;
				  		  	if(LCD_disp_starting>=28)
				  		  		LCD_disp_starting=0;
				  		  	LcdLeftCnt=LCD_LEFT_CNT;
				  		  }
              	WDT_CONTR=0x3d;  //喂狗 1.13s;
              }
				  		player_Num(35);
				  		while(player_busy()==1)
				  		{
				  			if(LcdLeftCnt==0)
				  		  {
				  		  	chn_left_disp(disp_buf,0,24,LCD_disp_starting);
				  		  	LCD_disp_starting++;
				  		  	LCD_disp_starting++;
				  		  	LcddispCnt++;
				  		  	if(LCD_disp_starting>=28)
				  		  		LCD_disp_starting=0;
				  		  	LcdLeftCnt=LCD_LEFT_CNT;
				  		  }
				  			WDT_CONTR=0x3d;  //喂狗 1.13s;
				  		}
				  		player_Num(10);
				  		k=0xff;
			      	while((k==0xff)&&(LcddispCnt<21))   //等待有按键
			      	{
			      		WDT_CONTR=0x3d;  //喂狗 1.13s;
			      		if(LcdLeftCnt==0)
				  			{
				  				chn_left_disp(disp_buf,0,24,LCD_disp_starting);
				  				LCD_disp_starting++;
				  				LCD_disp_starting++;
				  				LcddispCnt++;
				  				if(LCD_disp_starting>=28)
				  					LCD_disp_starting=0;
				  				LcdLeftCnt=LCD_LEFT_CNT;
				  			}
			      		k=KeyRd();
			      		fLcdPwr=LCD_ON;
			      		CntLcdOn=0;
			      	}
			      	delay1(10000);
	          }
          }
          else if((TRDataBuf[0]=='2')&&(TRDataBuf[1]=='#')&&(TRDataBuf[2]==IndexSend+48)&&(TRDataBuf[3]=='#')&&(TRDataBuf[4]=='e')&&(TRDataBuf[5]=='#'))
          {
          	chn_disp(ErrM03,1);
				  	player_Num(35);
				  	player_Num(11);
          	delay1(40000);
          }
          else
          {
          	chn_disp(ErrM12,1);
				  	player_Num(45);
				  	
          	delay1(40000);
          }
        }
        else
        {
         	staComRx=COM_RX_NONE;
         	player_Num(45);
         	if(k==COM_ERR_SER)  //服务器无响应
         	{
   	        chn_disp(ErrM11,1);
   	      	delay1(40000);
         	}
         	else if(k==COM_ERR_COR)   //协调器无响应
         	{
   	        chn_disp(ErrM10,1);
   	      	delay1(40000);
         	}
         	else;
        }
      }
			break;
			case FUN13:				//功能13:服务
			{
				clrram();
				KeyCLr();
    	  chn_disp(Menu77,0);
    	  chn_disp(Menu17,1);
				player_Num(36);
				player_stop=0;
    		while(player_busy()==1)WDT_CONTR=0x3d;  //喂狗 1.13s;
				player_Num(QSK);
    	  RFID_GetID();
        PinRfs=1;
        if((fOvTime==1)||(fCancel==1))break;
				player_Num(53);
        delay1(2000);
        TRDataBuf[0]='.';
        TRDataBuf[1]='#';
        IndexSend++;
        IndexSend%=10;
        TRDataBuf[2]=IndexSend+48;
        TRDataBuf[3]='#';
        for(i=0;i<10;i++)
        {
        	TRDataBuf[4+i]=idbuf[i];
        }
        TRDataBuf[14]='#';
        ///////////////////////////////////////////////////////////////
        for(j=0;j<DISP_BUF_MAX;j++)
				{
					disp_buf[j]=0;
				}
				for(j=0;j<40;j++)
				{
					disp_buf[j]=Menu84[j];
				}
        LCD_disp_starting=0;
        clrram();
    	  chn_disp(Menu83,0);
    	  chn_left_disp(disp_buf,1,40,LCD_disp_starting);
    	  LCD_disp_starting++;
	      LCD_disp_starting++;
	      LcdLeftCnt=LCD_LEFT_CNT;
    	  player_stop=0;
    		while(player_busy()==1)
    		{
    			if(LcdLeftCnt==0)
					{
						chn_left_disp(disp_buf,1,40,LCD_disp_starting);
						LCD_disp_starting++;
						LCD_disp_starting++;
						if(LCD_disp_starting>=44)
							LCD_disp_starting=0;
						LcdLeftCnt=LCD_LEFT_CNT;
					}
    			WDT_CONTR=0x3d;  //喂狗 1.13s;
    		}
				player_Num(QXZ);
    	  CntOv1s=0;
        fOvTime=0;
        fCancel=0;
        i=0;
    	  while(((i<0x01)||(i>0x06))&&(i!=0x0a))
      	{
      		WDT_CONTR=0x3d;  //喂狗 1.13s;
      		i=KeyRd();
    	    if(CntOv1s<=KEY_OVERTIME)
    		  {
    		  	if(LcdLeftCnt==0)
						{
							chn_left_disp(disp_buf,1,40,LCD_disp_starting);
							LCD_disp_starting++;
							LCD_disp_starting++;
							if(LCD_disp_starting>=44)
								LCD_disp_starting=0;
							LcdLeftCnt=LCD_LEFT_CNT;
						}
    		   	Lcd_overtime(KEY_OVERTIME-CntOv1s,0);
    		  }
    		  else
    		  {
    		   	fOvTime=1;
						player_Num(54);
						player_Num(55);
    		   	break;
    		  }
      	}
      	if(i==0x0a||fOvTime==1)       //*取消
      	{
      		fCancel=1;
      		break;
      	}
      	else if((i>=0x01)&&(i<=0x06))
      	{
      		Service_type=i;
      	}
      	else
      	{
      		fCancel=1;
      		break;
      	}
      	if(fCancel==1)
        {
        	LcdDisIniIn();
        	break;
        }
        ///////////////////////////////////////////////////////////////
        switch(Service_type)
        {
        	case 0x01:				//茶水
        	  clrram();
		  		  chn_disp(Menu85,0);
		  		  chn_disp(Menu50,1);
						player_Num(QQR);
		  		  CntOv1s=0;
		  	    fOvTime=0;
		  	    fCancel=0;
		  	    i=0;
		  		  while((i!=0x0b)&&(i!=0x0a))
		  	  	{
		  	  		WDT_CONTR=0x3d;  //喂狗 1.13s;
		  	  		i=KeyRd();
		  		    if(CntOv1s<=KEY_OVERTIME)
		  			  {
		  			   	Lcd_overtime(KEY_OVERTIME-CntOv1s,0);
		  			  }
		  			  else
		  			  {
		  			   	fOvTime=1;
								player_Num(54);
								player_Num(55);
		  			   	break;
		  			  }
		  	  	}
		  	  	if(i==0x0a||fOvTime==1)       //*取消
		  	  	{
		  	  		fCancel=1;
		  	  		break;
		  	  	}
        		break;
        	case 0x02:					//水果
        		clrram();
		  		  chn_disp(Menu86,0);
		  		  chn_disp(Menu50,1);
						player_Num(QQR);
		  		  CntOv1s=0;
		  	    fOvTime=0;
		  	    fCancel=0;
		  	    i=0;
		  		  while((i!=0x0b)&&(i!=0x0a))
		  	  	{
		  	  		WDT_CONTR=0x3d;  //喂狗 1.13s;
		  	  		i=KeyRd();
		  		    if(CntOv1s<=KEY_OVERTIME)
		  			  {
		  			   	Lcd_overtime(KEY_OVERTIME-CntOv1s,0);
		  			  }
		  			  else
		  			  {
		  			   	fOvTime=1;
								player_Num(54);
								player_Num(55);
		  			   	break;
		  			  }
		  	  	}
		  	  	if(i==0x0a||fOvTime==1)       //*取消
		  	  	{
		  	  		fCancel=1;
		  	  		break;
		  	  	}
        		break;
        	case 0x03:					//提前落钟
        		clrram();
		  		  chn_disp(Menu87,0);
		  		  chn_disp(Menu50,1);
						player_Num(QQR);
		  		  CntOv1s=0;
		  	    fOvTime=0;
		  	    fCancel=0;
		  	    i=0;
		  		  while((i!=0x0b)&&(i!=0x0a))
		  	  	{
		  	  		WDT_CONTR=0x3d;  //喂狗 1.13s;
		  	  		i=KeyRd();
		  		    if(CntOv1s<=KEY_OVERTIME)
		  			  {
		  			   	Lcd_overtime(KEY_OVERTIME-CntOv1s,0);
		  			  }
		  			  else
		  			  {
		  			   	fOvTime=1;
								player_Num(54);
								player_Num(55);
		  			   	break;
		  			  }
		  	  	}
		  	  	if(i==0x0a||fOvTime==1)       //*取消
		  	  	{
		  	  		fCancel=1;
		  	  		break;
		  	  	}
        		break;
        	case 0x04:					//投诉
        		clrram();
		  		  chn_disp(Menu88,0);
		  		  chn_disp(Menu50,1);
						player_Num(QQR);
		  		  CntOv1s=0;
		  	    fOvTime=0;
		  	    fCancel=0;
		  	    i=0;
		  		  while((i!=0x0b)&&(i!=0x0a))
		  	  	{
		  	  		WDT_CONTR=0x3d;  //喂狗 1.13s;
		  	  		i=KeyRd();
		  		    if(CntOv1s<=KEY_OVERTIME)
		  			  {
		  			   	Lcd_overtime(KEY_OVERTIME-CntOv1s,0);
		  			  }
		  			  else
		  			  {
		  			   	fOvTime=1;
								player_Num(54);
								player_Num(55);
		  			   	break;
		  			  }
		  	  	}
		  	  	if(i==0x0a||fOvTime==1)       //*取消
		  	  	{
		  	  		fCancel=1;
		  	  		break;
		  	  	}
        		break;
        	case 0x05:					//空调
        		clrram();
		  		  chn_disp(Menu89,0);
		  		  chn_disp(Menu50,1);
						player_Num(QQR);
		  		  CntOv1s=0;
		  	    fOvTime=0;
		  	    fCancel=0;
		  	    i=0;
		  		  while((i!=0x0b)&&(i!=0x0a))
		  	  	{
		  	  		WDT_CONTR=0x3d;  //喂狗 1.13s;
		  	  		i=KeyRd();
		  		    if(CntOv1s<=KEY_OVERTIME)
		  			  {
		  			   	Lcd_overtime(KEY_OVERTIME-CntOv1s,0);
		  			  }
		  			  else
		  			  {
		  			   	fOvTime=1;
								player_Num(54);
								player_Num(55);
		  			   	break;
		  			  }
		  	  	}
		  	  	if(i==0x0a||fOvTime==1)       //*取消
		  	  	{
		  	  		fCancel=1;
		  	  		break;
		  	  	}
        		break;
        	case 0x06:					//电视
        		clrram();
		  		  chn_disp(Menu90,0);
		  		  chn_disp(Menu50,1);
						player_Num(QQR);
		  		  CntOv1s=0;
		  	    fOvTime=0;
		  	    fCancel=0;
		  	    i=0;
		  		  while((i!=0x0b)&&(i!=0x0a))
		  	  	{
		  	  		WDT_CONTR=0x3d;  //喂狗 1.13s;
		  	  		i=KeyRd();
		  		    if(CntOv1s<=KEY_OVERTIME)
		  			  {
		  			   	Lcd_overtime(KEY_OVERTIME-CntOv1s,0);
		  			  }
		  			  else
		  			  {
		  			   	fOvTime=1;
								player_Num(54);
								player_Num(55);
		  			   	break;
		  			  }
		  	  	}
		  	  	if(i==0x0a||fOvTime==1)       //*取消
		  	  	{
		  	  		fCancel=1;
		  	  		break;
		  	  	}
        		break;
        	default : 
        		fCancel=1;
    		  	break;
        }
        if(fCancel==1)
        {
        	LcdDisIniIn();
        	break;
        }
        TRDataBuf[15]=Service_type+48;
        TRDataBuf[16]='#';
        ///////////////////////////////////////////////////////////////
        for(i=0;i<RoomLen;i++)
        {
        	TRDataBuf[17+i]=RoomId[i];
        }
        TRDataBuf[17+RoomLen]='#';
   	    //WIFISendData(TRDataBuf,18+RoomLen);
   	    k=0;
   	    fOvTime=0;
   	    fCancel=0;
   	    clrram();
		  	chn_disp(Menu77,0);
		  	chn_disp(Null00,1);
   	    k=comTrCommand(TRDataBuf,18+RoomLen);  //发送指令
   	    if(k==COM_NO_ERR)  //成功接收数据
   	    {
   	    	for(i=6;i<(comRxLength-1);i++)TRDataBuf[i-6]=comRxDataBuf[i];
          TRDataBuf[comRxLength-7]=0;
          if((TRDataBuf[0]=='.')&&(TRDataBuf[1]=='#')&&(TRDataBuf[2]==IndexSend+48)&&(TRDataBuf[3]=='#')&&(TRDataBuf[4]!='e'))
          {
          	WorkLen=0;
          	for(k=0;k<7;k++)
	          {
	          	WorkId[k]=TRDataBuf[4+k];
	          	if(WorkId[k]!='#')WorkLen++;
	          	else break;
	          }
	          //if((TRDataBuf[4+WorkLen]=='#')&&(WorkLen+5==TRDataLen))
	          {
    	        clrram();
    	        chn_disp(Menu53,0);
    	        chn_disp(Menu54,1);
    	        wr_lcd(comm,0x30);
              wr_lcd(comm,0x82);
              wr_lcd(dat,':');
              wr_lcd(comm,0x30);
              wr_lcd(comm,0x83);
              for(j=0;j<WorkLen;j++)
              {
              	wr_lcd(dat,WorkId[j]);
              }
				  		player_Num(36);
				  		player_Num(10);
              delay1(40000);
              delay1(40000);
	          }
          }
          else if((TRDataBuf[0]=='.')&&(TRDataBuf[1]=='#')&&(TRDataBuf[2]==IndexSend+48)&&(TRDataBuf[3]=='#')&&(TRDataBuf[4]=='e')&&(TRDataBuf[5]=='#'))
          {
          	chn_disp(ErrM03,1);
				  	player_Num(36);
				  	player_Num(11);
          	delay1(40000);
          }
          else
          {
          	chn_disp(ErrM12,1);
				  	player_Num(45);
				  	
          	delay1(40000);
          }
        }
        else
        {
         	staComRx=COM_RX_NONE;
         	player_Num(45);
         	if(k==COM_ERR_SER)  //服务器无响应
         	{
   	        chn_disp(ErrM11,1);
   	      	delay1(40000);
         	}
         	else if(k==COM_ERR_COR)   //协调器无响应
         	{
   	        chn_disp(ErrM10,1);
   	      	delay1(40000);
         	}
         	else;
        }
      }
			break;
			case FUN14:				//功能14:卡结账
			{
				clrram();
				KeyCLr();
    	  chn_disp(Menu78,0);
    	  chn_disp(Menu36,1);
				player_Num(41);
				player_Num(QSK);
    	  RFID_GetID();
        PinRfs=1;
        if((fOvTime==1)||(fCancel==1))break;
				player_Num(53);
        delay1(2000);
        TRDataBuf[0]='9';
        TRDataBuf[1]='#';
        IndexSend++;
        IndexSend%=10;
        TRDataBuf[2]=IndexSend+48;
        TRDataBuf[3]='#';
        for(i=0;i<10;i++)
        {
        	TRDataBuf[4+i]=idbuf[i];
        }
        TRDataBuf[14]='#';
        ////////////////////////////////////////////////////////////////////
        fOvTime=0;
				fCancel=0;
				if(fProSelect==0x04)
				{
					clrram();
    	    chn_disp(Menu78,0);
    	    chn_disp(Menu18,1);
				  player_Num(QSK);
    	    for(i=0;i<3;i++)
          {
          	delay1(10000);
          	RFID_GetID();
            if((fOvTime==1)||(fCancel==1))break;
            k=0;
            for(j=0;j<10;j++)
            {
            	if(idbuf[j]!=TRDataBuf[4+j])
            	{
            		k++;
            	}
            }
            PinRfs=1;
            if(k>0)
            {
            	fOvTime=0;
				  		player_Num(53);
            	break;
            }
            fOvTime=1;
				  	player_Num(53);
				  	player_Num(53);
				  	player_Num(53);
				  	player_Num(53);
          }
          PinRfs=1;
        }
        if((fOvTime==1)||(fCancel==1))break;
        for(i=0;i<10;i++)
        {
        	TRDataBuf[15+i]=idbuf[i];
        }
        TRDataBuf[25]='#';
        //////////////////////////////////////////////////////////////////////////////////
        clrram();
    	  chn_disp(Menu78,0);
    	  chn_disp(Menu56,1);
				player_Num(QSK);
    	  for(i=0;i<3;i++)
        {
        	delay1(10000);
        	RFID_GetID();
          if((fOvTime==1)||(fCancel==1))break;
          k=0;
          for(j=0;j<10;j++)
          {
          	if(idbuf[j]!=TRDataBuf[15+j])
          	{
          		k++;
          	}
          }
          PinRfs=1;
          if(k>0)
          {
          	fOvTime=0;
						player_Num(53);
          	break;
          }
          fOvTime=1;
					player_Num(53);
					player_Num(53);
					player_Num(53);
					player_Num(53);
        }
        PinRfs=1;
        if((fOvTime==1)||(fCancel==1))break;
        for(i=0;i<10;i++)
        {
        	TRDataBuf[26+i]=idbuf[i];
        }
        TRDataBuf[36]='#';
        for(i=0;i<RoomLen;i++)
        {
        	TRDataBuf[37+i]=RoomId[i];
        }
        TRDataBuf[37+RoomLen]='#';
   	    //WIFISendData(TRDataBuf,38+RoomLen);
   	    k=0;
   	    fOvTime=0;
   	    fCancel=0;
   	    k=comTrCommand(TRDataBuf,38+RoomLen);  //发送指令
   	    if(k==COM_NO_ERR)  //成功接收数据
   	    {
   	    	for(i=6;i<(comRxLength-1);i++)TRDataBuf[i-6]=comRxDataBuf[i];
          TRDataBuf[comRxLength-7]=0;
          if((TRDataBuf[0]=='9')&&(TRDataBuf[1]=='#')&&(TRDataBuf[2]==IndexSend+48)&&(TRDataBuf[3]=='#')&&(TRDataBuf[4]!='e'))
          {
          	check_flag=TRDataBuf[4];
          	if(TRDataBuf[5]!='#')
          	{
          		clrram();
    	        chn_disp(Null00,0);
    	        chn_disp(ErrM03,1);
          		break;
          	}
          	Intelen=0;
          	for(k=0;k<7;k++)
	          {
	          	Inte[k]=TRDataBuf[6+k];
	          	if(Inte[k]!='#')Intelen++;
	          	else break;
	          }
	          Resilen=0;
	          for(k=0;k<7;k++)
	          {
	          	Resi[k]=TRDataBuf[7+Intelen+k];
	          	if(Resi[k]!='#')Resilen++;
	          	else break;
	          }
	          Cost_len=0;
	          for(k=0;k<7;k++)
	          {
	          	Cost[k]=TRDataBuf[8+Intelen+Resilen+k];
	          	if(Cost[k]!='#')Cost_len++;
	          	else break;
	          }
	          //if((TRDataBuf[8+Intelen+Resilen+Cost_len]=='#')&&(9+Intelen+Resilen+Cost_len==TRDataLen))
	          {
    	        if(check_flag==(0+48))
    	        {
    	        	//可以结账
    	        	for(j=0;j<DISP_BUF_MAX;j++)
				  			{
				  				disp_buf[j]=0;
				  			}
				  			for(j=0;j<30;j++)
				  	    {
				  	    	disp_buf[j]=Menu61[j];
				  	    }
		          	for(j=0;j<Intelen;j++)
	  	          {
	  	          	disp_buf[4+j]=Inte[j];
	  	          }
	  	          for(j=0;j<Resilen;j++)
	  	          {
	  	          	disp_buf[14+j]=Resi[j];
	  	          }
	  	          for(j=0;j<Cost_len;j++)
	  	          {
	  	          	disp_buf[24+j]=Cost[j];
	  	          }
				  			LCD_disp_starting=0;
	  	          clrram();
	  	          chn_disp(Menu57,0);
	  	          chn_left_disp1(disp_buf,1,30,LCD_disp_starting,1);
		          	LCD_disp_starting++;
		          	LCD_disp_starting++;
		          	LcdLeftCnt=LCD_LEFT_CNT;
				  			player_stop=0;
	  	          while(player_busy()==1)
	  	          {
	  	          	if(LcdLeftCnt==0)
				  			  {
				  			  	chn_left_disp1(disp_buf,1,30,LCD_disp_starting,1);
				  			  	LCD_disp_starting++;
				  			  	LCD_disp_starting++;
				  			  	if(LCD_disp_starting>=34)
				  			  		LCD_disp_starting=0;
				  			  	LcdLeftCnt=LCD_LEFT_CNT;
				  			  }
	  	          	WDT_CONTR=0x3d;  //喂狗 1.13s;
	  	          }
				  			player_Num(37);
				  			player_Sev(&Inte[0],Intelen,disp_buf,1,30,1);
				  			while(player_busy()==1)
				  			{
				  				if(LcdLeftCnt==0)
				  			  {
				  			  	chn_left_disp1(disp_buf,1,30,LCD_disp_starting,1);
				  			  	LCD_disp_starting++;
				  			  	LCD_disp_starting++;
				  			  	if(LCD_disp_starting>=34)
				  			  		LCD_disp_starting=0;
				  			  	LcdLeftCnt=LCD_LEFT_CNT;
				  			  }
				  				WDT_CONTR=0x3d;  //喂狗 1.13s;
				  			}
				  			player_Num(38);
				  			player_Sev(&Resi[0],Resilen,disp_buf,1,30,1);
				  			while(player_busy()==1)
				  			{
				  				if(LcdLeftCnt==0)
				  			  {
				  			  	chn_left_disp1(disp_buf,1,30,LCD_disp_starting,1);
				  			  	LCD_disp_starting++;
				  			  	LCD_disp_starting++;
				  			  	if(LCD_disp_starting>=34)
				  			  		LCD_disp_starting=0;
				  			  	LcdLeftCnt=LCD_LEFT_CNT;
				  			  }
				  				WDT_CONTR=0x3d;  //喂狗 1.13s;
				  			}
				  			player_Num(39);
				  			player_Sev(&Cost[0],Cost_len,disp_buf,1,30,1);
				  			while(player_busy()==1)
				  			{
				  				if(LcdLeftCnt==0)
				  			  {
				  			  	chn_left_disp1(disp_buf,1,30,LCD_disp_starting,1);
				  			  	LCD_disp_starting++;
				  			  	LCD_disp_starting++;
				  			  	if(LCD_disp_starting>=34)
				  			  		LCD_disp_starting=0;
				  			  	LcdLeftCnt=LCD_LEFT_CNT;
				  			  }
				  				WDT_CONTR=0x3d;  //喂狗 1.13s;
				  			}
				  			player_Num(QQR);
	  		        i=0;
		      		  CntOv1s=0;
		      	    fOvTime=0;
		      	    fCancel=0;
		      	    i=0;
		      		  while((i!=0x0b)&&(i!=0x0a))
		      	  	{
		      	  		WDT_CONTR=0x3d;  //喂狗 1.13s;
		      	  		i=KeyRd();
		      		    if(CntOv1s<=KEY_OVERTIME)
		      			  {
		      			  	if(LcdLeftCnt==0)
				  				  {
				  				  	chn_left_disp1(disp_buf,1,30,LCD_disp_starting,1);
				  				  	LCD_disp_starting++;
				  				  	LCD_disp_starting++;
				  				  	if(LCD_disp_starting>=34)
				  				  		LCD_disp_starting=0;
				  				  	LcdLeftCnt=LCD_LEFT_CNT;
				  				  }
		      			   	Lcd_overtime(KEY_OVERTIME-CntOv1s,0);
		      			  }
		      			  else
		      			  {
		      			   	fOvTime=1;
				  					player_Num(54);
				  					player_Num(55);
		      			   	break;
		      			  }
		      	  	}
		      	  	if(i==0x0a||fOvTime==1)       //*取消
		      	  	{
		      	  		fCancel=1;
		      	  	}
		      	  	else if(i==0x0b)						//确定
		      	  	{
		      	  		TRDataBuf[0]='m';
		      	  		TRDataBuf[1]='#';
		      	  		TRDataBuf[2]=IndexSend+48;
          				TRDataBuf[3]='#';
          				TRDataBuf[4]='m';
		      	  		TRDataBuf[5]='#';
          				//WIFISendData(TRDataBuf,6);
				  				clrram();
				  				chn_disp(Null00,0);
          				k=0;
			     		    fOvTime=0;
			     		    fCancel=0;
			     		    k=comTrCommand(TRDataBuf,6);  //发送指令
   	              if(k==COM_NO_ERR)  //成功接收数据
   	              {
   	              	for(i=6;i<(comRxLength-1);i++)TRDataBuf[i-6]=comRxDataBuf[i];
                    TRDataBuf[comRxLength-7]=0;
			      	      if((TRDataBuf[0]=='m')&&(TRDataBuf[1]=='#')&&(TRDataBuf[2]==IndexSend+48)&&(TRDataBuf[3]=='#')&&(TRDataBuf[4]=='k')&&(TRDataBuf[5]=='#'))
			      	      {
			      	      	clrram();
				      		    chn_disp(Null00,0);
				      		    chn_disp(Menu59,1);
				  				  	player_Num(41);
				  				  	player_Num(10);
				      		    delay1(40000);
              		  	delay1(40000);
              		  	break;
			      	      }
			      	      else if((TRDataBuf[0]=='m')&&(TRDataBuf[1]=='#')&&(TRDataBuf[2]==IndexSend+48)&&(TRDataBuf[3]=='#')&&(TRDataBuf[4]=='e'))
			      	      {
			      	      	chn_disp(ErrM03,1);
				  				  	player_Num(41);
				  				  	player_Num(11);
			      	      	delay1(40000);
			      	      } 
			      	      else
			      	      {
			      	      	chn_disp(ErrM12,1);
				  				  	player_Num(45);
				  				  	
			      	      	delay1(40000);
          				  }
          				}
          				else
                  {
                   	staComRx=COM_RX_NONE;
                   	player_Num(45);
                   	if(k==COM_ERR_SER)  //服务器无响应
                   	{
   	                  chn_disp(ErrM11,1);
   	                	delay1(40000);
                   	}
                   	else if(k==COM_ERR_COR)   //协调器无响应
                   	{
   	                  chn_disp(ErrM10,1);
   	                	delay1(40000);
                   	}
                   	else;
                  }
		      	  	}
		      	  	else
		      	  	{
		      	  		fCancel=1;
		      	  	}
		      	  	if(fCancel==1)
		      	    {
		      	    	LcdDisIniIn();
		      	    	break;
		      	    }
    	        }
    	        else
    	        {
    	        	//不能结账，余额不足
    	        	for(j=0;j<DISP_BUF_MAX;j++)
				  			{
				  				disp_buf[j]=0;
				  			}
				  			for(j=0;j<30;j++)
				  	    {
				  	    	disp_buf[j]=Menu61[j];
				  	    }
		          	for(j=0;j<Intelen;j++)
	  	          {
	  	          	disp_buf[4+j]=Inte[j];
	  	          }
	  	          for(j=0;j<Resilen;j++)
	  	          {
	  	          	disp_buf[14+j]=Resi[j];
	  	          }
	  	          for(j=0;j<Cost_len;j++)
	  	          {
	  	          	disp_buf[24+j]=Cost[j];
	  	          }
				  			LCD_disp_starting=0;
				  			LcddispCnt=0;
	  	          clrram();
	  	          chn_disp(Menu60,0);
	  	          chn_left_disp1(disp_buf,1,30,LCD_disp_starting,1);
		          	LCD_disp_starting++;
		          	LCD_disp_starting++;
		          	LcddispCnt++;
		          	LcdLeftCnt=LCD_LEFT_CNT;
				  			player_stop=0;
	  	          while(player_busy()==1)
	  	          {
	  	          	if(LcdLeftCnt==0)
				  			  {
				  			  	chn_left_disp1(disp_buf,1,30,LCD_disp_starting,1);
				  			  	LCD_disp_starting++;
				  			  	LCD_disp_starting++;
				  			  	LcddispCnt++;
				  			  	if(LCD_disp_starting>=34)
				  			  		LCD_disp_starting=0;
				  			  	LcdLeftCnt=LCD_LEFT_CNT;
				  			  }
	  	          	WDT_CONTR=0x3d;  //喂狗 1.13s;
	  	          }
				  			player_Num(37);
				  			player_Sev(&Inte[0],Intelen,disp_buf,1,30,1);
				  			while(player_busy()==1)
				  			{
				  				if(LcdLeftCnt==0)
				  			  {
				  			  	chn_left_disp1(disp_buf,1,30,LCD_disp_starting,1);
				  			  	LCD_disp_starting++;
				  			  	LCD_disp_starting++;
				  			  	LcddispCnt++;
				  			  	if(LCD_disp_starting>=34)
				  			  		LCD_disp_starting=0;
				  			  	LcdLeftCnt=LCD_LEFT_CNT;
				  			  }
				  				WDT_CONTR=0x3d;  //喂狗 1.13s;
				  			}
				  			player_Num(38);
				  			player_Sev(&Resi[0],Resilen,disp_buf,1,30,1);
				  			while(player_busy()==1)
				  			{
				  				if(LcdLeftCnt==0)
				  			  {
				  			  	chn_left_disp1(disp_buf,1,30,LCD_disp_starting,1);
				  			  	LCD_disp_starting++;
				  			  	LCD_disp_starting++;
				  			  	LcddispCnt++;
				  			  	if(LCD_disp_starting>=34)
				  			  		LCD_disp_starting=0;
				  			  	LcdLeftCnt=LCD_LEFT_CNT;
				  			  }
				  				WDT_CONTR=0x3d;  //喂狗 1.13s;
				  			}
				  			player_Num(39);
				  			player_Sev(&Cost[0],Cost_len,disp_buf,1,30,1);
				  			while(player_busy()==1)
				  			{
				  				if(LcdLeftCnt==0)
				  			  {
				  			  	chn_left_disp1(disp_buf,1,30,LCD_disp_starting,1);
				  			  	LCD_disp_starting++;
				  			  	LCD_disp_starting++;
				  			  	LcddispCnt++;
				  			  	if(LCD_disp_starting>=34)
				  			  		LCD_disp_starting=0;
				  			  	LcdLeftCnt=LCD_LEFT_CNT;
				  			  }
				  				WDT_CONTR=0x3d;  //喂狗 1.13s;
				  			}
				  			player_Num(42);
				  			k=0xff;
				      	while((k==0xff)&&(LcddispCnt<27))   //等待有按键
				      	{
				      		WDT_CONTR=0x3d;  //喂狗 1.13s;
				      		if(LcdLeftCnt==0)
				  				{
				  					chn_left_disp1(disp_buf,1,30,LCD_disp_starting,1);
				  					LCD_disp_starting++;
				  					LCD_disp_starting++;
				  					LcddispCnt++;
				  					if(LCD_disp_starting>=34)
				  						LCD_disp_starting=0;
				  					LcdLeftCnt=LCD_LEFT_CNT;
				  				}
				      		k=KeyRd();
				      		fLcdPwr=LCD_ON;
				      		CntLcdOn=0;
				      	}
				      	delay1(10000);
              	break;
    	        }
	          }
          }
          else if((TRDataBuf[0]=='9')&&(TRDataBuf[1]=='#')&&(TRDataBuf[2]==IndexSend+48)&&(TRDataBuf[3]=='#')&&(TRDataBuf[4]=='e')&&(TRDataBuf[5]=='#'))
          {
          	chn_disp(ErrM03,1);
				  	player_Num(41);
				  	player_Num(11);
          	delay1(40000);
          }
          else
          {
          	chn_disp(ErrM12,1);
				  	player_Num(45);
				  	player_Num(55);
          	delay1(40000);
          }
        }
        else
        {
         	staComRx=COM_RX_NONE;
         	player_Num(45);
         	if(k==COM_ERR_SER)  //服务器无响应
         	{
   	        chn_disp(ErrM11,1);
   	      	delay1(40000);
         	}
         	else if(k==COM_ERR_COR)   //协调器无响应
         	{
   	        chn_disp(ErrM10,1);
   	      	delay1(40000);
         	}
         	else;
        }
      }
			break;
    	default : 
    	break;
   	}
   	KeyCLr();
   	CntLcdOn=0;
   	WDT_CONTR=0x3d;  //喂狗 1.13s;
   	Notice_again_ENflag=Notice_operat_flag;
   	Notice_operat_flag=0;
   	delay1(2000);
   	LcdDisIniIn();
 	}
}

void T0_int(void) interrupt INT_T0		//5ms进入中断一次.
{
	INT8U cntKeyBuf[5];          //键盘缓冲环计数数组.
	INT8U txConfirmData[20];
	INT8U key_temp;
	INT8U i,j;
	TH0	= 0xdc;
	TL0	= 0x31;
	//cntBuzzer++;
  //testPin=!testPin;            //定时器时间测试用
  Cnt5ms++;
  cntSemPend++;
  if(cntComRxTimeout>=20)
	{
		cntComRxTimeout=21;
		if(cntComRxIndex!=0)
		{
			comRxLength=cntComRxIndex;
			if((comRxDataBuf[0]==comRxLength-1)&&(comRxDataBuf[comRxLength-1]==0xff))   //帧长度和帧结束标志正确
			{
				if((comRxDataBuf[1]==0x00)&&(comRxDataBuf[6]==0x02)&&(comRxDataBuf[7]==0x00))  //接收到查询chn,myadress
				{
					txConfirmData[0]=12;
					txConfirmData[1]=0x01;
					txConfirmData[2]=0x00;
					txConfirmData[3]=0x00;
					txConfirmData[4]=0x00;
					txConfirmData[5]=0x00;
					txConfirmData[6]=0x02;  //注意
					txConfirmData[7]=MyChn+0x0b;  //chn
					txConfirmData[8]=0x00;
					txConfirmData[9]=0x00;
					txConfirmData[10]=MyAddres[0];  //addressL
					txConfirmData[11]=MyAddres[1];  //addressH
					txConfirmData[12]=0xff;
					comSenData(txConfirmData[0]+1,txConfirmData);
					staNet=NET_INIT;
				}
				if((comRxDataBuf[1]==0x00)&&(comRxDataBuf[6]==0x03)&&(comRxDataBuf[7]==0x4a))  //接收到加入网络
				{
					txConfirmData[0]=8;
					txConfirmData[1]=0x01;
					txConfirmData[2]=0x00;
					txConfirmData[3]=0x00;
					txConfirmData[4]=0x00;
					txConfirmData[5]=0x00;
					txConfirmData[6]=0x03;
					txConfirmData[7]=0x4a;
					txConfirmData[8]=0xff;
					comSenData(txConfirmData[0]+1,txConfirmData);
					staNet=NET_JOIN;
				}
				if((comRxDataBuf[1]==0x00)&&(comRxDataBuf[6]==0x03)&&(comRxDataBuf[7]==0x4b))  //接收到断开网络
				{
					txConfirmData[0]=8;
					txConfirmData[1]=0x01;
					txConfirmData[2]=0x00;
					txConfirmData[3]=0x00;
					txConfirmData[4]=0x00;
					txConfirmData[5]=0x00;
					txConfirmData[6]=0x03;
					txConfirmData[7]=0x4b;
					txConfirmData[8]=0xff;
					comSenData(txConfirmData[0]+1,txConfirmData);
					staNet=NET_LEAVE;
				}
				if((comRxDataBuf[1]==0x02)&&(comRxDataBuf[4]==MyAddres[0])&&(comRxDataBuf[5]==MyAddres[1]))  //接收到数据
				{
					if(comRxDataBuf[6]=='d')flag_rx_time=1;  //刷卡器催钟
					else
					{
						staComRx=COM_RX_DATA;
					  flag_com_data_finish=1;
					  //OSSemPost(comRxDataRdy);
					  comRxDataRdy=1;
					}
				}
				if((comRxDataBuf[1]==0x03)&&(comRxDataBuf[4]==MyAddres[0])&&(comRxDataBuf[5]==MyAddres[1])&&(comRxDataBuf[6]==0x52))  //接收到数据确认帧
				{
					staComRx=COM_RX_DCONFIRM;
					flag_com_confirm_finish=1;
					//OSSemPost(comRxConfirmRdy);
					comRxConfirmRdy=1;
				}
			}
			else if((comRxLength == 10)   			/** 帧长度 **/
				&&(comRxDataBuf[0]==0xaa)			/** 帧开始标志 **/
				&&(comRxDataBuf[10 - 1]==0xbb)) 	/** 帧结束标志 **/
			{
				#if	1
				if((comRxDataBuf[1]
				^comRxDataBuf[2]
				^comRxDataBuf[3]
				^comRxDataBuf[4]
				^comRxDataBuf[5]
				^comRxDataBuf[6]
				^comRxDataBuf[7]) == comRxDataBuf[8])	/** BCC checksum **/
				{
					staComRx=COM_RX_CARD;
					flag_com_confirm_finish=1;
				}
				#else
					
				#endif
			}
		}
		cntComRxIndex=0;
	}
	cntComRxTimeout++;
  
  
	if(Cnt5ms>=200)
	{
		Cnt5ms=0;
		CntLcdOn++;
//		Cnt1s++;
		CntOv1s++;
	}
	if(LcdLeftCnt)
		LcdLeftCnt--;
	if(player_wait_time)
		player_wait_time--;
	if(player_Cut_stop==0)
	{
		if(player_Cut!=10)
		{
			if(BUSY_AP170==0)
				player_Cut++;
			else
				player_Cut=0;
		}
		else
		{
			player_Cut=0;
			player_Cut_stop=1;
			player_PDN_INT();
		}	
	}
	if(fLcdPwr==LCD_ON)
	{
		LCD_PWR=LCD_ON;
		KeyLed=LED_ON;
	}
	if(CntLcdOn>=CNT_LCD_ON)
	{
		CntLcdOn=CNT_LCD_ON;
	}
	key_temp=0x00;
	KEYPORT=0xf0;                                      //矩阵键盘扫描
	_nop_();
	_nop_();
	_nop_();
	_nop_();
	if(k5)key_temp|=0x10;else key_temp&=0xef;
	if(k6)key_temp|=0x20;else key_temp&=0xdf;
	if(k7)key_temp|=0x40;else key_temp&=0xbf;
	if(k8)key_temp|=0x80;else key_temp&=0x7f;
	KEYPORT=0x0f;
	_nop_();
	_nop_();
	_nop_();
	_nop_();
	if(k1)key_temp|=0x01;else key_temp&=0xfe;
	if(k2)key_temp|=0x02;else key_temp&=0xfd;
	if(k3)key_temp|=0x04;else key_temp&=0xfb;
	if(k4)key_temp|=0x08;else key_temp&=0xf7;
	key_temp^=0xff;
	KeyPoint%=5;
	KeyCir[KeyPoint]=key_temp;
	KeyPoint++;
	key_temp=0x00;
	for(i=0;i<5;i++)
	{
		cntKeyBuf[i]=0;
		for(j=0;j<5;j++)
		{
			if(KeyCir[i]==KeyCir[j])cntKeyBuf[i]++;
		}
		if(cntKeyBuf[i]>=3)key_temp=KeyCir[i];
	}
	//_nop_();                            //供测试时放置中断点
	if(KeyRptBuf==key_temp)return;        //忽略同一个键连按的状态
	if(key_temp!=0x00)
	{
		CntLcdOn=0;
		fLcdPwr=LCD_ON;
		player_INT(53);
		if(KeyRdPoint==((KeyWrPoint+1)%10))
		{
			KeyBuf[KeyWrPoint]=key_temp;     //键盘缓冲环已满,则覆盖当前键值.
		}
		else
		{
			
			KeyBuf[KeyWrPoint]=key_temp;
			KeyWrPoint++;
			KeyWrPoint%=10;
		}
		
	}
	KeyRptBuf=key_temp;
  //_nop_();                           //供测试时放置中断点
}
void Serial_Int() interrupt INT_SER
{
	if(TI)
	{
		//Tibuf=1;
		//TI=0;		
	}
	if(RI)
	{
		RI=0;
  	comRxDataBuf[cntComRxIndex++] = SBUF;
  	cntComRxTimeout=0;
  	
  	#if	0
  	/** debug start!!! **/
  	//if((comRxDataBuf[cntComRxIndex - 1] == 0xaa)||(comRxDataBuf[cntComRxIndex - 1] == 0xbb))
  	if((cntComRxIndex == 10) && (comRxDataBuf[0] == 0xaa) && (comRxDataBuf[9] == 0xbb))
  	//if(comRxDataBuf[0] == 0xaa)
  	//if(comRxDataBuf[9] == 0xbb)
  	//if(1)
  	{
		
	}
	/** debug over!!! **/
	#endif
	
	}
}

